## boards/heltec/heltec_wifi_lora32_v4/Kconfig.heltec_wifi_lora32_v4
```kconfig
# HELTEC WiFi LoRa 32 (V4) board configuration
#
# SPDX-License-Identifier: Apache-2.0

config BOARD_HELTEC_WIFI_LORA32_V4
	# V4 (4.2 / 4.3) = ESP32-S3 WROOM with 16MB flash + 2MB QSPI PSRAM.
	select SOC_ESP32S3_WROOM_N16R2
	select SOC_ESP32S3_PROCPU if BOARD_HELTEC_WIFI_LORA32_V4_ESP32S3_PROCPU
	select SOC_ESP32S3_APPCPU if BOARD_HELTEC_WIFI_LORA32_V4_ESP32S3_APPCPU
```

## boards/heltec/heltec_wifi_lora32_v4/board.yml
```yaml
board:
  name: heltec_wifi_lora32_v4
  full_name: WiFi LoRa 32 (V4)
  vendor: heltec
  # ONE image covers both V4 PCB revisions. They differ only in the RF
  # front-end module (4.2 -> GC1109, 4.3 -> KCT8103L) and its mode-select GPIO;
  # heltec_wifi_lora32_v4_fem.c detects the fitted FEM at boot (reads the CSD
  # line) and configures it, so no board revisions are needed. The
  # 8MB-octal-PSRAM "V4 R8" is a different memory part (quad vs octal PSRAM at
  # the SoC-dtsi level) and lives in its own board dir (heltec_wifi_lora32_v4_r8).
  socs:
  - name: esp32s3
```

## boards/heltec/heltec_wifi_lora32_v4_r8/board.yml
```yaml
board:
  name: heltec_wifi_lora32_v4_r8
  full_name: WiFi LoRa 32 (V4 R8)
  vendor: heltec
  # V4 "R8": ESP32-S3 WROOM with 16MB flash + 8MB OCTAL PSRAM (vs the 2MB QSPI
  # PSRAM on the plain V4). Because the PSRAM part differs at the SoC-dtsi level
  # (octal vs quad), this is a separate board rather than a revision of
  # heltec_wifi_lora32_v4. FEM is the KCT8103L (same as V4 4.3). Several control
  # pins move vs the plain V4 (Vext GPIO40, GPS enable) — all marked VERIFY.
  socs:
  - name: esp32s3
```

## boards/heltec/heltec_wifi_lora32_v4_r8/heltec_wifi_lora32_v4_r8_procpu_defconfig
```kconfig
# SPDX-License-Identifier: Apache-2.0

CONFIG_CLOCK_CONTROL=y
CONFIG_CONSOLE=y
CONFIG_GPIO=y
CONFIG_SERIAL=y
CONFIG_UART_CONSOLE=y

# The FEM power/enable pins are driven at boot with gpio-hogs (see the board
# devicetree). Same mechanism the V3 uses for Vext.
CONFIG_GPIO_HOGS=y
```

## samples/meshtastic/boards/heltec_wifi_lora32_v3_esp32s3_procpu.conf
```kconfig
# Heltec WiFi LoRa 32 (V3) — ESP32-S3 + on-board Semtech SX1262
# Board target: heltec_wifi_lora32_v3/esp32s3/procpu
#
# The upstream Zephyr board already declares a fully-wired `lora0` (sx1262)
# node, so no radio devicetree overlay is needed — only board-appropriate
# feature tuning lives here. (An optional overlay in this directory enables
# the on-die temperature sensor for device metrics.)

# The V3's SX1262 supports up to +22 dBm. 20 dBm is a common safe default;
# choose per your region and antenna. (Stack default is 17 dBm.)
CONFIG_MESHTASTIC_TX_POWER=20

# NOTE: the V3 has NO fuel-gauge IC — battery voltage is read via a plain ADC
# divider (VBAT sense enabled on GPIO37, measured on GPIO1), not a `fuel_gauge0`
# device. So CONFIG_MESHTASTIC_FUEL_GAUGE is intentionally left OFF; uptime and
# airtime/channel-utilization device metrics still work without it.

# The board overlay uses a gpio-hog to drive Vext (GPIO36) ON at boot, matching
# the reference firmware. This auto-enables from the DT, but set it explicitly.
CONFIG_GPIO_HOGS=y

# Admin "shutdown" support: the ESP32-S3 has HAS_POWEROFF, so sys_poweroff()
# enters deep sleep (wakes on reset). Enables canShutdown in device metadata.
CONFIG_POWEROFF=y
```

## samples/meshtastic/boards/twatch_s3_esp32s3_procpu.conf
```kconfig
CONFIG_MESHTASTIC_NODE_LONG_NAME="T-Watch S3"
CONFIG_MESHTASTIC_NODE_SHORT_NAME="TWS3"

CONFIG_I2C=y
CONFIG_REGULATOR=y
CONFIG_FUEL_GAUGE=y

CONFIG_MESHTASTIC_FUEL_GAUGE=y
CONFIG_MESHTASTIC_TX_POWER=4

# Admin "shutdown" = deep sleep via sys_poweroff() (ESP32-S3 HAS_POWEROFF).
CONFIG_POWEROFF=y
```

## src/Kconfig.core
```kconfig
# Copyright (c) 2026 The Zephyr Project Contributors
# SPDX-License-Identifier: GPL-3.0

menu "Meshtastic core"

config MESHTASTIC_THREAD_STACK_SIZE
	int "Processing thread stack size (bytes)"
	default 8192 if MESHTASTIC_BLE
	default 6144 if MESHTASTIC_GNSS || MESHTASTIC_DEVICE_METRICS || \
		MESHTASTIC_ENVIRONMENT_METRICS || MESHTASTIC_NODEINFO
	default 4096
	help
	  Stack size for the Meshtastic packet-processing thread.  Must
	  accommodate nanopb decoding, PSA crypto and the relay/auto-reply
	  transmit path.  Increase if stack overflows are observed.

config MESHTASTIC_THREAD_PRIORITY
	int "Processing thread priority"
	default 7
	help
	  Cooperative (negative) or preemptive (non-negative) priority of the
	  Meshtastic packet-processing thread.

config MESHTASTIC_RX_QUEUE_DEPTH
	int "Receive hand-off queue depth (frames)"
	default 4
	range 2 16
	help
	  Number of raw LoRa frames buffered between the driver receive
	  callback and the processing thread.  Each slot consumes about
	  260 bytes of RAM.  Increase if rx_dropped climbs under bursty
	  traffic (the processing thread fell behind incoming packets).

config MESHTASTIC_RX_REARM_RETRY_MS
	int "Receive re-arm retry interval (ms)"
	default 1000
	help
	  If re-arming continuous receive after a transmit fails, the radio
	  is left deaf.  The processing thread retries the re-arm at this
	  interval until it succeeds.

config MESHTASTIC_OUTBOUND_QUEUE_MAX
	int "Outbound LoRa transmit queue capacity (frames)"
	default 16
	range 2 64
	help
	  Physical capacity of the outbound priority queue. The scheduler
	  (meshtastic sched) enforces a runtime soft depth <= this ceiling, so
	  the depth can be tuned live without a rebuild up to this maximum. Each
	  slot holds a full wire frame, so raising this costs RAM.

config MESHTASTIC_OUTBOUND_QUEUE_DEPTH
	int "Default outbound transmit soft depth (frames)"
	default 8
	range 2 64
	help
	  Default runtime soft depth of the outbound queue (the scheduler's
	  starting tx.depth). Must be <= MESHTASTIC_OUTBOUND_QUEUE_MAX. All LoRa
	  TX (application packets, relay, periodic telemetry) is serialized
	  through this queue.

config MESHTASTIC_OUTBOUND_STACK_SIZE
	int "Outbound transmit worker stack size (bytes)"
	default 2048
	help
	  Stack for the thread that performs serialized LoRa transmits.

config MESHTASTIC_PACKET_HEXDUMP
	bool "Hex dump LoRa wire packets at DBG log level"
	default MESHTASTIC_LOG_LEVEL_DBG
	help
	  When enabled and the meshtastic log level is DBG, log a hex dump of
	  each Meshtastic wire packet (16-byte header plus encrypted payload)
	  on transmit and receive.

config MESHTASTIC_DEFAULT_HOP_LIMIT
	int "Default hop limit for outgoing packets"
	default 3
	range 1 7
	help
	  Number of times an outgoing packet may be relayed by intermediate
	  nodes.  3 is the Meshtastic firmware default; higher values increase
	  range at the cost of additional channel utilisation.

config MESHTASTIC_DEFAULT_REGION
	int "Default LoRa region code"
	default 1
	range 0 24
	help
	  Region this device operates in, as a meshtastic_Config_LoRaConfig_RegionCode
	  value.  1 is US (902-928 MHz) and is the default.  Seeds the stored
	  config on first boot; a later admin or phone-app change overrides it.

	  THIS IS A REGULATORY SETTING.  It determines the frequency the radio
	  transmits on and the power limit applied.  Set it to the region you are
	  physically operating in — transmitting outside your allocation is
	  illegal in most jurisdictions, and the firmware cannot detect that for
	  you.

	  Common values: 1 US, 2 EU_433, 3 EU_868, 4 CN, 5 JP, 6 ANZ, 7 RU,
	  8 KR, 9 TW, 10 IN, 11 NZ_865, 12 TH.  See the RegionCode enum in
	  meshtastic/config.proto for the full list.

	  Rejected regions:

	  - Amateur (ITU) allocations, whether or not the owner record is marked
	    licensed.  Amateur service forbids obscuring the meaning of a
	    transmission, and this port does not yet disable encryption in
	    licensed mode the way the reference firmware does.  Separately, the
	    2 m allocations (144-146 MHz) are below the SX1262's 150 MHz tuning
	    floor, and the 125 cm / 70 cm allocations fall far outside the
	    supported boards' 863-928 MHz front end.

	  - LORA_24 (2.4 GHz): no wide-LoRa radio support in this port.

	  A US device needs no licence: 902-928 MHz is unlicensed ISM spectrum.

config MESHTASTIC_DEFAULT_OK_TO_MQTT
	bool "Consent to our traffic being republished to MQTT by default"
	default n
	help
	  Seeds config.lora.config_ok_to_mqtt on first boot. When set, every
	  packet this node originates carries the OK_TO_MQTT bit, telling any
	  gateway that hears it that our traffic may be republished to an MQTT
	  broker — including a public one.

	  Defaults to n, matching the reference firmware: consent to being
	  rebroadcast off the local RF mesh should be opt-in.

	  This governs only OUR OWN traffic. Whether this node republishes other
	  people's packets is a separate matter, decided by their bit and by
	  whether the configured broker is private.

	  A later admin or phone-app change overrides this seed.

config MESHTASTIC_TX_POWER
	int "Default TX power (dBm)"
	default 17
	help
	  Default LoRa transmit power used when meshtastic_config.tx_power is
	  zero.  Most LoRa modules support 2–20 dBm; consult your hardware
	  datasheet for the allowed range.

config MESHTASTIC_DUP_CACHE_SIZE
	int "Duplicate-packet cache size (entries)"
	default 32
	range 4 64
	help
	  Number of (src, packet_id) pairs retained for duplicate suppression.
	  Each entry consumes 12 bytes of RAM.  Increase if duplicate packets
	  are observed in dense mesh deployments.  The retention window is bounded
	  by both this size and the runtime "dedup.ttl" scheduler knob (an entry
	  older than the TTL no longer suppresses a re-sent packet).

config MESHTASTIC_NODE_LONG_NAME
	string "Default node long name"
	default "Zephyr Meshtastic"
	help
	  Human-readable node name used when meshtastic_config.long_name is
	  NULL. This is reported through local APIs such as Bluetooth PhoneAPI.

config MESHTASTIC_NODE_SHORT_NAME
	string "Default node short name"
	default "ZEPH"
	help
	  Short node name used when meshtastic_config.short_name is NULL.

choice MESHTASTIC_NODE_ID_SOURCE
	prompt "Node ID source"
	default MESHTASTIC_NODE_ID_HWINFO if HWINFO_HAS_DRIVER
	default MESHTASTIC_NODE_ID_CUSTOM
	help
	  How the local 32-bit Meshtastic node ID is determined at init time.

config MESHTASTIC_NODE_ID_HWINFO
	bool "HWINFO device ID"
	depends on HWINFO_HAS_DRIVER
	help
	  Derive the node ID from the last four bytes of the value returned by
	  hwinfo_get_device_id().  Requires CONFIG_HWINFO.

#config MESHTASTIC_NODE_ID_BT_MAC
#	bool "Bluetooth identity address"
#	depends on BT
#	help
#	  Derive the node ID from the last four bytes of the default Bluetooth
#	  identity address (bt_id_get).
#
#config MESHTASTIC_NODE_ID_WIFI_MAC
#	bool "Wi-Fi link-layer address"
#	depends on NET_IF
#	help
#	  Derive the node ID from the last four bytes of the default network
#	  interface link-layer address.

config MESHTASTIC_NODE_ID_CUSTOM
	bool "Custom fixed value"
	help
	  Use meshtastic_config.node_id when non-zero, otherwise
	  CONFIG_MESHTASTIC_NODE_ID_DEFAULT.

endchoice

config MESHTASTIC_NODE_ID_DEFAULT
	hex "Default node ID (custom source)"
	depends on MESHTASTIC_NODE_ID_CUSTOM
	default 0xDEADBEEF
	help
	  Node ID used when MESHTASTIC_NODE_ID_CUSTOM is selected and
	  meshtastic_config.node_id is zero.

endmenu
```

## src/Kconfig.display
```kconfig
# Copyright (c) 2026 The Zephyr Project Contributors
# SPDX-License-Identifier: GPL-3.0

menuconfig MESHTASTIC_DISPLAY
	bool "On-device screen UI (CFB)"
	select DISPLAY
	select CHARACTER_FRAMEBUFFER
	help
	  Render a small on-device status UI on the board's monochrome display
	  using Zephyr's Character Framebuffer (CFB). It reads node/state data
	  from the existing Meshtastic C getters, so no phone app or shell is
	  required.

	  The board must provide a `chosen { zephyr,display }` node (e.g. the
	  SSD1306 OLED on the Heltec WiFi LoRa 32 V4); its driver (CONFIG_SSD1306
	  and friends) auto-enables from that devicetree node. Intended for small
	  monochrome panels such as 128x64 and 160x80.

	  A read-only status UI: a launcher menu plus a few pages (device info,
	  node list, stack status). With a board button (alias sw0) it is
	  navigable; without one it falls back to auto-cycling the pages on a
	  timer.

if MESHTASTIC_DISPLAY

config MESHTASTIC_DISPLAY_BUTTON
	bool "Navigate with the board button (sw0)"
	default y
	select INPUT
	help
	  Drive the UI from the board's user button, wired via a gpio-keys node
	  aliased as sw0 (the PRG/USER key on the Heltec V4). A short press moves
	  to the next item (the highlight cycles in a loop); a long press
	  confirms the highlighted choice. In a page, the footer offers Back
	  (return to the launcher) and Next (advance to the next page).

	  Selects the input subsystem; the gpio-keys driver auto-enables from the
	  devicetree node. If the board has no sw0 alias, or this is disabled, the
	  UI auto-cycles its pages on a timer instead.

config MESHTASTIC_DISPLAY_REFRESH_MS
	int "Screen refresh interval (ms)"
	default 1000
	range 100 10000
	help
	  How often the current page is redrawn. Live counters (TX/RX, RSSI,
	  uptime) update at this cadence. Button presses are handled immediately,
	  independent of this interval.

config MESHTASTIC_DISPLAY_LONGPRESS_MS
	int "Long-press threshold (ms)"
	default 600
	range 200 3000
	depends on MESHTASTIC_DISPLAY_BUTTON
	help
	  How long the button must be held to count as a long press (confirm)
	  rather than a short press (next). The long press fires at this threshold
	  while the button is still held, for immediate feedback.

config MESHTASTIC_DISPLAY_TIMEOUT_SECONDS
	int "Blank the screen after N seconds idle (0 = never)"
	default 30
	range 0 3600
	depends on MESHTASTIC_DISPLAY_BUTTON
	help
	  With no button activity for this long, the panel is blanked to save
	  power. The next button press wakes it without also navigating. Set 0 to
	  keep the screen on permanently.

config MESHTASTIC_DISPLAY_PAGE_SECONDS
	int "Seconds per page before auto-advancing (no-button fallback)"
	default 4
	range 1 60
	help
	  When no button is available (MESHTASTIC_DISPLAY_BUTTON=n or the board
	  has no sw0 alias), the UI cycles through its pages on a timer. This sets
	  how long each page stays on screen.

config MESHTASTIC_DISPLAY_STACK_SIZE
	int "Display thread stack size"
	default 2048
	help
	  Stack for the dedicated screen-refresh thread. It only calls CFB and the
	  Meshtastic getters, so a couple of KB is plenty.

config MESHTASTIC_DISPLAY_PRIORITY
	int "Display thread priority"
	default 10
	help
	  Preemptible priority of the screen-refresh thread. Kept below the radio
	  and packet-processing work so drawing never starves the mesh.

endif # MESHTASTIC_DISPLAY
```
