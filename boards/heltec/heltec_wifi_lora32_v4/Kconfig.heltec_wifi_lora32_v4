## src/Kconfig.mqtt
```kconfig
# Copyright (c) 2026 The Zephyr Project Contributors
# SPDX-License-Identifier: GPL-3.0

menuconfig MESHTASTIC_MQTT
	bool "Meshtastic MQTT gateway bridge"
	depends on NETWORKING && MQTT_LIB && NET_TCP && NET_SOCKETS && DNS_RESOLVER
	select NANOPB_ENABLE_MALLOC
	help
	  Bridge LoRa mesh packets to a Meshtastic-compatible MQTT broker using
	  ServiceEnvelope protobuf on msh/.../2/e/... topics.

	  Requires a network interface (Wi-Fi, Ethernet, etc.) in addition to LoRa.

	  Select NANOPB_ENABLE_MALLOC as ServiceEnvelope is dynamically allocated.

if MESHTASTIC_MQTT

config MESHTASTIC_MQTT_BROKER_HOST
	string "MQTT broker hostname"
	default "mqtt.meshtastic.org"
	help
	  MQTT broker address without port. For the public Meshtastic broker use
	  mqtt.meshtastic.org with the default credentials below.

config MESHTASTIC_MQTT_BROKER_PORT
	int "MQTT broker port"
	default 1883
	range 1 65535

config MESHTASTIC_MQTT_USERNAME
	string "MQTT username"
	default "meshdev"
	help
	  Default meshdev matches the public mqtt.meshtastic.org broker.

config MESHTASTIC_MQTT_PASSWORD
	string "MQTT password"
	default "large4cats"
	help
	  Default large4cats matches the public mqtt.meshtastic.org broker.

config MESHTASTIC_MQTT_TLS
	bool "Connect to the MQTT broker over TLS"
	depends on MQTT_LIB_TLS && NET_SOCKETS_SOCKOPT_TLS && TLS_CREDENTIALS
	help
	  Use a TLS-secured transport (typically port 8883). The CA trust anchor
	  is registered from meshtastic_mqtt_ca_cert.h under the sec tag below,
	  and the broker certificate is verified against MESHTASTIC_MQTT_TLS_HOSTNAME
	  (which also drives SNI) — so BROKER_HOST may be a raw IP to bypass DNS.

if MESHTASTIC_MQTT_TLS

config MESHTASTIC_MQTT_TLS_HOSTNAME
	string "TLS SNI / certificate verification hostname"
	default "mqtt.meshtastic.org"
	help
	  Hostname used for SNI and CN/SAN certificate verification, independent of
	  BROKER_HOST. Set to the broker's DNS name even when BROKER_HOST is an IP.

config MESHTASTIC_MQTT_TLS_SEC_TAG
	int "TLS credential security tag for the MQTT CA cert"
	default 42
	help
	  Arbitrary, unique sec tag under which the CA certificate is registered.
	  Unused when MESHTASTIC_MQTT_TLS_NO_VERIFY is set.

config MESHTASTIC_MQTT_TLS_NO_VERIFY
	bool "Skip broker certificate verification (encrypted but unauthenticated)"
	default n
	help
	  Establish a TLS-encrypted transport WITHOUT validating the broker
	  certificate: no CA trust anchor is loaded (meshtastic_mqtt_ca_cert.h is
	  not compiled in) and peer_verify is NONE. The channel is still encrypted
	  on the wire, but a man-in-the-middle cannot be detected.

	  Use this only when the on-device mbedTLS build cannot parse the chain the
	  broker serves (e.g. an RSA-signed Let's Encrypt chain against an
	  ECDSA-only mbedTLS config). Prefer full verification (leave this off and
	  embed the CA under the sec tag above) whenever the broker can serve a
	  chain this build can validate.

endif # MESHTASTIC_MQTT_TLS

config MESHTASTIC_MQTT_ROOT
	string "MQTT root topic prefix"
	default "msh/EU_868"
	help
	  Root topic prefix prepended to /2/e/... paths. Use msh/US or msh/EU_868
	  (or your region) for the public Meshtastic broker.

config MESHTASTIC_MQTT_ENCRYPTION_ENABLED
	bool "Publish encrypted MeshPackets to MQTT"
	default y
	help
	  When enabled, ServiceEnvelope carries encrypted MeshPacket payloads
	  (wire-compatible with official firmware). Downlink rejects decoded
	  packets when this is set.

config MESHTASTIC_MQTT_UPLINK_ENABLED
	bool "Uplink mesh packets to MQTT"
	default y
	help
	  Publish packets heard on LoRa (and locally transmitted) to the broker.

config MESHTASTIC_MQTT_DOWNLINK_ENABLED
	bool "Downlink MQTT packets to mesh"
	default y
	help
	  Subscribe to the channel topic and inject received ServiceEnvelopes
	  onto the local mesh.

config MESHTASTIC_MQTT_IGNORE_MQTT
	bool "Ignore packets that arrived via MQTT"
	default n
	help
	  When enabled, drop LoRa packets that have the via_mqtt flag set
	  (matches config.lora.ignore_mqtt in official firmware).

config MESHTASTIC_MQTT_THREAD_STACK_SIZE
	int "MQTT worker thread stack size"
	default 4096

config MESHTASTIC_MQTT_THREAD_PRIORITY
	int "MQTT worker thread priority"
	default 10
	help
	  Priority for the MQTT broker worker. This should normally be lower
	  priority than LoRa packet processing and local command workers so
	  connected broker I/O cannot delay local mesh sends.

config MESHTASTIC_MQTT_PUBLISH_QUEUE_SIZE
	int "Offline MQTT publish queue depth"
	default 32
	range 4 64
	help
	  Encoded MQTT ServiceEnvelope publishes that cannot be written to the
	  broker immediately are retained here and retried on the MQTT worker
	  thread. When full, the oldest envelope is dropped so newer mesh
	  traffic can continue to make progress.

config MESHTASTIC_MQTT_UPLINK_QUEUE_SIZE
	int "Deferred MQTT uplink encode queue depth"
	default 16
	range 4 64
	depends on MESHTASTIC_MQTT_UPLINK_ENABLED
	help
	  Packets to uplink are queued here and processed on the MQTT thread so
	  LoRa TX/RX and shell commands are not blocked on broker I/O. When
	  full, the newest packet is dropped before any protobuf or broker work
	  is attempted.

config MESHTASTIC_MQTT_RECONNECT_INTERVAL_MS
	int "Reconnect interval when broker is unreachable (ms)"
	default 5000
	range 1000 60000

config MESHTASTIC_MQTT_RX_BUFFER_SIZE
	int "MQTT client RX buffer size"
	default 1024
	range 256 4096

config MESHTASTIC_MQTT_TX_BUFFER_SIZE
	int "MQTT client TX buffer size"
	default 1024
	range 256 4096

config MESHTASTIC_MQTT_MAP_REPORT
	bool "Publish MapReport to MQTT map topic"
	default n
	help
	  Periodically publish an unencrypted MapReport wrapped in a
	  ServiceEnvelope to {root}/2/map/ (compatible with the public Meshtastic
	  map). Requires a position fix when location reporting is enabled.

if MESHTASTIC_MQTT_MAP_REPORT

config MESHTASTIC_MQTT_MAP_REPORT_INTERVAL_SEC
	int "MapReport publish interval (seconds)"
	default 900
	range 60 86400
	help
	  Minimum interval between map reports. Official firmware defaults to
	  15 minutes.

config MESHTASTIC_MQTT_MAP_REPORT_POSITION_PRECISION
	int "MapReport location precision (bits)"
	default 14
	range 12 15
	help
	  Bits of precision for latitude and longitude in the map report.
	  Values outside 12-15 are clamped to the default (14).

endif # MESHTASTIC_MQTT_MAP_REPORT

endif # MESHTASTIC_MQTT
```

## src/Kconfig.reliable
```kconfig
# Copyright (c) 2026 The Zephyr Project Contributors
# SPDX-License-Identifier: GPL-3.0

config MESHTASTIC_RELIABLE_DELIVERY
	bool "Sender-side reliable delivery (retransmission)"
	default y
	help
	  Track want_ack unicast packets this node originates and retransmit
	  them until an acknowledgement is received or the retry budget is
	  exhausted. An explicit ROUTING ACK/NAK from the destination, or an
	  implicit ACK (hearing a neighbour rebroadcast our packet), stops the
	  retransmission; exhaustion emits a TX-failed event and hands the
	  connected app a MAX_RETRANSMIT routing error.

	  Retry count and interval are tunable at runtime via the scheduler
	  surface (`meshtastic sched set reliable.retries|reliable.timeout`).

config MESHTASTIC_RELIABLE_MAX_PENDING
	int "Maximum in-flight reliable packets"
	depends on MESHTASTIC_RELIABLE_DELIVERY
	default 8
	range 1 32
	help
	  Number of unacknowledged want_ack packets tracked concurrently. Each
	  slot retains the packet's wire bytes (up to 255 B) for retransmission.
	  When the table is full, the oldest pending packet stops being tracked
	  (its delivery becomes best-effort).
```

## src/Kconfig.sntp
```kconfig
# Copyright (c) 2026 The Zephyr Project Contributors
# SPDX-License-Identifier: GPL-3.0

menuconfig MESHTASTIC_SNTP
	bool "Seed the wall clock from SNTP over IP"
	depends on NETWORKING && NET_IPV4 && DNS_RESOLVER
	select SNTP
	help
	  On a networked build with no GNSS and no battery-backed RTC, query an
	  SNTP server whenever the interface gets an IPv4 lease (and periodically
	  after) to seed meshtastic_clock. Without this the wall clock is only set
	  by the phone's set_time_only admin message, so CLI-driven nodes report
	  timestamps stuck at the epoch floor.

if MESHTASTIC_SNTP

config MESHTASTIC_SNTP_SERVER
	string "SNTP server (hostname or IP)"
	default "pool.ntp.org"
	help
	  Use a numeric IP on networks that block/intercept DNS (port 53) — e.g.
	  Cloudflare's NTP anycast "162.159.200.123" — so the query needs no
	  name resolution.

config MESHTASTIC_SNTP_TIMEOUT_MS
	int "SNTP query timeout (ms)"
	default 5000

config MESHTASTIC_SNTP_RESYNC_HOURS
	int "Periodic re-sync interval (hours; 0 = only on lease/reconnect)"
	default 12

config MESHTASTIC_SNTP_STACK_SIZE
	int "SNTP worker stack size"
	default 2560
	help
	  Dedicated workqueue stack. sntp_simple() blocks on DNS + UDP, so it must
	  not run on the system workqueue (which also completes LoRa DIO work).

config MESHTASTIC_SNTP_PRIORITY
	int "SNTP worker thread priority"
	default 10
	help
	  Keep below LoRa/radio processing so a slow NTP query never delays mesh
	  sends.

endif # MESHTASTIC_SNTP
```

## src/Kconfig.traceroute
```kconfig
# Copyright (c) 2026 The Zephyr Project Contributors
# SPDX-License-Identifier: GPL-3.0

config MESHTASTIC_TRACEROUTE
	bool "Meshtastic TraceRoute responder"
	default y
	help
	  Register a port handler for incoming TRACEROUTE_APP (port 70)
	  requests: reply with a RouteDiscovery so the app or the reference
	  client `meshtastic --traceroute` can map the path to this node. The
	  reply appends this node's receive SNR to the towards-route, mirroring
	  the reference firmware's destination behavior.

	  Responder only: this flood-router port does not insert itself into the
	  route of traces passing through it, and has no local trace initiator.
```

## src/Kconfig.wifi_auto
```kconfig
# Copyright (c) 2026 The Zephyr Project Contributors
# SPDX-License-Identifier: GPL-3.0

config MESHTASTIC_WIFI_AUTOCONNECT
	bool "Auto-connect WiFi from stored credentials at boot"
	depends on WIFI && WIFI_CREDENTIALS && WIFI_CREDENTIALS_CONNECT_STORED
	help
	  At boot, issue NET_REQUEST_WIFI_CONNECT_STORED so the station connects
	  using credentials persisted in NVS (provision once via `wifi cred add`).
	  Removes the need to type `wifi connect` on the shell -- required when the
	  console UART is repurposed (e.g. serial PhoneAPI) and only telnet remains.

if MESHTASTIC_WIFI_AUTOCONNECT

config MESHTASTIC_WIFI_AUTOCONNECT_DELAY_SEC
	int "Delay before first auto-connect attempt (seconds)"
	default 3

config MESHTASTIC_WIFI_AUTOCONNECT_RETRIES
	int "Auto-connect attempts before giving up"
	default 5

endif # MESHTASTIC_WIFI_AUTOCONNECT
```
