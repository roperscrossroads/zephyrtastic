## src/Kconfig.airtime
```kconfig
# Copyright (c) 2026 The Zephyr Project Contributors
# SPDX-License-Identifier: GPL-3.0

config MESHTASTIC_AIRTIME
	bool "Meshtastic channel and TX airtime accounting"
	default y
	help
	  Track LoRa time-on-air for TX and RX: the regulatory duty-cycle gate
	  (MESHTASTIC_DUTY_CYCLE) and the contention window read it, and, when
	  device metrics are built, DeviceMetrics telemetry reports it as
	  channel_utilization and air_util_tx, matching official firmware.

	  Not dependent on MESHTASTIC_DEVICE_METRICS (agents-ls39.1.13): until
	  2026-11-25 it was, so turning off device-metrics telemetry silently
	  removed the duty-cycle gate with it. The telemetry reads this under its
	  own #if; the accounting itself needs nothing from it.
```

## src/Kconfig.hawkbit
```kconfig
# SPDX-FileCopyrightText: Adam Roper
# SPDX-License-Identifier: GPL-3.0

config MESHTASTIC_HAWKBIT
	bool "Firmware updates from an Eclipse hawkBit server (DDI polling)"
	depends on HAWKBIT && HAWKBIT_SET_SETTINGS_RUNTIME
	depends on !HAWKBIT_AUTOHANDLER && !HAWKBIT_SHELL && !HAWKBIT_CONFIRM_IMG_ON_INIT
	depends on !MESHTASTIC_OTA
	select NET_MGMT_EVENT
	help
	  Poll a hawkBit server for an update and install it into the MCUboot
	  second slot, through Zephyr's hawkBit client (subsys/mgmt/hawkbit).

	  How it sits with the rest of the update path:
	  - It probes from its own thread, never the system work queue: a probe
	    downloads the whole image, and the stack's senders run on the work queue.
	    So HAWKBIT_AUTOHANDLER (which uses the work queue) must be off.
	  - The running image is confirmed by the healthy-window rule, not at init:
	    HAWKBIT_CONFIRM_IMG_ON_INIT must be off. The client then refuses to
	    probe until the image is confirmed, so the server hears "success" only
	    from an image that came up and stayed up.
	  - One writer of slot 1: the SMP update path (MESHTASTIC_OTA) is not built
	    beside it.
	  - The server and the device token are set at run time (`hawkbit server`,
	    `hawkbit token`) and kept in settings, never in the build.

if MESHTASTIC_HAWKBIT

config MESHTASTIC_HAWKBIT_STACK_SIZE
	int "hawkBit probe thread stack size"
	default 6144

config MESHTASTIC_HAWKBIT_PRIORITY
	int "hawkBit probe thread priority"
	default 12
	help
	  Low: a probe can download for minutes and must not hold up radio work.

config MESHTASTIC_HAWKBIT_CONFIRM_DELAY_SEC
	int "Confirm the running image after this many seconds of uptime"
	default 120
	help
	  The healthy window: a freshly swapped image that resets before this
	  is reverted by MCUboot. 0 leaves confirming to someone else.

config MESHTASTIC_HAWKBIT_MIN_POLL_SEC
	int "Never probe more often than this"
	default 60
	help
	  The server sets the poll interval; this is a floor under it.

endif
```

## src/Kconfig.link
```kconfig
# Copyright (c) 2026 The Zephyr Project Contributors
# SPDX-License-Identifier: GPL-3.0

menu "Links: one hub, many radios (ATTACHMENT-DESIGN)"

config MESHTASTIC_LINK_CODEC
	bool
	default y if MESHTASTIC_HUB || MESHTASTIC_WORKER || MESHTASTIC_WORKER_RX
	help
	  The envelope a worker and its hub exchange (pure byte packing).
	  Pulled in by anything that speaks it; not a user choice.

config MESHTASTIC_LINK_BEARER
	bool
	default y if MESHTASTIC_LINK_CODEC
	help
	  The board-to-board link between a hub and its workers (ATTACHMENT-SCOPE §4):
	  a registry of bearers -- the BLE peer link, a wire, a test pipe -- each
	  a send and a link_info. Envelopes never see a bearer's types.

config MESHTASTIC_HUB
	bool "This node is a hub: it hears through workers"
	default n
	help
	  Accept link envelopes over the BLE peer link. A worker's RX_FRAME
	  enters the router as an RF frame tagged with the worker's preset and
	  signal; the node's identity, keys, NodeDB and modules stay exactly as
	  they are. Costs a small table (MESHTASTIC_HUB_WORKERS_MAX entries) and
	  8 B per RX queue slot; the code is flash.

config MESHTASTIC_HUB_WORKERS_MAX
	int "Workers a hub tracks (its own radio is not counted)"
	depends on MESHTASTIC_HUB
	default 4
	range 1 8
	help
	  A BLE peer link per worker; the R8 has 3 connection slots in total.

config MESHTASTIC_HUB_EVICT_SEC
	int "Seconds a worker stays in the table after its link went down"
	depends on MESHTASTIC_HUB
	default 180
	range 1 3600
	help
	  A worker whose bearer link dropped keeps its slot (and counters) this long
	  so a reboot or a BLE hiccup re-admits it in place; after that the slot
	  is freed. A worker that speaks again before then is simply up again.

config MESHTASTIC_HUB_ALLOW_MAX
	int "Operator allow-list entries (workers admitted on an untrusted link)"
	depends on MESHTASTIC_HUB
	default 4
	range 1 8

config MESHTASTIC_WORKER
	bool "This node is a keyless worker"
	depends on !MESHTASTIC_HUB
	default n
	help
	  The radio forwards every frame it hears, undecoded, with its RSSI/SNR
	  and preset, to its hub over the peer link (overlay-ble-peer.conf; on
	  native_sim the send is a test seam), and retunes when the hub says
	  so. Transmit for the hub is phase 3. The image carries no channel
	  keys, no PKI, no NodeDB and no config beyond its preset and its hub:
	  build with samples/meshtastic/overlay-worker.conf, whose
	  post-build step refuses an image in which any of those linked
	  (cmake/keyless-assert.cmake). The router is never reached from the
	  radio on a worker; origination is refused at the outbound queue.

config MESHTASTIC_WORKER_HUB_ID
	hex "The hub's node number (0 = set at runtime)"
	depends on MESHTASTIC_WORKER
	default 0
	help
	  Baked-in hub. `meshtastic worker hub <id>` overrides it and the
	  value persists (mtattach/brain) with MESHTASTIC_SETTINGS.

config MESHTASTIC_WORKER_STATUS_PERIOD_SEC
	int "STATUS report period (s)"
	depends on MESHTASTIC_WORKER
	default 60
	range 5 3600

config MESHTASTIC_WORKER_TX_STACK_SIZE
	int "Stack of the worker's transmit thread (bytes)"
	depends on MESHTASTIC_WORKER
	default 2048
	help
	  A transmit blocks for the frame's airtime (and its contention wait),
	  so it runs on its own thread: the forward path -- the RX thread's
	  queue and the work item that writes envelopes to the hub -- must
	  keep draining while the radio is keyed up, or a busy preset overflows
	  the worker's RX queue. Sized like the hub's outbound worker.

config MESHTASTIC_WORKER_TX_QUEUE_SIZE
	int "Frames the hub has handed this worker, waiting to key up"
	depends on MESHTASTIC_WORKER
	default 4
	range 1 16
	help
	  TX_FRAMEs accepted from the hub and not yet transmitted. A full queue
	  refuses the envelope (counted; the hub sees no TX_RESULT). Each entry
	  is a full airframe.

config MESHTASTIC_WORKER_QUEUE_SIZE
	int "Frames queued for the hub"
	depends on MESHTASTIC_WORKER
	default 4
	range 1 16
	help
	  Between the RX thread and the forwarding work item. ~260 B each.

endmenu
```

## src/Kconfig.pki
```kconfig
# Copyright (c) 2026 The Zephyr Project Contributors
# SPDX-License-Identifier: GPL-3.0

config MESHTASTIC_PKI
	bool "PKC for direct messages (Curve25519/X25519 + AES-CCM)"
	depends on MESHTASTIC_NODEDB && MESHTASTIC_SETTINGS
	help
	  Implements Meshtastic public-key cryptography for direct messages,
	  interoperable with the reference firmware: an X25519 keypair (generated
	  once, persisted in the SecurityConfig NVS partition — survives reboot and
	  reflash), advertised via User.public_key, with AES-256-CCM DM
	  encrypt/decrypt (key = SHA256(ECDH shared secret)). Fixes both the
	  "PKI send failed, no public key" a peer sees and the NO_CHANNEL a peer
	  returns for our PSK-only DMs.

	  Requires PSA crypto: ECDH + ECC Montgomery-255 (key pair
	  generate/import/export + public key), AES, CCM and SHA-256. On the net
	  build the ECC/AES/SHA pieces come from the TLS overlay; the overlay adds
	  PSA_WANT_ALG_CCM.

config MESHTASTIC_PKI_SECRET_CACHE
	int "Peers whose derived PKC key is kept"
	depends on MESHTASTIC_PKI
	range 0 32
	default 8 if SOC_SERIES_NRF52X
	default 10
	help
	  Every PKC frame needs SHA256(X25519(our private key, the peer's
	  public key)), and a direct message needs it three times for the same
	  peer (its decrypt, our ACK's encrypt, the decrypt of the ACK the
	  sender returns). Without a cache each is a full X25519: 115 ms on the
	  ESP32-S3 with PSA's software ECDH, on the mesh thread. This keeps the
	  derived keys of the most recently used peers, matched on the whole
	  public key, as the reference does since 2.8 (CryptoEngine
	  setCryptoSharedSecret: 10 entries, 8 on nRF52). 68 bytes each.
	  Emptied whenever our own keypair is (re)loaded. 0 derives every time.

config MESHTASTIC_NODE_ID_FROM_KEY
	bool "Derive the node ID from the identity public key (reference >= 2.8)"
	depends on MESHTASTIC_PKI
	select CRC
	help
	  Use crc32(X25519 public key) as the node ID, as the reference firmware
	  has since 2.8 (NodeDB::createNewIdentity, shipped with packet signing).
	  The id then commits to the key: nobody can claim an id without also
	  holding the key it was derived from, which is what makes trusting a
	  stranger's first signed NodeInfo safe.

	  MESHTASTIC_NODE_ID_SOURCE still supplies the PROVISIONAL id, used only
	  when no key is readable and none was stored. The adopted id is kept in
	  the unsealed "mtid" settings record so a lockdown-locked boot, which
	  cannot read the keypair, keeps the same id.

	  Turning this on CHANGES the id of an existing node once, on its first
	  boot, and every peer then holds the node under both ids until the old
	  entry is forgotten or ages out (the reference does the same). Keys do
	  not change, so the new id is predictable before flashing, and turning
	  it off again returns the node to its hardware id.
```

## src/Kconfig.sparkplug
```kconfig
# SPDX-FileCopyrightText: Adam Roper
# SPDX-License-Identifier: GPL-3.0

config MESHTASTIC_SPARKPLUG_SESSION
	bool "Sparkplug B session core (no network; the gateway's and the tests')"
	help
	  The Sparkplug B 3.0 Edge Node logic of the mesh gateway: births, deaths, data by
	  exception, sequence numbers, rebirth requests, with the nodes heard as Devices.
	  It publishes through a function the caller gives it; MESHTASTIC_SPARKPLUG is that
	  caller on a networked image. On its own it is what the sparkplug test suite builds.

config MESHTASTIC_SPARKPLUG
	bool "Mesh gateway as a Sparkplug B Edge Node over MQTT"
	depends on NETWORKING && NET_SOCKETS && MQTT_LIB && MESHTASTIC_NODEDB
	select MESHTASTIC_SPARKPLUG_SESSION
	help
	  Publish the nodes this gateway hears to an MQTT broker as Sparkplug B Devices
	  (spBv1.0/<group>/.../<edge>/<node id>): names, hardware, role, SNR, hops, channel,
	  when last heard, position. A node not heard for MESHTASTIC_SPARKPLUG_DEATH_SEC gets a
	  DDEATH. Its own MQTT connection, whose Will is the Edge Node's NDEATH; bdSeq is kept in
	  settings. Telemetry only: no command is acted on but a rebirth request, and nothing is
	  ever forwarded into the mesh. A planned reboot (admin, lockdown, `intents clear`) ends
	  the session first with the NDEATH and an MQTT DISCONNECT; `sparkplug stop` / `start` do
	  the same by hand.

if MESHTASTIC_SPARKPLUG_SESSION

config MESHTASTIC_SPARKPLUG_MAX_DEVICES
	int "Nodes reported at once"
	default 32

config MESHTASTIC_SPARKPLUG_BUF_SIZE
	int "Encoded payload buffer"
	default 1024

endif

if MESHTASTIC_SPARKPLUG

config MESHTASTIC_SPARKPLUG_BROKER
	string "MQTT broker host"
	default "127.0.0.1"
	help
	  The default. Broker, port, group, edge id and the MQTT login (user, password) are
	  settings: `sparkplug set|unset <key>` changes one at runtime, saves it, and reconnects.
	  Use the edge id as the username where the broker gives each Edge Node its own login.

config MESHTASTIC_SPARKPLUG_PORT
	int "MQTT broker port"
	default 1883

config MESHTASTIC_SPARKPLUG_GROUP
	string "Sparkplug group id"
	default "bench"

config MESHTASTIC_SPARKPLUG_EDGE
	string "Sparkplug edge node id (empty: gw-<node id>)"
	default ""

config MESHTASTIC_SPARKPLUG_INTERVAL_SEC
	int "Seconds between NodeDB snapshots"
	default 10

config MESHTASTIC_SPARKPLUG_DEATH_SEC
	int "A node not heard for this long gets a DDEATH"
	default 900

config MESHTASTIC_SPARKPLUG_STACK_SIZE
	int "Sparkplug thread stack size"
	default 4096

config MESHTASTIC_SPARKPLUG_PRIORITY
	int "Sparkplug thread priority"
	default 12

endif

config MESHTASTIC_SIM_RADIO_SHELL
	bool "Shell: make the simulated radio hear made-up peers (native_sim)"
	depends on LORA_SIM && SHELL
	help
	  `simradio nodeinfo <from> <long> <short> [snr]` and `simradio text <from> <text>
	  [snr]` build a frame from a peer and inject it into the simulated LoRa driver, so it
	  takes the real receive path. For simulated benches, where boards cannot hear each
	  other; never on hardware.
```

## src/Kconfig.text_inbox
```kconfig
# Copyright (c) 2026 The Zephyr Project Contributors
# SPDX-License-Identifier: GPL-3.0

menuconfig MESHTASTIC_TEXT_INBOX
	bool "Keep the last text messages this node received"
	help
	  A small RAM ring of the text messages (TEXT_MESSAGE_APP, port 1)
	  delivered to this node, addressed to it or broadcast, with who sent
	  each, where it was going, the channel it was filed under, the radio
	  and preset it was heard on, its signal, its hops, whether it came as
	  a PKC direct message, and the text. `meshtastic text inbox` lists them
	  on the shell, newest first.

	  For a console and for tests: without a phone attached a node has no
	  other way to say what it received. Nothing is persisted, and the ring
	  is not the phone's message history (the phone still gets every
	  message through the PhoneAPI as before).

if MESHTASTIC_TEXT_INBOX

config MESHTASTIC_TEXT_INBOX_ENTRIES
	int "Messages kept"
	default 8
	range 1 32
	help
	  The newest this many are kept; a new one replaces the oldest.

config MESHTASTIC_TEXT_INBOX_TEXT_LEN
	int "Bytes of each message's text kept"
	default 200
	range 16 233
	help
	  A longer text is cut to this many bytes and marked truncated. 200 is
	  the reference clients' limit for a message they send.

endif # MESHTASTIC_TEXT_INBOX
```
