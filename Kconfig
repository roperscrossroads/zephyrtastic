## Kconfig
```kconfig
# SPDX-License-Identifier: GPL-3.0

rsource "src/Kconfig"
rsource "drivers/lora_sim/Kconfig"
```

## boards/seeed/sensecap_indicator_d1l/Kconfig
```kconfig
# SPDX-License-Identifier: Apache-2.0

config HEAP_MEM_POOL_ADD_SIZE_BOARD
	int
	default 4096 if BOARD_SENSECAP_INDICATOR_D1L_ESP32S3_PROCPU
	default 256 if BOARD_SENSECAP_INDICATOR_D1L_ESP32S3_APPCPU
```

## boards/shields/wio_sx1262_xiao/Kconfig.shield
```kconfig
# SPDX-License-Identifier: Apache-2.0

config SHIELD_WIO_SX1262_XIAO
	def_bool $(shields_list_contains,wio_sx1262_xiao)
```

## drivers/lora_sim/Kconfig
```kconfig
# SPDX-License-Identifier: GPL-3.0

config LORA_SIM
	bool "Simulated LoRa transceiver for native_sim"
	default y
	depends on DT_HAS_MESHTASTIC_LORA_SIM_ENABLED
	depends on LORA
	help
	  Fake LoRa driver for native_sim. Transmitted frames are captured in a
	  queue a test drains (lora_sim_take_tx); tests inject received frames
	  (lora_sim_inject). Per-frame airtime is computed with the same math as
	  the SX126x driver and the channel is modelled busy for that airtime, so
	  duty-cycle / contention / flood-dedup behaviour of the real stack runs
	  under twister with no radio hardware.

if LORA_SIM

config LORA_SIM_TX_QUEUE_DEPTH
	int "Captured-TX queue depth"
	default 16
	range 1 256
	help
	  Maximum number of transmitted frames buffered for a test to drain.

endif # LORA_SIM
```
