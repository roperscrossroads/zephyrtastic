## CMakeLists.txt
```
cmake_minimum_required(VERSION 3.20.0)

find_package(Zephyr REQUIRED HINTS $ENV{ZEPHYR_BASE})
project(meshtastic_battery_tests)

target_include_directories(app PRIVATE
  ${CMAKE_CURRENT_SOURCE_DIR}/../../src
  ${CMAKE_CURRENT_SOURCE_DIR}/..
  ${CMAKE_BINARY_DIR}/modules/meshtastic-zephyr/src
  ${CMAKE_BINARY_DIR}/modules/meshtastic-zephyr/src/proto
)

target_sources(app PRIVATE src/main.c)
```

## prj.conf
```kconfig
CONFIG_ZTEST=y

CONFIG_MESHTASTIC=y
CONFIG_MESHTASTIC_SETTINGS=n
CONFIG_MESHTASTIC_BLE=n
CONFIG_MESHTASTIC_SERIAL=n
CONFIG_MESHTASTIC_SHELL=n
CONFIG_MESHTASTIC_PHONEAPI=n

# The unit under test. Selects ADC; the emulated controller and the vbatt
# voltage-divider node both come from the board overlay. HAS_POWEROFF does not
# exist on native_sim, so CONFIG_MESHTASTIC_BATTERY_CUTOFF cannot be selected
# here -- this suite covers the read path only (millivolts/percent/present/
# external_power), not the low-voltage cutoff state machine. See
# meshtastic_battery_cutoff.h's own test suite for that.
CONFIG_MESHTASTIC_BATTERY=y

# Pulls in meshtastic_metrics.c so collect_battery_divider()'s telemetry mapping
# (battery_level 0-100, or the upstream-parity 101 "powered" sentinel) is tested
# against the SAME emulated divider as the read-path tests above, not asserted
# separately from a differently-configured build.
CONFIG_MESHTASTIC_DEVICE_METRICS=y

CONFIG_ADC=y
CONFIG_ADC_EMUL=y

CONFIG_MAIN_STACK_SIZE=4096
```

## boards/native_sim_native_64.overlay
```dts
/* SPDX-License-Identifier: GPL-3.0 */
/*
 * A vbatt voltage-divider node identical in shape to the Heltec V4-R8's (no
 * power-gpios -- the R8's divider is ungated, same as this test setup), backed
 * by native_sim's built-in emulated ADC controller (adc0, zephyr,adc-emul)
 * instead of a real Espressif SAR ADC. meshtastic_battery.c's real
 * implementation -- not a reimplementation of it -- compiles and runs against
 * this: the module's `#if DT_NODE_EXISTS(DT_NODELABEL(vbatt))` guard means
 * WITHOUT this overlay only the "no vbatt node" stub compiles, and there is
 * nothing to test. Same channel config as the real board
 * (heltec_wifi_lora32_v4-common.dtsi's &adc0 node): ADC_GAIN_4_5,
 * ADC_REF_INTERNAL, 12-bit.
 */
#include <zephyr/dt-bindings/adc/adc.h>

/ {
	vbatt: vbatt {
		compatible = "voltage-divider";
		io-channels = <&adc0 0>;
		output-ohms = <100000>;
		full-ohms = <(100000 + 390000)>;
	};
};

&adc0 {
	ref-internal-mv = <3300>;
	#address-cells = <1>;
	#size-cells = <0>;

	channel@0 {
		reg = <0>;
		zephyr,gain = "ADC_GAIN_4_5";
		zephyr,reference = "ADC_REF_INTERNAL";
		zephyr,acquisition-time = <ADC_ACQ_TIME_DEFAULT>;
		zephyr,resolution = <12>;
	};
};
```

## src/main.c
```c
/* SPDX-License-Identifier: GPL-3.0 */
/*
 * Battery divider read-path tests (agents-wu94.1).
 *
 * meshtastic_battery.c had ZERO automated coverage before this suite (noted in
 * docs/power-and-battery/BATTERY-STATUS.md as one of the reasons the whole
 * arc sat unmerged for a month). Drives the module's REAL implementation --
 * not a reimplementation of it -- against native_sim's emulated ADC
 * (zephyr,adc-emul), wired up via a `vbatt` voltage-divider node in the board
 * overlay with the same channel config (ADC_GAIN_4_5 / ADC_REF_INTERNAL /
 * 12-bit) as the real Heltec V4/V4-R8 board file.
 *
 * Out of scope here: the low-voltage cutoff state machine
 * (CONFIG_MESHTASTIC_BATTERY_CUTOFF). It depends on HAS_POWEROFF, which
 * native_sim does not have, so it cannot even be selected in this image. Its
 * pure decision logic is covered separately by main/tests/battery_cutoff,
 * which has no ADC or poweroff dependency at all.
 *
 * Expected values are computed with the SAME integer arithmetic
 * meshtastic_battery_millivolts() uses (pin_mv * full_ohms / output_ohms,
 * then * CAL_PERMILLE / 1000, both truncating), not floating point, so a
 * changed rounding behaviour shows up as a real assertion failure rather
 * than being absorbed by an overly generous tolerance. A small epsilon still
 * covers the ADC emulator's own raw<->mV round-trip through its resolution.
 */
#include <zephyr/device.h>
#include <zephyr/drivers/adc.h>
#include <zephyr/drivers/adc/adc_emul.h>
#include <zephyr/kernel.h>
#include <zephyr/ztest.h>

#include "meshtastic_battery.h"
#include "meshtastic_telemetry_internal.h"

/* Real Heltec V4 divider: 390k upper / 100k lower -> full/output = 4.9. */
#define DIVIDER_FULL_OHMS   490000
#define DIVIDER_OUTPUT_OHMS 100000

/* Default CAL_PERMILLE (Kconfig default, no R8 override applies on
 * native_sim -- there is no board-specific defconfig for a host arch).
 * Measured against a real cell 2026-09-07, see src/Kconfig.battery. */
#define CAL_PERMILLE 1030

/* meshtastic_battery.c's own BATTERY_CACHE_MS. Not exposed via the header
 * (it is a read-path implementation detail, not part of the module's
 * contract), so this is a second source of truth that has to be kept in step
 * by hand if that constant ever moves -- same tradeoff the GNSS suite makes
 * with EMUL_FIX_INTERVAL_MS. */
#define CACHE_MS 5000

/* ADC round-trip tolerance (emulator quantization at 12-bit resolution,
 * compounded through two integer-truncating multiply/divide stages). */
#define MV_EPS 40

static const struct device *adc_dev;

static void *battery_suite_setup(void)
{
	adc_dev = DEVICE_DT_GET(DT_NODELABEL(adc0));
	zassert_true(device_is_ready(adc_dev), "emulated ADC not ready");
	return NULL;
}

/* Sets the pin voltage (post-divider, at the ADC input -- what a multimeter
 * at GPIO1 would read) and waits past the read cache so the next call to
 * meshtastic_battery_millivolts() takes a fresh sample rather than returning
 * whatever the previous test case cached. */
static void set_pin_mv_and_wait(int pin_mv)
{
	int ret = adc_emul_const_value_set(adc_dev, 0, (uint32_t)pin_mv);

	zassert_ok(ret, "adc_emul_const_value_set(%d) failed: %d", pin_mv, ret);
	k_sleep(K_MSEC(CACHE_MS + 200));
}

/* Same integer arithmetic as meshtastic_battery_millivolts(): scale by the
 * divider ratio, then apply CAL_PERMILLE, both truncating. */
static int expected_final_mv(int pin_mv)
{
	int32_t scaled = (int32_t)((int64_t)pin_mv * DIVIDER_FULL_OHMS / DIVIDER_OUTPUT_OHMS);

	return (int32_t)((int64_t)scaled * CAL_PERMILLE / 1000);
}

ZTEST_SUITE(meshtastic_battery, NULL, battery_suite_setup, NULL, NULL, NULL);

ZTEST(meshtastic_battery, test_reads_scaled_voltage)
{
	/* Comfortably mid-curve: not near either threshold, so this is purely a
	 * scaling-math check. */
	const int pin_mv = 742;
	const int expected = expected_final_mv(pin_mv);
	int mv;

	set_pin_mv_and_wait(pin_mv);

	mv = meshtastic_battery_millivolts();
	zassert_within(mv, expected, MV_EPS, "got %d mV, expected ~%d mV", mv, expected);
	zassert_true(meshtastic_battery_present(), "a mid-curve reading must count as present");
	zassert_false(meshtastic_battery_external_power(), "mid-curve is not charging");
	zassert_false(meshtastic_battery_is_critical(),
		      "cutoff is compiled out on native_sim; must never report critical");
}

ZTEST(meshtastic_battery, test_top_of_curve_is_100_percent)
{
	/* Comfortably above the OCV table's top entry (4190 mV) -- comfortably
	 * meaning well clear of the emulated ADC's own quantization noise (see
	 * MV_EPS), not merely above 4190 on paper. The real gap between "top of
	 * the resting curve" and "charge-termination threshold" (4200 mV) is
	 * only 10 mV, too narrow to also assert not-charging here without
	 * flaking on ADC noise; that boundary gets its own test below instead. */
	const int pin_mv = 850;

	set_pin_mv_and_wait(pin_mv);

	zassert_equal(meshtastic_battery_percent(), 100, "at/above the curve's top is 100%%");
}

ZTEST(meshtastic_battery, test_above_charge_termination_reads_external_power)
{
	/* Above OCV_max + 10 mV: nothing can rest there, so this is the port's
	 * only "is something charging this" signal (see meshtastic_battery.c's
	 * top-of-file comment on why that's the only signal available at all).
	 * 870, not 840: at the post-2026-09-07 CAL_PERMILLE (1030, down from
	 * 1045), 840 clears the 4200 mV threshold by only ~40 mV -- exactly
	 * MV_EPS, too tight to trust against the emulator's own noise. */
	const int pin_mv = 870;

	set_pin_mv_and_wait(pin_mv);

	zassert_true(meshtastic_battery_external_power(),
		     "above the charge-termination voltage must read as charging");
	zassert_true(meshtastic_battery_present(), "still a valid, present reading");
}

ZTEST(meshtastic_battery, test_bottom_of_curve_is_0_percent_not_absent)
{
	/* Below the OCV table's last entry (3100 mV) but well above the
	 * "no battery" floor (2600 mV): a genuinely flat-but-fitted cell, which
	 * must read 0%, not "absent". */
	const int pin_mv = 605;

	set_pin_mv_and_wait(pin_mv);

	zassert_true(meshtastic_battery_present(), "still above the no-battery floor");
	zassert_equal(meshtastic_battery_percent(), 0, "below the curve's bottom clamps to 0%%");
}

ZTEST(meshtastic_battery, test_below_floor_reads_absent_not_a_bad_percent)
{
	/* Below the ~2600 mV no-battery floor: what a USB-powered board with an
	 * empty JST reads. millivolts() still reports the real divider voltage
	 * (nothing gates that) -- only present()/percent() treat it specially,
	 * because a mains node must never be penalised as if it had a dying cell. */
	const int pin_mv = 390;
	const int expected = expected_final_mv(pin_mv);
	int mv;

	set_pin_mv_and_wait(pin_mv);

	mv = meshtastic_battery_millivolts();
	zassert_within(mv, expected, MV_EPS, "got %d mV, expected ~%d mV", mv, expected);
	zassert_false(meshtastic_battery_present(), "below the floor must read as no battery");
	zassert_equal(meshtastic_battery_percent(), -1, "no battery has no percentage");
	zassert_false(meshtastic_battery_external_power(), "an absent reading is not 'charging'");
}

ZTEST(meshtastic_battery, test_cache_holds_then_refreshes)
{
	const int pin_a = 742;
	const int pin_b = 390;
	const int expected_a = expected_final_mv(pin_a);
	const int expected_b = expected_final_mv(pin_b);
	int mv;

	/* Populate the cache with a known reading. */
	set_pin_mv_and_wait(pin_a);
	mv = meshtastic_battery_millivolts();
	zassert_within(mv, expected_a, MV_EPS, "initial sample: got %d, expected ~%d", mv,
		       expected_a);

	/* Change the input, but read again immediately -- inside the cache
	 * window, this MUST still return the stale value. If a caller could see
	 * a fresh sample here, two racing callers (see the module's own comment
	 * on why this matters) could observe the pin mid-transition instead of a
	 * single consistent reading. */
	zassert_ok(adc_emul_const_value_set(adc_dev, 0, (uint32_t)pin_b));
	mv = meshtastic_battery_millivolts();
	zassert_within(mv, expected_a, MV_EPS,
		       "read inside the cache window returned %d, expected the STALE ~%d", mv,
		       expected_a);

	/* Past the cache window, the next read must reflect the new input. */
	k_sleep(K_MSEC(CACHE_MS + 200));
	mv = meshtastic_battery_millivolts();
	zassert_within(mv, expected_b, MV_EPS,
		       "read past the cache window returned %d, expected the fresh ~%d", mv,
		       expected_b);
}

/*
 * Upstream parity (PowerStatus.h / DeviceTelemetry.cpp): the wire-level
 * battery_level field reports the "101 = powered" sentinel whenever there is
 * no battery OR the pack is charging, and only reports a real 0-100 percent
 * when a battery is present and NOT charging. collect_battery_divider() is
 * the only thing standing between our real ADC reading and that field, so
 * these three cases exercise it end to end -- not a reimplementation of the
 * mapping, the actual meshtastic_collect_device_metrics() call.
 */
ZTEST(meshtastic_battery, test_device_metrics_reports_real_percent_on_battery)
{
	const int pin_mv = 742;
	meshtastic_DeviceMetrics m;

	set_pin_mv_and_wait(pin_mv);

	zassert_ok(meshtastic_collect_device_metrics(&m), "collect must succeed");
	zassert_true(m.has_battery_level, "a present, non-charging battery must report a level");
	zassert_equal(m.battery_level, (uint32_t)meshtastic_battery_percent(),
		      "battery_level must be the real percent, not the powered sentinel");
	zassert_true(m.battery_level <= 100U, "a real percent must never reach the 101 sentinel");
	zassert_true(m.has_voltage, "a present battery must report its voltage");
}

ZTEST(meshtastic_battery, test_device_metrics_reports_powered_sentinel_when_charging)
{
	const int pin_mv = 870; /* above charge-termination -- see the external_power test above */
	meshtastic_DeviceMetrics m;

	set_pin_mv_and_wait(pin_mv);
	zassert_true(meshtastic_battery_external_power(), "test setup: must be in the charging range");

	zassert_ok(meshtastic_collect_device_metrics(&m), "collect must succeed");
	zassert_true(m.has_battery_level, "battery_level must be present, not omitted");
	zassert_equal(m.battery_level, 101U,
		      "a charging battery must report 101 (powered), got %u -- upstream reports "
		      "the same sentinel for hasBattery && isCharging, not just !hasBattery",
		      (unsigned int)m.battery_level);
	zassert_true(m.has_voltage,
		     "upstream still reports voltage while charging (hasBattery is true) -- "
		     "only the percent is replaced by the sentinel, not the reading");
}

ZTEST(meshtastic_battery, test_device_metrics_reports_powered_sentinel_when_no_battery)
{
	const int pin_mv = 390; /* below the no-battery floor -- see the absent test above */
	meshtastic_DeviceMetrics m;

	set_pin_mv_and_wait(pin_mv);
	zassert_false(meshtastic_battery_present(), "test setup: must read as no battery fitted");

	zassert_ok(meshtastic_collect_device_metrics(&m), "collect must succeed");
	zassert_true(m.has_battery_level, "battery_level must be present, not omitted");
	zassert_equal(m.battery_level, 101U,
		      "no battery fitted must report 101 (powered), got %u",
		      (unsigned int)m.battery_level);
	zassert_false(m.has_voltage,
		      "with no battery fitted, voltage must stay unset -- not a phantom reading "
		      "of whatever the floating/USB-only divider happens to read");
}
```
