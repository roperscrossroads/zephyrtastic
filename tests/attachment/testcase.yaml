## tests/ble_peer/testcase.yaml
```yaml
common:
  tags:
    - meshtastic
    - ble
    - native_sim
  integration_platforms:
    - native_sim/native/64
  platform_allow:
    - native_sim/native/64
tests:
  meshtastic.ble_peer.native_sim: {}
```

## tests/common/fake_hci/dts/bindings/zephyr,bt-hci-fake.yaml
```yaml
description: |
  Fake Bluetooth LE controller for native_sim tests (tests/common/fake_hci).
  Answers the host's HCI commands from a small state model instead of a radio.

compatible: "zephyr,bt-hci-fake"

include: bt-hci.yaml

properties:
  bt-hci-name:
    default: "fake"
  bt-hci-bus:
    default: "virtual"
  bt-hci-quirks:
    default: ["no-reset"]
```

## tests/phonelog/testcase.yaml
```yaml
common:
  tags:
    - meshtastic
    - phonelog
    - native_sim
  integration_platforms:
    - native_sim/native/64
  platform_allow:
    - native_sim/native/64
tests:
  meshtastic.phonelog.native_sim: {}
```

## tests/reboot_trace/testcase.yaml
```yaml
common:
  tags:
    - meshtastic
    - reboot_trace
    - native_sim
  integration_platforms:
    - native_sim/native/64
  platform_allow:
    - native_sim/native/64
tests:
  meshtastic.reboot_trace.native_sim: {}
```
