## tests/sx126x_busy/testcase.yaml
```yaml
common:
  tags:
    - meshtastic
    - sx126x_busy
    - native_sim
  integration_platforms:
    - native_sim/native/64
  platform_allow:
    - native_sim/native/64
tests:
  meshtastic.sx126x_busy.native_sim: {}
```

## tests/xeddsa/testcase.yaml
```yaml
common:
  extra_conf_files:
    - ../common/pki-psa.conf
  tags:
    - meshtastic
    - xeddsa
    - crypto
    - native_sim
  integration_platforms:
    - native_sim/native/64
  platform_allow:
    - native_sim/native/64
tests:
  meshtastic.xeddsa.native_sim: {}
```
