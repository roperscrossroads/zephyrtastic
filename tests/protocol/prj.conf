## CMakeLists.txt
```
cmake_minimum_required(VERSION 3.20.0)

find_package(Zephyr REQUIRED HINTS $ENV{ZEPHYR_BASE})
project(meshtastic_protocol_tests)

target_include_directories(app PRIVATE
  ${CMAKE_CURRENT_SOURCE_DIR}/../../src
  ${CMAKE_CURRENT_SOURCE_DIR}/..
  ${CMAKE_BINARY_DIR}/modules/meshtastic-zephyr/src
  ${CMAKE_BINARY_DIR}/modules/meshtastic-zephyr/src/proto
)

target_sources(app PRIVATE src/main.c src/sched.c src/phonequeue.c src/vectors.c src/channels.c src/txpower.c)
```

## prj.conf
```kconfig
CONFIG_ZTEST=y

CONFIG_MESHTASTIC=y
CONFIG_MESHTASTIC_PHONEAPI=y
# A stream client's contact timeout short enough to test (phonequeue.c); upstream is 900 s.
CONFIG_MESHTASTIC_PHONEAPI_CONTACT_TIMEOUT_S=2
CONFIG_MESHTASTIC_SETTINGS=n
CONFIG_MESHTASTIC_BLE=n
CONFIG_MESHTASTIC_SERIAL=n
CONFIG_MESHTASTIC_SHELL=n
CONFIG_MESHTASTIC_GNSS=n
CONFIG_MESHTASTIC_DEVICE_METRICS=n
CONFIG_MESHTASTIC_ENVIRONMENT_METRICS=n
CONFIG_MESHTASTIC_NODEDB=y

CONFIG_MAIN_STACK_SIZE=4096

# Clock persistence, against native_sim's counter (see the board overlay).
#
# Set EXPLICITLY, not left to the Kconfig default: the default is n until the
# feature has been brought up on hardware, and a test that inherits a default is
# a test that silently stops running when the default moves. It did exactly that
# once — the coverage vanished the moment the default flipped, and the suite
# stayed green.
CONFIG_MESHTASTIC_CLOCK_PERSIST=y
# Set explicitly, not inherited: the skew tests below assert against
# MIN_WINDOW_S and MAX_PPM, and a test that rides a default stops testing
# the moment the default moves — silently, with the suite still green.
CONFIG_MESHTASTIC_CLOCK_SKEW=y
CONFIG_MESHTASTIC_CLOCK_SKEW_MIN_WINDOW_S=3600
CONFIG_MESHTASTIC_CLOCK_SKEW_MAX_PPM=100
CONFIG_COUNTER=y
CONFIG_COUNTER_NATIVE_SIM=y
CONFIG_MESHTASTIC_BOOTLOG=y
```

## boards/native_sim_native_64.overlay
```dts
/* SPDX-License-Identifier: GPL-3.0 */
/*
 * A counter for the clock-persistence module to measure downtime against.
 *
 * Without a meshtastic,persist-counter chosen the module compiles out entirely,
 * and a module that compiles out is a module with no tests — which is exactly
 * how a configuration reaches the bench having never been built. native_sim
 * ships a counter; pointing the chosen at it brings the decision logic under
 * test, even though nothing here survives a reset (there is no reset to
 * survive, so the boot path reports a cold start and the tests drive the
 * decision through its seam instead).
 */
/ {
	chosen {
		meshtastic,persist-counter = &counter0;
	};
};

&counter0 {
	status = "okay";
};
```

## src/channels.c
```c
/* Channel key-resolution regression tests.
 *
 * SPDX-License-Identifier: GPL-3.0
 */

#include <zephyr/ztest.h>
#include <string.h>

#include "meshtastic_channels.h"

static void channels_before(void *fixture)
{
	ARG_UNUSED(fixture);
	meshtastic_channels_init_defaults();
}

/* An empty-PSK SECONDARY borrows the primary's key. If the primary slot is
 * itself marked SECONDARY, that borrow points at its own index and recurses
 * forever -- nothing enforces that channel_slots[primary_index] has role
 * PRIMARY. Reachable from meshtastic_channels_set_slot(), i.e. from the admin
 * set_channel path, so a peer that can set a channel can wedge the node.
 *
 * Note on failure mode: a regression here HANGS rather than failing, because
 * the recursive call is in tail position and the compiler turns it into an
 * infinite loop instead of blowing the stack. Detecting it cleanly in-process
 * would mean adding a depth counter to production code purely for testability,
 * which is not worth it -- twister's per-suite timeout catches the hang.
 * Reaching the assertions below at all is the real signal.
 */
ZTEST(channels, test_secondary_at_primary_index_does_not_recurse)
{
	meshtastic_Channel ch = meshtastic_Channel_init_zero;
	struct meshtastic_channel_key key;

	/* Slot 0 is primary_index after init_defaults(). Installing a SECONDARY
	 * there leaves primary_index pointing at a non-PRIMARY slot -- set_slot
	 * only reassigns primary_index when the incoming role IS primary.
	 */
	ch.role = meshtastic_Channel_Role_SECONDARY;
	ch.has_settings = true;
	ch.settings.psk.size = 0;
	strncpy(ch.settings.name, "selfref", sizeof(ch.settings.name) - 1U);

	zassert_ok(meshtastic_channels_set_slot(0, &ch),
		   "set_slot must return rather than recurse");

	zassert_equal(meshtastic_channels_primary_index(), 0,
		      "precondition: slot 0 is still primary_index");

	/* The self-referential borrow resolves to cleartext, matching a PRIMARY
	 * with an empty PSK, rather than looping.
	 */
	zassert_ok(meshtastic_channels_primary_key(&key),
		   "primary_key must return rather than recurse");
	zassert_equal(key.len, 0, "self-referential secondary resolves to cleartext");
}

/* The legitimate borrow must keep working: a SECONDARY at a different index
 * with no PSK still inherits the primary's key.
 */
ZTEST(channels, test_secondary_borrows_primary_key)
{
	meshtastic_Channel ch = meshtastic_Channel_init_zero;
	struct meshtastic_channel_key primary, borrowed;

	zassert_ok(meshtastic_channels_primary_key(&primary), "primary key unavailable");
	zassert_true(primary.len > 0, "default primary should carry a key");

	ch.role = meshtastic_Channel_Role_SECONDARY;
	ch.has_settings = true;
	ch.settings.psk.size = 0;
	strncpy(ch.settings.name, "borrower", sizeof(ch.settings.name) - 1U);
	zassert_ok(meshtastic_channels_set_slot(1, &ch), "set_slot failed");

	zassert_ok(meshtastic_channels_get_key(1, &borrowed), "get_key failed");
	zassert_equal(borrowed.len, primary.len, "borrowed key length differs");
	zassert_mem_equal(borrowed.bytes, primary.bytes, primary.len,
			  "secondary did not inherit the primary key");
}

ZTEST_SUITE(channels, NULL, NULL, channels_before, NULL, NULL);
```

## src/phonequeue.c
```c
/* SPDX-License-Identifier: GPL-3.0
 *
 * Phone FromRadio queue selective-eviction tests.
 *
 * Exercises meshtastic_phoneapi_enqueue_fromradio() under a saturated queue for
 * both phone.evict policies:
 *   - protect     : text/routing/admin frames survive a burst of droppable
 *                   position/telemetry/nodeinfo frames (finding C).
 *   - drop-oldest : legacy strict-oldest eviction.
 *
 * The queue holds encoded FromRadio bytes, so surviving frames are decoded back
 * with nanopb to check *which* portnum survived, not merely how many.
 */

#include <string.h>

#include <zephyr/kernel.h>
#include <zephyr/ztest.h>

#include <pb_decode.h>
#include "meshtastic/mesh.pb.h"

#include "meshtastic_phoneapi.h"
#include "meshtastic_sched.h"

#define Q_SIZE 4U

static struct meshtastic_phoneapi_frame q_storage[Q_SIZE];
static struct meshtastic_phoneapi api;
static meshtastic_ToRadio to_scratch;
static meshtastic_FromRadio from_scratch;

static void phonequeue_before(void *fixture)
{
	ARG_UNUSED(fixture);
	meshtastic_sched_defaults();
	meshtastic_sched_stats_reset();
	meshtastic_phoneapi_init(&api, "test", q_storage, Q_SIZE, NULL, NULL, NULL, NULL,
				 &to_scratch, &from_scratch);
	/* These cases are a connected phone's eviction policy: its client has started the
	 * API, as want_config does. The no-reader cases below say otherwise themselves. */
	meshtastic_phoneapi_session_start(&api);
}

/* Build a FromRadio carrying a decoded MeshPacket on the given portnum. `id`
 * lands in packet.id so a decode can identify the survivor. */
static meshtastic_FromRadio make_pkt(uint32_t id, meshtastic_PortNum portnum)
{
	meshtastic_FromRadio from = meshtastic_FromRadio_init_zero;

	from.which_payload_variant = meshtastic_FromRadio_packet_tag;
	from.packet.id = id;
	from.packet.which_payload_variant = meshtastic_MeshPacket_decoded_tag;
	from.packet.decoded.portnum = portnum;
	from.packet.decoded.payload.size = 1U;
	from.packet.decoded.payload.bytes[0] = (uint8_t)id;
	return from;
}

/* A FromRadio carrying a log record — the cheapest thing above a queue status. */
static meshtastic_FromRadio make_log(const char *msg)
{
	meshtastic_FromRadio from = meshtastic_FromRadio_init_zero;

	from.which_payload_variant = meshtastic_FromRadio_log_record_tag;
	strncpy(from.log_record.message, msg, sizeof(from.log_record.message) - 1U);
	from.log_record.level = meshtastic_LogRecord_Level_INFO;
	return from;
}

/* A FromRadio carrying a queue status — the most replaceable frame there is,
 * since the next one supersedes it outright. */
static meshtastic_FromRadio make_status(void)
{
	meshtastic_FromRadio from = meshtastic_FromRadio_init_zero;

	from.which_payload_variant = meshtastic_FromRadio_queueStatus_tag;
	from.queueStatus.free = 1U;
	return from;
}

/* Decode a popped frame and return its packet portnum (or -1 if not a packet). */
static int frame_portnum(const struct meshtastic_phoneapi_frame *f)
{
	meshtastic_FromRadio from = meshtastic_FromRadio_init_zero;
	pb_istream_t stream = pb_istream_from_buffer(f->data, f->len);

	if (!pb_decode(&stream, meshtastic_FromRadio_fields, &from)) {
		return -1;
	}
	if (from.which_payload_variant != meshtastic_FromRadio_packet_tag) {
		return -1;
	}
	return (int)from.packet.decoded.portnum;
}

/* Count surviving frames of a given portnum by draining the queue. */
static uint8_t drain_count_portnum(int portnum)
{
	struct meshtastic_phoneapi_frame f;
	uint8_t n = 0;

	while (meshtastic_phoneapi_pop_frame(&api, &f)) {
		if (frame_portnum(&f) == portnum) {
			n++;
		}
	}
	return n;
}

/* protect: a full queue of protected TEXT frames rejects an incoming droppable
 * TELEMETRY frame rather than evicting a text message. */
ZTEST(phonequeue, test_protect_rejects_incoming_droppable)
{
	struct meshtastic_sched_stats st;

	for (uint32_t i = 0; i < Q_SIZE; i++) {
		meshtastic_FromRadio t = make_pkt(i + 1, meshtastic_PortNum_TEXT_MESSAGE_APP);

		zassert_ok(meshtastic_phoneapi_enqueue_fromradio(&api, &t));
	}

	meshtastic_FromRadio tel = make_pkt(99, meshtastic_PortNum_TELEMETRY_APP);

	zassert_ok(meshtastic_phoneapi_enqueue_fromradio(&api, &tel));

	/* All four text messages must still be present; the telemetry was dropped. */
	zassert_equal(drain_count_portnum(meshtastic_PortNum_TEXT_MESSAGE_APP), 4,
		      "protected text frames must survive");

	meshtastic_sched_stats_get(&st);
	zassert_equal(st.phone_drop, 1, "one droppable frame dropped");
	zassert_equal(st.phone_drop_protected, 0, "no protected frame dropped");
}

/* protect: with a droppable frame queued, an incoming protected frame evicts
 * the droppable one — not the oldest. */
ZTEST(phonequeue, test_protect_evicts_droppable_not_oldest)
{
	struct meshtastic_sched_stats st;

	/* Queue: TEXT, TELEMETRY, TEXT, TELEMETRY (full). */
	meshtastic_FromRadio a = make_pkt(1, meshtastic_PortNum_TEXT_MESSAGE_APP);
	meshtastic_FromRadio b = make_pkt(2, meshtastic_PortNum_TELEMETRY_APP);
	meshtastic_FromRadio c = make_pkt(3, meshtastic_PortNum_TEXT_MESSAGE_APP);
	meshtastic_FromRadio d = make_pkt(4, meshtastic_PortNum_TELEMETRY_APP);

	zassert_ok(meshtastic_phoneapi_enqueue_fromradio(&api, &a));
	zassert_ok(meshtastic_phoneapi_enqueue_fromradio(&api, &b));
	zassert_ok(meshtastic_phoneapi_enqueue_fromradio(&api, &c));
	zassert_ok(meshtastic_phoneapi_enqueue_fromradio(&api, &d));

	/* Incoming protected TEXT: should evict the oldest droppable (id 2). */
	meshtastic_FromRadio e = make_pkt(5, meshtastic_PortNum_TEXT_MESSAGE_APP);

	zassert_ok(meshtastic_phoneapi_enqueue_fromradio(&api, &e));

	meshtastic_sched_stats_get(&st);
	zassert_equal(st.phone_drop, 1, "one droppable frame evicted");
	zassert_equal(st.phone_drop_protected, 0, "no protected frame dropped");

	/* Now: 3 text (1,3,5) + 1 telemetry (4). */
	zassert_equal(drain_count_portnum(meshtastic_PortNum_TEXT_MESSAGE_APP), 3);
}

/* protect, second telemetry frame case: only the older droppable is evicted. */
ZTEST(phonequeue, test_protect_evicts_oldest_droppable_first)
{
	/* Queue: TELEMETRY(1), TEXT(2), TELEMETRY(3), TEXT(4). */
	meshtastic_FromRadio a = make_pkt(1, meshtastic_PortNum_TELEMETRY_APP);
	meshtastic_FromRadio b = make_pkt(2, meshtastic_PortNum_TEXT_MESSAGE_APP);
	meshtastic_FromRadio c = make_pkt(3, meshtastic_PortNum_TELEMETRY_APP);
	meshtastic_FromRadio d = make_pkt(4, meshtastic_PortNum_TEXT_MESSAGE_APP);

	zassert_ok(meshtastic_phoneapi_enqueue_fromradio(&api, &a));
	zassert_ok(meshtastic_phoneapi_enqueue_fromradio(&api, &b));
	zassert_ok(meshtastic_phoneapi_enqueue_fromradio(&api, &c));
	zassert_ok(meshtastic_phoneapi_enqueue_fromradio(&api, &d));

	/* Incoming protected TEXT(5): evict oldest droppable = telemetry id 1. */
	meshtastic_FromRadio e = make_pkt(5, meshtastic_PortNum_TEXT_MESSAGE_APP);

	zassert_ok(meshtastic_phoneapi_enqueue_fromradio(&api, &e));

	/* Surviving: TEXT(2), TELEMETRY(3), TEXT(4), TEXT(5). */
	struct meshtastic_phoneapi_frame f;
	uint32_t got[Q_SIZE];
	uint8_t n = 0;

	while (n < Q_SIZE && meshtastic_phoneapi_pop_frame(&api, &f)) {
		meshtastic_FromRadio from = meshtastic_FromRadio_init_zero;
		pb_istream_t s = pb_istream_from_buffer(f.data, f.len);

		zassert_true(pb_decode(&s, meshtastic_FromRadio_fields, &from));
		got[n++] = from.packet.id;
	}

	zassert_equal(n, 4, "queue stays full");
	zassert_equal(got[0], 2, "oldest telemetry(1) evicted, text(2) now oldest");
	zassert_equal(got[1], 3);
	zassert_equal(got[2], 4);
	zassert_equal(got[3], 5);
}

/* drop-oldest: the no-backoff policy evicts the strict-oldest frame regardless
 * of tier. */
ZTEST(phonequeue, test_drop_oldest_legacy)
{
	struct meshtastic_sched_stats st;

	zassert_ok(meshtastic_sched_set("phone.evict", "drop-oldest"));

	for (uint32_t i = 0; i < Q_SIZE; i++) {
		meshtastic_FromRadio t = make_pkt(i + 1, meshtastic_PortNum_TEXT_MESSAGE_APP);

		zassert_ok(meshtastic_phoneapi_enqueue_fromradio(&api, &t));
	}

	/* Incoming TEXT(5): drops oldest TEXT(1) despite being protected. */
	meshtastic_FromRadio e = make_pkt(5, meshtastic_PortNum_TEXT_MESSAGE_APP);

	zassert_ok(meshtastic_phoneapi_enqueue_fromradio(&api, &e));

	meshtastic_sched_stats_get(&st);
	zassert_equal(st.phone_drop, 1);
	zassert_equal(st.phone_drop_protected, 1, "legacy dropped a protected frame");

	struct meshtastic_phoneapi_frame f;
	meshtastic_FromRadio from = meshtastic_FromRadio_init_zero;

	zassert_true(meshtastic_phoneapi_pop_frame(&api, &f));
	pb_istream_t s = pb_istream_from_buffer(f.data, f.len);

	zassert_true(pb_decode(&s, meshtastic_FromRadio_fields, &from));
	zassert_equal(from.packet.id, 2, "oldest (id 1) dropped, id 2 now oldest");
}

/* --- the eviction ladder (parity T-5) --------------------------------------
 *
 * "Droppable" used to be one bit, so a NodeInfo and a Telemetry were
 * interchangeable victims and whichever happened to arrive first lost. They are
 * not interchangeable. A lost Telemetry costs one sample of a value that will be
 * sent again shortly; a lost NodeInfo costs the app knowing a node EXISTS, until
 * that peer next announces itself — which since the CADENCE fix can be an hour.
 *
 * This matters more than the August audit's Tier-2 rating suggests, because the
 * fleet has no WiFi and therefore no netlog: the phone IS the diagnostic
 * channel, and "the app can't see that node" reads like a range problem rather
 * than a full queue.
 */

/* THE T-5 assertion. A burst of samples must not cost the app a node. */
ZTEST(phonequeue, test_nodeinfo_survives_a_burst_of_samples)
{
	meshtastic_FromRadio ni = make_pkt(1, meshtastic_PortNum_NODEINFO_APP);

	zassert_ok(meshtastic_phoneapi_enqueue_fromradio(&api, &ni));

	/* Fill the rest with samples, then keep pushing samples at a full queue —
	 * more than the queue is deep, so under the old single-bit rule the
	 * NodeInfo (the oldest droppable frame) would have been the first victim. */
	for (uint32_t i = 0; i < Q_SIZE * 3U; i++) {
		meshtastic_FromRadio t = make_pkt(100U + i, meshtastic_PortNum_TELEMETRY_APP);

		zassert_ok(meshtastic_phoneapi_enqueue_fromradio(&api, &t));
	}

	zassert_equal(drain_count_portnum(meshtastic_PortNum_NODEINFO_APP), 1,
		      "a NodeInfo must outrank a Position/Telemetry sample — losing it "
		      "costs the app a node, not a reading");
}

/* The bottom of the ladder, and the property the log-record comment in
 * meshtastic_phoneapi.c has always claimed: diagnostics must never outrank the
 * traffic they describe. A log burst is exactly what fills this queue now, so
 * this is the case that stops the observability layer eating the observations. */
ZTEST(phonequeue, test_a_log_burst_never_evicts_a_sample)
{
	meshtastic_FromRadio t = make_pkt(1, meshtastic_PortNum_TELEMETRY_APP);
	struct meshtastic_sched_stats st;

	zassert_ok(meshtastic_phoneapi_enqueue_fromradio(&api, &t));
	for (uint32_t i = 0; i < Q_SIZE - 1U; i++) {
		meshtastic_FromRadio l = make_log("filling");

		zassert_ok(meshtastic_phoneapi_enqueue_fromradio(&api, &l));
	}

	/* Full. Every further log must be refused at the door rather than evict
	 * the sample, even though the sample is older. */
	for (uint32_t i = 0; i < Q_SIZE * 2U; i++) {
		meshtastic_FromRadio l = make_log("more");

		zassert_ok(meshtastic_phoneapi_enqueue_fromradio(&api, &l));
	}

	zassert_equal(drain_count_portnum(meshtastic_PortNum_TELEMETRY_APP), 1,
		      "a log record must never displace the traffic it describes");
	meshtastic_sched_stats_get(&st);
	zassert_equal(st.phone_drop_protected, 0, "nothing protected should have been dropped");
}

/* A queue status is the most replaceable frame there is — the next one
 * supersedes it outright — so it goes before a log record does. */
ZTEST(phonequeue, test_a_queue_status_is_sacrificed_before_a_log_record)
{
	meshtastic_FromRadio st_frame = make_status();
	meshtastic_FromRadio keep = make_log("keep me");
	uint8_t logs = 0;
	struct meshtastic_phoneapi_frame f;

	zassert_ok(meshtastic_phoneapi_enqueue_fromradio(&api, &st_frame));
	zassert_ok(meshtastic_phoneapi_enqueue_fromradio(&api, &keep));
	for (uint32_t i = 0; i < Q_SIZE - 2U; i++) {
		meshtastic_FromRadio l = make_log("filling");

		zassert_ok(meshtastic_phoneapi_enqueue_fromradio(&api, &l));
	}

	/* Full, with exactly one status in it. One more log evicts the status. */
	meshtastic_FromRadio extra = make_log("extra");

	zassert_ok(meshtastic_phoneapi_enqueue_fromradio(&api, &extra));

	while (meshtastic_phoneapi_pop_frame(&api, &f)) {
		meshtastic_FromRadio from = meshtastic_FromRadio_init_zero;
		pb_istream_t s = pb_istream_from_buffer(f.data, f.len);

		zassert_true(pb_decode(&s, meshtastic_FromRadio_fields, &from));
		zassert_not_equal(from.which_payload_variant,
				  meshtastic_FromRadio_queueStatus_tag,
				  "the queue status should have been the first thing sacrificed");
		if (from.which_payload_variant == meshtastic_FromRadio_log_record_tag) {
			logs++;
		}
	}
	zassert_equal(logs, Q_SIZE, "every log record should have survived");
}

/* At EQUAL rank the oldest goes, not the newcomer. For a repeating measurement
 * the newer sample is strictly the better one to keep, and this is the case that
 * would silently invert if the comparison were tightened to a strict less-than.
 */
ZTEST(phonequeue, test_at_equal_rank_the_newer_sample_wins)
{
	struct meshtastic_phoneapi_frame f;
	meshtastic_FromRadio from = meshtastic_FromRadio_init_zero;
	pb_istream_t s;

	for (uint32_t i = 0; i < Q_SIZE; i++) {
		meshtastic_FromRadio t = make_pkt(i + 1U, meshtastic_PortNum_TELEMETRY_APP);

		zassert_ok(meshtastic_phoneapi_enqueue_fromradio(&api, &t));
	}

	meshtastic_FromRadio newer = make_pkt(99, meshtastic_PortNum_TELEMETRY_APP);

	zassert_ok(meshtastic_phoneapi_enqueue_fromradio(&api, &newer));

	zassert_true(meshtastic_phoneapi_pop_frame(&api, &f));
	s = pb_istream_from_buffer(f.data, f.len);
	zassert_true(pb_decode(&s, meshtastic_FromRadio_fields, &from));
	zassert_equal(from.packet.id, 2U,
		      "the oldest sample should have gone, not the incoming one");
}

ZTEST_SUITE(phonequeue, NULL, NULL, phonequeue_before, NULL, NULL);


/* ---- with and without a reader (tooling docs/PHONE-QUEUE-READERS.md) ---------------- */

static void fill_and_overflow(void)
{
	meshtastic_FromRadio from;

	for (uint32_t i = 0U; i <= Q_SIZE; i++) {
		from = make_pkt(0x100U + i, meshtastic_PortNum_TELEMETRY_APP);
		zassert_true(meshtastic_phoneapi_enqueue_fromradio(&api, &from) >= 0, "");
	}
}

/* Upstream holds packets for a phone that is not there (toPhoneQueue is filled either way),
 * so frames are still queued; a drop where no client reads is work done for nobody and is
 * counted apart from a drop a connected phone suffered. */
ZTEST(phonequeue, test_a_drop_with_no_reader_is_counted_as_idle)
{
	struct meshtastic_sched_stats st;

	meshtastic_phoneapi_session_reset(&api);
	zassert_false(meshtastic_phoneapi_has_reader(&api), "no client has started the API");
	fill_and_overflow();
	meshtastic_sched_stats_get(&st);
	zassert_equal(st.phone_drop_idle, 1U, "the overflow, counted as idle");
	zassert_equal(st.phone_drop, 0U, "no reader lost anything");
	zassert_equal(api.count, Q_SIZE, "still held for a phone");
}

ZTEST(phonequeue, test_a_drop_with_a_reader_is_a_phone_drop)
{
	struct meshtastic_sched_stats st;

	zassert_true(meshtastic_phoneapi_has_reader(&api), "started in the fixture");
	fill_and_overflow();
	meshtastic_sched_stats_get(&st);
	zassert_equal(st.phone_drop, 1U, "");
	zassert_equal(st.phone_drop_idle, 0U, "");
}

/* upstream's isConnected(): from want_config until the session ends */
ZTEST(phonequeue, test_a_session_makes_a_reader_until_it_resets)
{
	meshtastic_phoneapi_session_reset(&api);
	zassert_false(meshtastic_phoneapi_has_reader(&api), "");
	meshtastic_phoneapi_session_start(&api);
	zassert_true(meshtastic_phoneapi_has_reader(&api), "");
	meshtastic_phoneapi_session_reset(&api);
	zassert_false(meshtastic_phoneapi_has_reader(&api), "the disconnect ends it");
}

/* upstream's checkConnectionTimeout() on a stream transport: silence ends the session; a
 * transport with a disconnect of its own (BLE) is not timed out */
ZTEST(phonequeue, test_a_silent_stream_client_stops_being_a_reader)
{
	meshtastic_phoneapi_set_contact_timeout(&api, false);
	meshtastic_phoneapi_session_start(&api);
	k_sleep(K_MSEC(CONFIG_MESHTASTIC_PHONEAPI_CONTACT_TIMEOUT_S * 1000 + 100));
	zassert_true(meshtastic_phoneapi_has_reader(&api), "no timeout without contact_timeout");

	meshtastic_phoneapi_set_contact_timeout(&api, true);
	meshtastic_phoneapi_session_start(&api);
	zassert_true(meshtastic_phoneapi_has_reader(&api), "");
	k_sleep(K_MSEC(CONFIG_MESHTASTIC_PHONEAPI_CONTACT_TIMEOUT_S * 1000 + 100));
	zassert_false(meshtastic_phoneapi_has_reader(&api), "silent past the timeout");
	meshtastic_phoneapi_set_contact_timeout(&api, false);
}

/* A polled client killed without a disconnect: its session runs on to the contact timeout, but
 * what the queue drops meanwhile no reader lost. A read makes it a reader again. */
ZTEST(phonequeue, test_a_polled_client_that_stopped_reading_loses_nothing)
{
	struct meshtastic_phoneapi_frame frame;
	struct meshtastic_sched_stats st;
	meshtastic_FromRadio from;

	meshtastic_phoneapi_set_read_window(&api, 1U);
	meshtastic_phoneapi_session_start(&api);
	k_sleep(K_MSEC(1100));
	zassert_true(meshtastic_phoneapi_has_reader(&api), "the session is still up");
	fill_and_overflow();
	meshtastic_sched_stats_get(&st);
	zassert_equal(st.phone_drop_idle, 1U, "past the window: idle");
	zassert_equal(st.phone_drop, 0U, "");

	zassert_true(meshtastic_phoneapi_pop_frame(&api, &frame), "");
	for (uint32_t i = 0U; i < 2U; i++) {
		from = make_pkt(0x200U + i, meshtastic_PortNum_TELEMETRY_APP);
		zassert_true(meshtastic_phoneapi_enqueue_fromradio(&api, &from) >= 0, "");
	}
	meshtastic_sched_stats_get(&st);
	zassert_equal(st.phone_drop, 1U, "it read again: a drop it suffered");
	zassert_equal(st.phone_drop_idle, 1U, "");
	meshtastic_phoneapi_set_read_window(&api, 0U);
}
```

## src/sched.c
```c
/* SPDX-License-Identifier: GPL-3.0
 *
 * Unit tests for the scheduler / QoS policy surface (meshtastic_sched).
 * Deterministic, no radio — verifies tier mapping, knob parsing, presets, and
 * stats accounting. The concurrency behavior of the priority egress queue is
 * exercised separately (hardware pass / gated-mock test).
 */

#include <errno.h>

#include <zephyr/ztest.h>

#include <zephyr/meshtastic/meshtastic.h>

#include "meshtastic_sched.h"

static void sched_before(void *fixture)
{
	ARG_UNUSED(fixture);
	meshtastic_sched_defaults();
	meshtastic_sched_stats_reset();
}

ZTEST_SUITE(sched, NULL, NULL, sched_before, NULL, NULL);

ZTEST(sched, test_compiled_defaults)
{
	const struct meshtastic_sched_config *c = meshtastic_sched_get();

	zassert_equal(c->tx_order, MT_SCHED_ORDER_PRIORITY, "default order should be priority");
	zassert_equal(c->tx_overflow, MT_SCHED_OVF_DROP_LOWEST, "default overflow should drop-lowest");
	zassert_true(c->tx_depth >= 1, "depth must be positive");
	zassert_equal(c->phone_evict, MT_SCHED_PHONE_PROTECT, "default phone evict should protect");
	zassert_true(c->airtime_max_util > 0 && c->airtime_max_util <= 100,
		     "default airtime gate should be enabled and a valid percent");
	zassert_true(c->dedup_ttl_sec > 0, "default dedup TTL should be enabled");
	zassert_true(c->reliable_retries > 0, "default reliable retries should be enabled");
	zassert_equal(c->reliable_timeout_ms, 0,
		      "default reliable timeout 0 = airtime-adaptive (mirror upstream)");
}

ZTEST(sched, test_tier_mapping)
{
	zassert_equal(meshtastic_sched_tier_for(MESHTASTIC_PORT_ROUTING), MT_SCHED_TIER_ACK);
	zassert_equal(meshtastic_sched_tier_for(MESHTASTIC_PORT_POSITION), MT_SCHED_TIER_BG);
	zassert_equal(meshtastic_sched_tier_for(MESHTASTIC_PORT_TELEMETRY), MT_SCHED_TIER_BG);
	zassert_equal(meshtastic_sched_tier_for(MESHTASTIC_PORT_NODEINFO), MT_SCHED_TIER_BG);
	zassert_equal(meshtastic_sched_tier_for(MESHTASTIC_PORT_NODE_STATUS), MT_SCHED_TIER_BG);
	zassert_equal(meshtastic_sched_tier_for(MESHTASTIC_PORT_NEIGHBORINFO), MT_SCHED_TIER_BG);
	zassert_equal(meshtastic_sched_tier_for(MESHTASTIC_PORT_MESH_BEACON), MT_SCHED_TIER_BG);
	zassert_equal(meshtastic_sched_tier_for(MESHTASTIC_PORT_TEXT_MESSAGE), MT_SCHED_TIER_NORMAL);
	/* Unknown portnum falls back to NORMAL, never dropped as background. */
	zassert_equal(meshtastic_sched_tier_for(12345U), MT_SCHED_TIER_NORMAL);
}

ZTEST(sched, test_set_valid_knobs)
{
	zassert_ok(meshtastic_sched_set("tx.order", "fifo"));
	zassert_equal(meshtastic_sched_get()->tx_order, MT_SCHED_ORDER_FIFO);
	zassert_ok(meshtastic_sched_set("tx.order", "priority"));
	zassert_equal(meshtastic_sched_get()->tx_order, MT_SCHED_ORDER_PRIORITY);

	zassert_ok(meshtastic_sched_set("tx.overflow", "drop-newest"));
	zassert_equal(meshtastic_sched_get()->tx_overflow, MT_SCHED_OVF_DROP_NEWEST);
	zassert_ok(meshtastic_sched_set("tx.overflow", "drop-lowest"));
	zassert_equal(meshtastic_sched_get()->tx_overflow, MT_SCHED_OVF_DROP_LOWEST);

	zassert_ok(meshtastic_sched_set("tx.depth", "3"));
	zassert_equal(meshtastic_sched_get()->tx_depth, 3);

	zassert_ok(meshtastic_sched_set("phone.evict", "drop-oldest"));
	zassert_equal(meshtastic_sched_get()->phone_evict, MT_SCHED_PHONE_DROP_OLDEST);
	zassert_ok(meshtastic_sched_set("phone.evict", "protect"));
	zassert_equal(meshtastic_sched_get()->phone_evict, MT_SCHED_PHONE_PROTECT);

	zassert_ok(meshtastic_sched_set("airtime.max", "0"));
	zassert_equal(meshtastic_sched_get()->airtime_max_util, 0);
	zassert_ok(meshtastic_sched_set("airtime.max", "55"));
	zassert_equal(meshtastic_sched_get()->airtime_max_util, 55);

	zassert_ok(meshtastic_sched_set("dedup.ttl", "0"));
	zassert_equal(meshtastic_sched_get()->dedup_ttl_sec, 0);
	zassert_ok(meshtastic_sched_set("dedup.ttl", "600"));
	zassert_equal(meshtastic_sched_get()->dedup_ttl_sec, 600);

	zassert_ok(meshtastic_sched_set("reliable.retries", "0"));
	zassert_equal(meshtastic_sched_get()->reliable_retries, 0);
	zassert_ok(meshtastic_sched_set("reliable.retries", "5"));
	zassert_equal(meshtastic_sched_get()->reliable_retries, 5);
	zassert_ok(meshtastic_sched_set("reliable.timeout", "2500"));
	zassert_equal(meshtastic_sched_get()->reliable_timeout_ms, 2500);
}

ZTEST(sched, test_set_invalid_rejected)
{
	uint8_t depth_before = meshtastic_sched_get()->tx_depth;

	zassert_equal(meshtastic_sched_set("bogus.key", "x"), -ENOENT);
	zassert_equal(meshtastic_sched_set("tx.order", "sideways"), -EINVAL);
	zassert_equal(meshtastic_sched_set("tx.overflow", "explode"), -EINVAL);
	zassert_equal(meshtastic_sched_set("tx.depth", "0"), -EINVAL);
	zassert_equal(meshtastic_sched_set("tx.depth", "99999"), -EINVAL);
	zassert_equal(meshtastic_sched_set("tx.depth", "notanumber"), -EINVAL);
	zassert_equal(meshtastic_sched_set("phone.evict", "maybe"), -EINVAL);
	zassert_equal(meshtastic_sched_set("airtime.max", "101"), -EINVAL);
	zassert_equal(meshtastic_sched_set("airtime.max", "-1"), -EINVAL);
	zassert_equal(meshtastic_sched_set("dedup.ttl", "70000"), -EINVAL);
	zassert_equal(meshtastic_sched_set("reliable.retries", "11"), -EINVAL);
	zassert_equal(meshtastic_sched_set("reliable.timeout", "10"), -EINVAL);

	/* A rejected set must not mutate state. */
	zassert_equal(meshtastic_sched_get()->tx_depth, depth_before);
}

ZTEST(sched, test_presets)
{
	zassert_ok(meshtastic_sched_apply_preset("no-backoff"));
	zassert_equal(meshtastic_sched_get()->tx_order, MT_SCHED_ORDER_FIFO,
		      "no-backoff must be FIFO for A/B comparison");
	zassert_equal(meshtastic_sched_get()->tx_overflow, MT_SCHED_OVF_DROP_NEWEST);
	zassert_equal(meshtastic_sched_get()->airtime_max_util, 0,
		      "no-backoff disables the airtime gate");
	zassert_equal(meshtastic_sched_get()->dedup_ttl_sec, 0,
		      "no-backoff uses a never-expiring dedup ring");

	zassert_ok(meshtastic_sched_apply_preset("default"));
	zassert_equal(meshtastic_sched_get()->tx_order, MT_SCHED_ORDER_PRIORITY);

	zassert_equal(meshtastic_sched_apply_preset("does-not-exist"), -ENOENT);

	/* Every advertised preset name must actually apply. */
	for (int i = 0; meshtastic_sched_preset_name(i) != NULL; i++) {
		zassert_ok(meshtastic_sched_apply_preset(meshtastic_sched_preset_name(i)),
			   "advertised preset '%s' failed to apply",
			   meshtastic_sched_preset_name(i));
	}
}

ZTEST(sched, test_stats_accounting)
{
	struct meshtastic_sched_stats st;

	meshtastic_sched_stat_enq(MT_SCHED_TIER_ACK, 3);
	meshtastic_sched_stat_enq(MT_SCHED_TIER_BG, 5);
	meshtastic_sched_stat_enq(MT_SCHED_TIER_BG, 2);
	meshtastic_sched_stat_drop(MT_SCHED_TIER_BG);

	meshtastic_sched_stats_get(&st);
	zassert_equal(st.tx_enq[MT_SCHED_TIER_ACK], 1);
	zassert_equal(st.tx_enq[MT_SCHED_TIER_BG], 2);
	zassert_equal(st.tx_drop[MT_SCHED_TIER_BG], 1);
	zassert_equal(st.ob_hiwater, 5, "hi-water tracks the peak occupancy");

	meshtastic_sched_stats_reset();
	meshtastic_sched_stats_get(&st);
	zassert_equal(st.tx_enq[MT_SCHED_TIER_ACK], 0);
	zassert_equal(st.tx_drop[MT_SCHED_TIER_BG], 0);
	zassert_equal(st.ob_hiwater, 0);
}

/* A snapshot must return a whole, self-consistent policy: every field belongs to
 * the same preset, and it tracks committed writes. */
ZTEST(sched, test_snapshot_coherent)
{
	struct meshtastic_sched_config snap;

	zassert_ok(meshtastic_sched_apply_preset("no-backoff"));
	meshtastic_sched_snapshot(&snap);
	zassert_equal(snap.tx_order, MT_SCHED_ORDER_FIFO);
	zassert_equal(snap.tx_overflow, MT_SCHED_OVF_DROP_NEWEST);
	zassert_equal(snap.phone_evict, MT_SCHED_PHONE_DROP_OLDEST);
	zassert_equal(snap.airtime_max_util, 0, "no-backoff bundle must be coherent");
	zassert_equal(snap.dedup_ttl_sec, 0, "no-backoff bundle must be coherent");

	zassert_ok(meshtastic_sched_apply_preset("default"));
	meshtastic_sched_snapshot(&snap);
	zassert_equal(snap.tx_order, MT_SCHED_ORDER_PRIORITY);
	zassert_true(snap.airtime_max_util > 0 && snap.dedup_ttl_sec > 0);

	/* A snapshot reflects an individual committed knob change. */
	zassert_ok(meshtastic_sched_set("airtime.max", "17"));
	meshtastic_sched_snapshot(&snap);
	zassert_equal(snap.airtime_max_util, 17);
	/* ...and agrees with the live pointer for that field. */
	zassert_equal(snap.airtime_max_util, meshtastic_sched_get()->airtime_max_util);
}

ZTEST(sched, test_airtime_and_dedup_stats)
{
	struct meshtastic_sched_stats st;

	meshtastic_sched_stat_airtime_drop();
	meshtastic_sched_stat_airtime_drop();
	meshtastic_sched_stat_dedup_expired();

	meshtastic_sched_stats_get(&st);
	zassert_equal(st.tx_airtime_drop, 2);
	zassert_equal(st.dedup_expired, 1);
}

/* Changing modes must zero the drop counters so each policy is measured from a
 * clean slate. */
ZTEST(sched, test_stats_reset_on_mode_change)
{
	struct meshtastic_sched_stats st;

	/* A committed `set` resets. */
	meshtastic_sched_stat_drop(MT_SCHED_TIER_BG);
	meshtastic_sched_stat_airtime_drop();
	zassert_ok(meshtastic_sched_set("tx.depth", "5"));
	meshtastic_sched_stats_get(&st);
	zassert_equal(st.tx_drop[MT_SCHED_TIER_BG], 0, "set must reset drop stats");
	zassert_equal(st.tx_airtime_drop, 0);

	/* A rejected `set` must NOT reset. */
	meshtastic_sched_stat_drop(MT_SCHED_TIER_BG);
	zassert_equal(meshtastic_sched_set("tx.depth", "0"), -EINVAL);
	meshtastic_sched_stats_get(&st);
	zassert_equal(st.tx_drop[MT_SCHED_TIER_BG], 1, "rejected set must not reset stats");

	/* Applying a preset resets. */
	zassert_ok(meshtastic_sched_apply_preset("no-backoff"));
	meshtastic_sched_stats_get(&st);
	zassert_equal(st.tx_drop[MT_SCHED_TIER_BG], 0, "preset must reset drop stats");

	/* defaults() resets. */
	meshtastic_sched_stat_phone_drop(true, false);
	meshtastic_sched_defaults();
	meshtastic_sched_stats_get(&st);
	zassert_equal(st.phone_drop, 0, "defaults must reset drop stats");
}
```
