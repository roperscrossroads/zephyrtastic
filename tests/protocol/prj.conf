## CMakeLists.txt
```
cmake_minimum_required(VERSION 3.20.0)

find_package(Zephyr REQUIRED HINTS $ENV{ZEPHYR_BASE})
project(meshtastic_protocol_tests)

target_include_directories(app PRIVATE
  ${CMAKE_CURRENT_SOURCE_DIR}/../../src
  ${CMAKE_CURRENT_SOURCE_DIR}/..
  ${CMAKE_BINARY_DIR}/modules/meshtastic-zephyr/src
  ${CMAKE_BINARY_DIR}/modules/meshtastic-zephyr/src/proto
)

target_sources(app PRIVATE src/main.c src/sched.c src/phonequeue.c src/vectors.c src/channels.c src/txpower.c)
```

## prj.conf
```kconfig
CONFIG_ZTEST=y

CONFIG_MESHTASTIC=y
CONFIG_MESHTASTIC_PHONEAPI=y
CONFIG_MESHTASTIC_SETTINGS=n
CONFIG_MESHTASTIC_BLE=n
CONFIG_MESHTASTIC_SERIAL=n
CONFIG_MESHTASTIC_SHELL=n
CONFIG_MESHTASTIC_GNSS=n
CONFIG_MESHTASTIC_DEVICE_METRICS=n
CONFIG_MESHTASTIC_ENVIRONMENT_METRICS=n
CONFIG_MESHTASTIC_NODEDB=y

CONFIG_MAIN_STACK_SIZE=4096

# Clock persistence, against native_sim's counter (see the board overlay).
#
# Set EXPLICITLY, not left to the Kconfig default: the default is n until the
# feature has been brought up on hardware, and a test that inherits a default is
# a test that silently stops running when the default moves. It did exactly that
# once — the coverage vanished the moment the default flipped, and the suite
# stayed green.
CONFIG_MESHTASTIC_CLOCK_PERSIST=y
# Set explicitly, not inherited: the skew tests below assert against
# MIN_WINDOW_S and MAX_PPM, and a test that rides a default stops testing
# the moment the default moves — silently, with the suite still green.
CONFIG_MESHTASTIC_CLOCK_SKEW=y
CONFIG_MESHTASTIC_CLOCK_SKEW_MIN_WINDOW_S=3600
CONFIG_MESHTASTIC_CLOCK_SKEW_MAX_PPM=100
CONFIG_COUNTER=y
CONFIG_COUNTER_NATIVE_SIM=y
CONFIG_MESHTASTIC_BOOTLOG=y
```

## boards/native_sim_native_64.overlay
```dts
/* SPDX-License-Identifier: GPL-3.0 */
/*
 * A counter for the clock-persistence module to measure downtime against.
 *
 * Without a meshtastic,persist-counter chosen the module compiles out entirely,
 * and a module that compiles out is a module with no tests — which is exactly
 * how a configuration reaches the bench having never been built. native_sim
 * ships a counter; pointing the chosen at it brings the decision logic under
 * test, even though nothing here survives a reset (there is no reset to
 * survive, so the boot path reports a cold start and the tests drive the
 * decision through its seam instead).
 */
/ {
	chosen {
		meshtastic,persist-counter = &counter0;
	};
};

&counter0 {
	status = "okay";
};
```

## src/channels.c
```c
/* Channel key-resolution regression tests.
 *
 * SPDX-License-Identifier: GPL-3.0
 */

#include <zephyr/ztest.h>
#include <string.h>

#include "meshtastic_channels.h"

static void channels_before(void *fixture)
{
	ARG_UNUSED(fixture);
	meshtastic_channels_init_defaults();
}

/* An empty-PSK SECONDARY borrows the primary's key. If the primary slot is
 * itself marked SECONDARY, that borrow points at its own index and recurses
 * forever -- nothing enforces that channel_slots[primary_index] has role
 * PRIMARY. Reachable from meshtastic_channels_set_slot(), i.e. from the admin
 * set_channel path, so a peer that can set a channel can wedge the node.
 *
 * Note on failure mode: a regression here HANGS rather than failing, because
 * the recursive call is in tail position and the compiler turns it into an
 * infinite loop instead of blowing the stack. Detecting it cleanly in-process
 * would mean adding a depth counter to production code purely for testability,
 * which is not worth it -- twister's per-suite timeout catches the hang.
 * Reaching the assertions below at all is the real signal.
 */
ZTEST(channels, test_secondary_at_primary_index_does_not_recurse)
{
	meshtastic_Channel ch = meshtastic_Channel_init_zero;
	struct meshtastic_channel_key key;

	/* Slot 0 is primary_index after init_defaults(). Installing a SECONDARY
	 * there leaves primary_index pointing at a non-PRIMARY slot -- set_slot
	 * only reassigns primary_index when the incoming role IS primary.
	 */
	ch.role = meshtastic_Channel_Role_SECONDARY;
	ch.has_settings = true;
	ch.settings.psk.size = 0;
	strncpy(ch.settings.name, "selfref", sizeof(ch.settings.name) - 1U);

	zassert_ok(meshtastic_channels_set_slot(0, &ch),
		   "set_slot must return rather than recurse");

	zassert_equal(meshtastic_channels_primary_index(), 0,
		      "precondition: slot 0 is still primary_index");

	/* The self-referential borrow resolves to cleartext, matching a PRIMARY
	 * with an empty PSK, rather than looping.
	 */
	zassert_ok(meshtastic_channels_primary_key(&key),
		   "primary_key must return rather than recurse");
	zassert_equal(key.len, 0, "self-referential secondary resolves to cleartext");
}

/* The legitimate borrow must keep working: a SECONDARY at a different index
 * with no PSK still inherits the primary's key.
 */
ZTEST(channels, test_secondary_borrows_primary_key)
{
	meshtastic_Channel ch = meshtastic_Channel_init_zero;
	struct meshtastic_channel_key primary, borrowed;

	zassert_ok(meshtastic_channels_primary_key(&primary), "primary key unavailable");
	zassert_true(primary.len > 0, "default primary should carry a key");

	ch.role = meshtastic_Channel_Role_SECONDARY;
	ch.has_settings = true;
	ch.settings.psk.size = 0;
	strncpy(ch.settings.name, "borrower", sizeof(ch.settings.name) - 1U);
	zassert_ok(meshtastic_channels_set_slot(1, &ch), "set_slot failed");

	zassert_ok(meshtastic_channels_get_key(1, &borrowed), "get_key failed");
	zassert_equal(borrowed.len, primary.len, "borrowed key length differs");
	zassert_mem_equal(borrowed.bytes, primary.bytes, primary.len,
			  "secondary did not inherit the primary key");
}

ZTEST_SUITE(channels, NULL, NULL, channels_before, NULL, NULL);
```

## src/phonequeue.c
```c
/* SPDX-License-Identifier: GPL-3.0
 *
 * Phone FromRadio queue selective-eviction tests.
 *
 * Exercises meshtastic_phoneapi_enqueue_fromradio() under a saturated queue for
 * both phone.evict policies:
 *   - protect     : text/routing/admin frames survive a burst of droppable
 *                   position/telemetry/nodeinfo frames (finding C).
 *   - drop-oldest : legacy strict-oldest eviction.
 *
 * The queue holds encoded FromRadio bytes, so surviving frames are decoded back
 * with nanopb to check *which* portnum survived, not merely how many.
 */

#include <string.h>

#include <zephyr/kernel.h>
#include <zephyr/ztest.h>

#include <pb_decode.h>
#include "meshtastic/mesh.pb.h"

#include "meshtastic_phoneapi.h"
#include "meshtastic_sched.h"

#define Q_SIZE 4U

static struct meshtastic_phoneapi_frame q_storage[Q_SIZE];
static struct meshtastic_phoneapi api;
static meshtastic_ToRadio to_scratch;
static meshtastic_FromRadio from_scratch;

static void phonequeue_before(void *fixture)
{
	ARG_UNUSED(fixture);
	meshtastic_sched_defaults();
	meshtastic_sched_stats_reset();
	meshtastic_phoneapi_init(&api, "test", q_storage, Q_SIZE, NULL, NULL, NULL, NULL,
				 &to_scratch, &from_scratch);
}

/* Build a FromRadio carrying a decoded MeshPacket on the given portnum. `id`
 * lands in packet.id so a decode can identify the survivor. */
static meshtastic_FromRadio make_pkt(uint32_t id, meshtastic_PortNum portnum)
{
	meshtastic_FromRadio from = meshtastic_FromRadio_init_zero;

	from.which_payload_variant = meshtastic_FromRadio_packet_tag;
	from.packet.id = id;
	from.packet.which_payload_variant = meshtastic_MeshPacket_decoded_tag;
	from.packet.decoded.portnum = portnum;
	from.packet.decoded.payload.size = 1U;
	from.packet.decoded.payload.bytes[0] = (uint8_t)id;
	return from;
}

/* A FromRadio carrying a log record — the cheapest thing above a queue status. */
static meshtastic_FromRadio make_log(const char *msg)
{
	meshtastic_FromRadio from = meshtastic_FromRadio_init_zero;

	from.which_payload_variant = meshtastic_FromRadio_log_record_tag;
	strncpy(from.log_record.message, msg, sizeof(from.log_record.message) - 1U);
	from.log_record.level = meshtastic_LogRecord_Level_INFO;
	return from;
}

/* A FromRadio carrying a queue status — the most replaceable frame there is,
 * since the next one supersedes it outright. */
static meshtastic_FromRadio make_status(void)
{
	meshtastic_FromRadio from = meshtastic_FromRadio_init_zero;

	from.which_payload_variant = meshtastic_FromRadio_queueStatus_tag;
	from.queueStatus.free = 1U;
	return from;
}

/* Decode a popped frame and return its packet portnum (or -1 if not a packet). */
static int frame_portnum(const struct meshtastic_phoneapi_frame *f)
{
	meshtastic_FromRadio from = meshtastic_FromRadio_init_zero;
	pb_istream_t stream = pb_istream_from_buffer(f->data, f->len);

	if (!pb_decode(&stream, meshtastic_FromRadio_fields, &from)) {
		return -1;
	}
	if (from.which_payload_variant != meshtastic_FromRadio_packet_tag) {
		return -1;
	}
	return (int)from.packet.decoded.portnum;
}

/* Count surviving frames of a given portnum by draining the queue. */
static uint8_t drain_count_portnum(int portnum)
{
	struct meshtastic_phoneapi_frame f;
	uint8_t n = 0;

	while (meshtastic_phoneapi_pop_frame(&api, &f)) {
		if (frame_portnum(&f) == portnum) {
			n++;
		}
	}
	return n;
}

/* protect: a full queue of protected TEXT frames rejects an incoming droppable
 * TELEMETRY frame rather than evicting a text message. */
ZTEST(phonequeue, test_protect_rejects_incoming_droppable)
{
	struct meshtastic_sched_stats st;

	for (uint32_t i = 0; i < Q_SIZE; i++) {
		meshtastic_FromRadio t = make_pkt(i + 1, meshtastic_PortNum_TEXT_MESSAGE_APP);

		zassert_ok(meshtastic_phoneapi_enqueue_fromradio(&api, &t));
	}

	meshtastic_FromRadio tel = make_pkt(99, meshtastic_PortNum_TELEMETRY_APP);

	zassert_ok(meshtastic_phoneapi_enqueue_fromradio(&api, &tel));

	/* All four text messages must still be present; the telemetry was dropped. */
	zassert_equal(drain_count_portnum(meshtastic_PortNum_TEXT_MESSAGE_APP), 4,
		      "protected text frames must survive");

	meshtastic_sched_stats_get(&st);
	zassert_equal(st.phone_drop, 1, "one droppable frame dropped");
	zassert_equal(st.phone_drop_protected, 0, "no protected frame dropped");
}

/* protect: with a droppable frame queued, an incoming protected frame evicts
 * the droppable one — not the oldest. */
ZTEST(phonequeue, test_protect_evicts_droppable_not_oldest)
{
	struct meshtastic_sched_stats st;

	/* Queue: TEXT, TELEMETRY, TEXT, TELEMETRY (full). */
	meshtastic_FromRadio a = make_pkt(1, meshtastic_PortNum_TEXT_MESSAGE_APP);
	meshtastic_FromRadio b = make_pkt(2, meshtastic_PortNum_TELEMETRY_APP);
	meshtastic_FromRadio c = make_pkt(3, meshtastic_PortNum_TEXT_MESSAGE_APP);
	meshtastic_FromRadio d = make_pkt(4, meshtastic_PortNum_TELEMETRY_APP);

	zassert_ok(meshtastic_phoneapi_enqueue_fromradio(&api, &a));
	zassert_ok(meshtastic_phoneapi_enqueue_fromradio(&api, &b));
	zassert_ok(meshtastic_phoneapi_enqueue_fromradio(&api, &c));
	zassert_ok(meshtastic_phoneapi_enqueue_fromradio(&api, &d));

	/* Incoming protected TEXT: should evict the oldest droppable (id 2). */
	meshtastic_FromRadio e = make_pkt(5, meshtastic_PortNum_TEXT_MESSAGE_APP);

	zassert_ok(meshtastic_phoneapi_enqueue_fromradio(&api, &e));

	meshtastic_sched_stats_get(&st);
	zassert_equal(st.phone_drop, 1, "one droppable frame evicted");
	zassert_equal(st.phone_drop_protected, 0, "no protected frame dropped");

	/* Now: 3 text (1,3,5) + 1 telemetry (4). */
	zassert_equal(drain_count_portnum(meshtastic_PortNum_TEXT_MESSAGE_APP), 3);
}

/* protect, second telemetry frame case: only the older droppable is evicted. */
ZTEST(phonequeue, test_protect_evicts_oldest_droppable_first)
{
	/* Queue: TELEMETRY(1), TEXT(2), TELEMETRY(3), TEXT(4). */
	meshtastic_FromRadio a = make_pkt(1, meshtastic_PortNum_TELEMETRY_APP);
	meshtastic_FromRadio b = make_pkt(2, meshtastic_PortNum_TEXT_MESSAGE_APP);
	meshtastic_FromRadio c = make_pkt(3, meshtastic_PortNum_TELEMETRY_APP);
	meshtastic_FromRadio d = make_pkt(4, meshtastic_PortNum_TEXT_MESSAGE_APP);

	zassert_ok(meshtastic_phoneapi_enqueue_fromradio(&api, &a));
	zassert_ok(meshtastic_phoneapi_enqueue_fromradio(&api, &b));
	zassert_ok(meshtastic_phoneapi_enqueue_fromradio(&api, &c));
	zassert_ok(meshtastic_phoneapi_enqueue_fromradio(&api, &d));

	/* Incoming protected TEXT(5): evict oldest droppable = telemetry id 1. */
	meshtastic_FromRadio e = make_pkt(5, meshtastic_PortNum_TEXT_MESSAGE_APP);

	zassert_ok(meshtastic_phoneapi_enqueue_fromradio(&api, &e));

	/* Surviving: TEXT(2), TELEMETRY(3), TEXT(4), TEXT(5). */
	struct meshtastic_phoneapi_frame f;
	uint32_t got[Q_SIZE];
	uint8_t n = 0;

	while (n < Q_SIZE && meshtastic_phoneapi_pop_frame(&api, &f)) {
		meshtastic_FromRadio from = meshtastic_FromRadio_init_zero;
		pb_istream_t s = pb_istream_from_buffer(f.data, f.len);

		zassert_true(pb_decode(&s, meshtastic_FromRadio_fields, &from));
		got[n++] = from.packet.id;
	}

	zassert_equal(n, 4, "queue stays full");
	zassert_equal(got[0], 2, "oldest telemetry(1) evicted, text(2) now oldest");
	zassert_equal(got[1], 3);
	zassert_equal(got[2], 4);
	zassert_equal(got[3], 5);
}

/* drop-oldest: the no-backoff policy evicts the strict-oldest frame regardless
 * of tier. */
ZTEST(phonequeue, test_drop_oldest_legacy)
{
	struct meshtastic_sched_stats st;

	zassert_ok(meshtastic_sched_set("phone.evict", "drop-oldest"));

	for (uint32_t i = 0; i < Q_SIZE; i++) {
		meshtastic_FromRadio t = make_pkt(i + 1, meshtastic_PortNum_TEXT_MESSAGE_APP);

		zassert_ok(meshtastic_phoneapi_enqueue_fromradio(&api, &t));
	}

	/* Incoming TEXT(5): drops oldest TEXT(1) despite being protected. */
	meshtastic_FromRadio e = make_pkt(5, meshtastic_PortNum_TEXT_MESSAGE_APP);

	zassert_ok(meshtastic_phoneapi_enqueue_fromradio(&api, &e));

	meshtastic_sched_stats_get(&st);
	zassert_equal(st.phone_drop, 1);
	zassert_equal(st.phone_drop_protected, 1, "legacy dropped a protected frame");

	struct meshtastic_phoneapi_frame f;
	meshtastic_FromRadio from = meshtastic_FromRadio_init_zero;

	zassert_true(meshtastic_phoneapi_pop_frame(&api, &f));
	pb_istream_t s = pb_istream_from_buffer(f.data, f.len);

	zassert_true(pb_decode(&s, meshtastic_FromRadio_fields, &from));
	zassert_equal(from.packet.id, 2, "oldest (id 1) dropped, id 2 now oldest");
}

/* --- the eviction ladder (parity T-5) --------------------------------------
 *
 * "Droppable" used to be one bit, so a NodeInfo and a Telemetry were
 * interchangeable victims and whichever happened to arrive first lost. They are
 * not interchangeable. A lost Telemetry costs one sample of a value that will be
 * sent again shortly; a lost NodeInfo costs the app knowing a node EXISTS, until
 * that peer next announces itself — which since the CADENCE fix can be an hour.
 *
 * This matters more than the August audit's Tier-2 rating suggests, because the
 * fleet has no WiFi and therefore no netlog: the phone IS the diagnostic
 * channel, and "the app can't see that node" reads like a range problem rather
 * than a full queue.
 */

/* THE T-5 assertion. A burst of samples must not cost the app a node. */
ZTEST(phonequeue, test_nodeinfo_survives_a_burst_of_samples)
{
	meshtastic_FromRadio ni = make_pkt(1, meshtastic_PortNum_NODEINFO_APP);

	zassert_ok(meshtastic_phoneapi_enqueue_fromradio(&api, &ni));

	/* Fill the rest with samples, then keep pushing samples at a full queue —
	 * more than the queue is deep, so under the old single-bit rule the
	 * NodeInfo (the oldest droppable frame) would have been the first victim. */
	for (uint32_t i = 0; i < Q_SIZE * 3U; i++) {
		meshtastic_FromRadio t = make_pkt(100U + i, meshtastic_PortNum_TELEMETRY_APP);

		zassert_ok(meshtastic_phoneapi_enqueue_fromradio(&api, &t));
	}

	zassert_equal(drain_count_portnum(meshtastic_PortNum_NODEINFO_APP), 1,
		      "a NodeInfo must outrank a Position/Telemetry sample — losing it "
		      "costs the app a node, not a reading");
}

/* The bottom of the ladder, and the property the log-record comment in
 * meshtastic_phoneapi.c has always claimed: diagnostics must never outrank the
 * traffic they describe. A log burst is exactly what fills this queue now, so
 * this is the case that stops the observability layer eating the observations. */
ZTEST(phonequeue, test_a_log_burst_never_evicts_a_sample)
{
	meshtastic_FromRadio t = make_pkt(1, meshtastic_PortNum_TELEMETRY_APP);
	struct meshtastic_sched_stats st;

	zassert_ok(meshtastic_phoneapi_enqueue_fromradio(&api, &t));
	for (uint32_t i = 0; i < Q_SIZE - 1U; i++) {
		meshtastic_FromRadio l = make_log("filling");

		zassert_ok(meshtastic_phoneapi_enqueue_fromradio(&api, &l));
	}

	/* Full. Every further log must be refused at the door rather than evict
	 * the sample, even though the sample is older. */
	for (uint32_t i = 0; i < Q_SIZE * 2U; i++) {
		meshtastic_FromRadio l = make_log("more");

		zassert_ok(meshtastic_phoneapi_enqueue_fromradio(&api, &l));
	}

	zassert_equal(drain_count_portnum(meshtastic_PortNum_TELEMETRY_APP), 1,
		      "a log record must never displace the traffic it describes");
	meshtastic_sched_stats_get(&st);
	zassert_equal(st.phone_drop_protected, 0, "nothing protected should have been dropped");
}

/* A queue status is the most replaceable frame there is — the next one
 * supersedes it outright — so it goes before a log record does. */
ZTEST(phonequeue, test_a_queue_status_is_sacrificed_before_a_log_record)
{
	meshtastic_FromRadio st_frame = make_status();
	meshtastic_FromRadio keep = make_log("keep me");
	uint8_t logs = 0;
	struct meshtastic_phoneapi_frame f;

	zassert_ok(meshtastic_phoneapi_enqueue_fromradio(&api, &st_frame));
	zassert_ok(meshtastic_phoneapi_enqueue_fromradio(&api, &keep));
	for (uint32_t i = 0; i < Q_SIZE - 2U; i++) {
		meshtastic_FromRadio l = make_log("filling");

		zassert_ok(meshtastic_phoneapi_enqueue_fromradio(&api, &l));
	}

	/* Full, with exactly one status in it. One more log evicts the status. */
	meshtastic_FromRadio extra = make_log("extra");

	zassert_ok(meshtastic_phoneapi_enqueue_fromradio(&api, &extra));

	while (meshtastic_phoneapi_pop_frame(&api, &f)) {
		meshtastic_FromRadio from = meshtastic_FromRadio_init_zero;
		pb_istream_t s = pb_istream_from_buffer(f.data, f.len);

		zassert_true(pb_decode(&s, meshtastic_FromRadio_fields, &from));
		zassert_not_equal(from.which_payload_variant,
				  meshtastic_FromRadio_queueStatus_tag,
				  "the queue status should have been the first thing sacrificed");
		if (from.which_payload_variant == meshtastic_FromRadio_log_record_tag) {
			logs++;
		}
	}
	zassert_equal(logs, Q_SIZE, "every log record should have survived");
}

/* At EQUAL rank the oldest goes, not the newcomer. For a repeating measurement
 * the newer sample is strictly the better one to keep, and this is the case that
 * would silently invert if the comparison were tightened to a strict less-than.
 */
ZTEST(phonequeue, test_at_equal_rank_the_newer_sample_wins)
{
	struct meshtastic_phoneapi_frame f;
	meshtastic_FromRadio from = meshtastic_FromRadio_init_zero;
	pb_istream_t s;

	for (uint32_t i = 0; i < Q_SIZE; i++) {
		meshtastic_FromRadio t = make_pkt(i + 1U, meshtastic_PortNum_TELEMETRY_APP);

		zassert_ok(meshtastic_phoneapi_enqueue_fromradio(&api, &t));
	}

	meshtastic_FromRadio newer = make_pkt(99, meshtastic_PortNum_TELEMETRY_APP);

	zassert_ok(meshtastic_phoneapi_enqueue_fromradio(&api, &newer));

	zassert_true(meshtastic_phoneapi_pop_frame(&api, &f));
	s = pb_istream_from_buffer(f.data, f.len);
	zassert_true(pb_decode(&s, meshtastic_FromRadio_fields, &from));
	zassert_equal(from.packet.id, 2U,
		      "the oldest sample should have gone, not the incoming one");
}

ZTEST_SUITE(phonequeue, NULL, NULL, phonequeue_before, NULL, NULL);
```

## src/sched.c
```c
/* SPDX-License-Identifier: GPL-3.0
 *
 * Unit tests for the scheduler / QoS policy surface (meshtastic_sched).
 * Deterministic, no radio — verifies tier mapping, knob parsing, presets, and
 * stats accounting. The concurrency behavior of the priority egress queue is
 * exercised separately (hardware pass / gated-mock test).
 */

#include <errno.h>

#include <zephyr/ztest.h>

#include <zephyr/meshtastic/meshtastic.h>

#include "meshtastic_sched.h"

static void sched_before(void *fixture)
{
	ARG_UNUSED(fixture);
	meshtastic_sched_defaults();
	meshtastic_sched_stats_reset();
}

ZTEST_SUITE(sched, NULL, NULL, sched_before, NULL, NULL);

ZTEST(sched, test_compiled_defaults)
{
	const struct meshtastic_sched_config *c = meshtastic_sched_get();

	zassert_equal(c->tx_order, MT_SCHED_ORDER_PRIORITY, "default order should be priority");
	zassert_equal(c->tx_overflow, MT_SCHED_OVF_DROP_LOWEST, "default overflow should drop-lowest");
	zassert_true(c->tx_depth >= 1, "depth must be positive");
	zassert_equal(c->phone_evict, MT_SCHED_PHONE_PROTECT, "default phone evict should protect");
	zassert_true(c->airtime_max_util > 0 && c->airtime_max_util <= 100,
		     "default airtime gate should be enabled and a valid percent");
	zassert_true(c->dedup_ttl_sec > 0, "default dedup TTL should be enabled");
	zassert_true(c->reliable_retries > 0, "default reliable retries should be enabled");
	zassert_equal(c->reliable_timeout_ms, 0,
		      "default reliable timeout 0 = airtime-adaptive (mirror upstream)");
}

ZTEST(sched, test_tier_mapping)
{
	zassert_equal(meshtastic_sched_tier_for(MESHTASTIC_PORT_ROUTING), MT_SCHED_TIER_ACK);
	zassert_equal(meshtastic_sched_tier_for(MESHTASTIC_PORT_POSITION), MT_SCHED_TIER_BG);
	zassert_equal(meshtastic_sched_tier_for(MESHTASTIC_PORT_TELEMETRY), MT_SCHED_TIER_BG);
	zassert_equal(meshtastic_sched_tier_for(MESHTASTIC_PORT_NODEINFO), MT_SCHED_TIER_BG);
	zassert_equal(meshtastic_sched_tier_for(MESHTASTIC_PORT_NODE_STATUS), MT_SCHED_TIER_BG);
	zassert_equal(meshtastic_sched_tier_for(MESHTASTIC_PORT_NEIGHBORINFO), MT_SCHED_TIER_BG);
	zassert_equal(meshtastic_sched_tier_for(MESHTASTIC_PORT_MESH_BEACON), MT_SCHED_TIER_BG);
	zassert_equal(meshtastic_sched_tier_for(MESHTASTIC_PORT_TEXT_MESSAGE), MT_SCHED_TIER_NORMAL);
	/* Unknown portnum falls back to NORMAL, never dropped as background. */
	zassert_equal(meshtastic_sched_tier_for(12345U), MT_SCHED_TIER_NORMAL);
}

ZTEST(sched, test_set_valid_knobs)
{
	zassert_ok(meshtastic_sched_set("tx.order", "fifo"));
	zassert_equal(meshtastic_sched_get()->tx_order, MT_SCHED_ORDER_FIFO);
	zassert_ok(meshtastic_sched_set("tx.order", "priority"));
	zassert_equal(meshtastic_sched_get()->tx_order, MT_SCHED_ORDER_PRIORITY);

	zassert_ok(meshtastic_sched_set("tx.overflow", "drop-newest"));
	zassert_equal(meshtastic_sched_get()->tx_overflow, MT_SCHED_OVF_DROP_NEWEST);
	zassert_ok(meshtastic_sched_set("tx.overflow", "drop-lowest"));
	zassert_equal(meshtastic_sched_get()->tx_overflow, MT_SCHED_OVF_DROP_LOWEST);

	zassert_ok(meshtastic_sched_set("tx.depth", "3"));
	zassert_equal(meshtastic_sched_get()->tx_depth, 3);

	zassert_ok(meshtastic_sched_set("phone.evict", "drop-oldest"));
	zassert_equal(meshtastic_sched_get()->phone_evict, MT_SCHED_PHONE_DROP_OLDEST);
	zassert_ok(meshtastic_sched_set("phone.evict", "protect"));
	zassert_equal(meshtastic_sched_get()->phone_evict, MT_SCHED_PHONE_PROTECT);

	zassert_ok(meshtastic_sched_set("airtime.max", "0"));
	zassert_equal(meshtastic_sched_get()->airtime_max_util, 0);
	zassert_ok(meshtastic_sched_set("airtime.max", "55"));
	zassert_equal(meshtastic_sched_get()->airtime_max_util, 55);

	zassert_ok(meshtastic_sched_set("dedup.ttl", "0"));
	zassert_equal(meshtastic_sched_get()->dedup_ttl_sec, 0);
	zassert_ok(meshtastic_sched_set("dedup.ttl", "600"));
	zassert_equal(meshtastic_sched_get()->dedup_ttl_sec, 600);

	zassert_ok(meshtastic_sched_set("reliable.retries", "0"));
	zassert_equal(meshtastic_sched_get()->reliable_retries, 0);
	zassert_ok(meshtastic_sched_set("reliable.retries", "5"));
	zassert_equal(meshtastic_sched_get()->reliable_retries, 5);
	zassert_ok(meshtastic_sched_set("reliable.timeout", "2500"));
	zassert_equal(meshtastic_sched_get()->reliable_timeout_ms, 2500);
}

ZTEST(sched, test_set_invalid_rejected)
{
	uint8_t depth_before = meshtastic_sched_get()->tx_depth;

	zassert_equal(meshtastic_sched_set("bogus.key", "x"), -ENOENT);
	zassert_equal(meshtastic_sched_set("tx.order", "sideways"), -EINVAL);
	zassert_equal(meshtastic_sched_set("tx.overflow", "explode"), -EINVAL);
	zassert_equal(meshtastic_sched_set("tx.depth", "0"), -EINVAL);
	zassert_equal(meshtastic_sched_set("tx.depth", "99999"), -EINVAL);
	zassert_equal(meshtastic_sched_set("tx.depth", "notanumber"), -EINVAL);
	zassert_equal(meshtastic_sched_set("phone.evict", "maybe"), -EINVAL);
	zassert_equal(meshtastic_sched_set("airtime.max", "101"), -EINVAL);
	zassert_equal(meshtastic_sched_set("airtime.max", "-1"), -EINVAL);
	zassert_equal(meshtastic_sched_set("dedup.ttl", "70000"), -EINVAL);
	zassert_equal(meshtastic_sched_set("reliable.retries", "11"), -EINVAL);
	zassert_equal(meshtastic_sched_set("reliable.timeout", "10"), -EINVAL);

	/* A rejected set must not mutate state. */
	zassert_equal(meshtastic_sched_get()->tx_depth, depth_before);
}

ZTEST(sched, test_presets)
{
	zassert_ok(meshtastic_sched_apply_preset("no-backoff"));
	zassert_equal(meshtastic_sched_get()->tx_order, MT_SCHED_ORDER_FIFO,
		      "no-backoff must be FIFO for A/B comparison");
	zassert_equal(meshtastic_sched_get()->tx_overflow, MT_SCHED_OVF_DROP_NEWEST);
	zassert_equal(meshtastic_sched_get()->airtime_max_util, 0,
		      "no-backoff disables the airtime gate");
	zassert_equal(meshtastic_sched_get()->dedup_ttl_sec, 0,
		      "no-backoff uses a never-expiring dedup ring");

	zassert_ok(meshtastic_sched_apply_preset("default"));
	zassert_equal(meshtastic_sched_get()->tx_order, MT_SCHED_ORDER_PRIORITY);

	zassert_equal(meshtastic_sched_apply_preset("does-not-exist"), -ENOENT);

	/* Every advertised preset name must actually apply. */
	for (int i = 0; meshtastic_sched_preset_name(i) != NULL; i++) {
		zassert_ok(meshtastic_sched_apply_preset(meshtastic_sched_preset_name(i)),
			   "advertised preset '%s' failed to apply",
			   meshtastic_sched_preset_name(i));
	}
}

ZTEST(sched, test_stats_accounting)
{
	struct meshtastic_sched_stats st;

	meshtastic_sched_stat_enq(MT_SCHED_TIER_ACK, 3);
	meshtastic_sched_stat_enq(MT_SCHED_TIER_BG, 5);
	meshtastic_sched_stat_enq(MT_SCHED_TIER_BG, 2);
	meshtastic_sched_stat_drop(MT_SCHED_TIER_BG);

	meshtastic_sched_stats_get(&st);
	zassert_equal(st.tx_enq[MT_SCHED_TIER_ACK], 1);
	zassert_equal(st.tx_enq[MT_SCHED_TIER_BG], 2);
	zassert_equal(st.tx_drop[MT_SCHED_TIER_BG], 1);
	zassert_equal(st.ob_hiwater, 5, "hi-water tracks the peak occupancy");

	meshtastic_sched_stats_reset();
	meshtastic_sched_stats_get(&st);
	zassert_equal(st.tx_enq[MT_SCHED_TIER_ACK], 0);
	zassert_equal(st.tx_drop[MT_SCHED_TIER_BG], 0);
	zassert_equal(st.ob_hiwater, 0);
}

/* A snapshot must return a whole, self-consistent policy: every field belongs to
 * the same preset, and it tracks committed writes. */
ZTEST(sched, test_snapshot_coherent)
{
	struct meshtastic_sched_config snap;

	zassert_ok(meshtastic_sched_apply_preset("no-backoff"));
	meshtastic_sched_snapshot(&snap);
	zassert_equal(snap.tx_order, MT_SCHED_ORDER_FIFO);
	zassert_equal(snap.tx_overflow, MT_SCHED_OVF_DROP_NEWEST);
	zassert_equal(snap.phone_evict, MT_SCHED_PHONE_DROP_OLDEST);
	zassert_equal(snap.airtime_max_util, 0, "no-backoff bundle must be coherent");
	zassert_equal(snap.dedup_ttl_sec, 0, "no-backoff bundle must be coherent");

	zassert_ok(meshtastic_sched_apply_preset("default"));
	meshtastic_sched_snapshot(&snap);
	zassert_equal(snap.tx_order, MT_SCHED_ORDER_PRIORITY);
	zassert_true(snap.airtime_max_util > 0 && snap.dedup_ttl_sec > 0);

	/* A snapshot reflects an individual committed knob change. */
	zassert_ok(meshtastic_sched_set("airtime.max", "17"));
	meshtastic_sched_snapshot(&snap);
	zassert_equal(snap.airtime_max_util, 17);
	/* ...and agrees with the live pointer for that field. */
	zassert_equal(snap.airtime_max_util, meshtastic_sched_get()->airtime_max_util);
}

ZTEST(sched, test_airtime_and_dedup_stats)
{
	struct meshtastic_sched_stats st;

	meshtastic_sched_stat_airtime_drop();
	meshtastic_sched_stat_airtime_drop();
	meshtastic_sched_stat_dedup_expired();

	meshtastic_sched_stats_get(&st);
	zassert_equal(st.tx_airtime_drop, 2);
	zassert_equal(st.dedup_expired, 1);
}

/* Changing modes must zero the drop counters so each policy is measured from a
 * clean slate. */
ZTEST(sched, test_stats_reset_on_mode_change)
{
	struct meshtastic_sched_stats st;

	/* A committed `set` resets. */
	meshtastic_sched_stat_drop(MT_SCHED_TIER_BG);
	meshtastic_sched_stat_airtime_drop();
	zassert_ok(meshtastic_sched_set("tx.depth", "5"));
	meshtastic_sched_stats_get(&st);
	zassert_equal(st.tx_drop[MT_SCHED_TIER_BG], 0, "set must reset drop stats");
	zassert_equal(st.tx_airtime_drop, 0);

	/* A rejected `set` must NOT reset. */
	meshtastic_sched_stat_drop(MT_SCHED_TIER_BG);
	zassert_equal(meshtastic_sched_set("tx.depth", "0"), -EINVAL);
	meshtastic_sched_stats_get(&st);
	zassert_equal(st.tx_drop[MT_SCHED_TIER_BG], 1, "rejected set must not reset stats");

	/* Applying a preset resets. */
	zassert_ok(meshtastic_sched_apply_preset("no-backoff"));
	meshtastic_sched_stats_get(&st);
	zassert_equal(st.tx_drop[MT_SCHED_TIER_BG], 0, "preset must reset drop stats");

	/* defaults() resets. */
	meshtastic_sched_stat_phone_drop(true);
	meshtastic_sched_defaults();
	meshtastic_sched_stats_get(&st);
	zassert_equal(st.phone_drop, 0, "defaults must reset drop stats");
}
```

## src/txpower.c
```c
/* Transmit-power resolution and FEM gain conversion.
 *
 * `LoRaConfig.tx_power` is power at the ANTENNA in the reference firmware. These
 * tests pin both halves of restoring that meaning here: resolving a configured
 * value against the region's regulatory limit, and converting the result into
 * the drive level a board with a PA front-end must program.
 *
 * SPDX-License-Identifier: GPL-3.0
 */

#include <zephyr/ztest.h>

#include <zephyr/meshtastic/fem.h>

#include <zephyr/meshtastic/nodedb.h>

#include "meshtastic_tx_power.h"

/* The reference firmware's tables (LoRaFEMInterface.cpp), indexed by drive dBm. */
static const uint8_t gain_gc1109[] = {
	11, 11, 11, 11, 11, 11, 11, 11, 11, 11, 11, 11, 11, 11, 11, 11, 10, 10, 9, 9, 8, 7,
};
static const uint8_t gain_kct8103l[] = {
	13, 13, 13, 13, 13, 13, 13, 13, 13, 13, 13, 13, 13, 13, 12, 12, 11, 11, 10, 9, 8, 7,
};

/* 0 means "as much as this region allows" -- NOT the no-limit fallback. The US
 * limit is 30 dBm, and reading 17 here was the bug: 17 is what the reference
 * uses only for a region with no declared limit at all. */
ZTEST(txpower, test_zero_resolves_to_region_limit)
{
	zassert_equal(30, meshtastic_tx_power_resolve(
				  0, meshtastic_Config_LoRaConfig_RegionCode_US, false),
		      "US tx_power=0 must resolve to the 30 dBm regional limit");
	zassert_equal(27, meshtastic_tx_power_resolve(
				  0, meshtastic_Config_LoRaConfig_RegionCode_EU_868, false),
		      "EU_868 tx_power=0 must resolve to 27 dBm");
}

/* An explicit request below the limit is the operator's to make. */
ZTEST(txpower, test_explicit_value_is_kept)
{
	zassert_equal(20, meshtastic_tx_power_resolve(
				  20, meshtastic_Config_LoRaConfig_RegionCode_US, false));
}

/* Over the limit is clamped for an unlicensed operator, and honoured for a
 * licensed one (reference: `power > powerLimit && !is_licensed`). */
ZTEST(txpower, test_over_limit_clamped_unless_licensed)
{
	zassert_equal(27, meshtastic_tx_power_resolve(
				  33, meshtastic_Config_LoRaConfig_RegionCode_EU_868, false),
		      "unlicensed over-limit request must clamp to the region limit");
	zassert_equal(33, meshtastic_tx_power_resolve(
				  33, meshtastic_Config_LoRaConfig_RegionCode_EU_868, true),
		      "a licensed operator is not clamped");
}

/* UNSET must not resolve to 0 -- it takes the build's default region. */
ZTEST(txpower, test_unset_region_resolves)
{
	zassert_not_equal(0, meshtastic_tx_power_resolve(
				     0, meshtastic_Config_LoRaConfig_RegionCode_UNSET, false));
}

/* The conversion's defining property: asking for N dBm at the antenna must
 * program a drive level whose drive+gain lands back on N. This is the check
 * that would have failed on the pre-fix firmware, which programmed N directly
 * and so radiated N+gain. */
ZTEST(txpower, test_gain_convert_round_trips)
{
	for (int8_t want = 14; want <= 22; want++) {
		int8_t drive = meshtastic_fem_gain_convert(gain_kct8103l,
							   ARRAY_SIZE(gain_kct8103l), want);

		zassert_true(drive >= 0 && drive < (int8_t)ARRAY_SIZE(gain_kct8103l),
			     "drive %d out of table range for %d dBm", drive, want);
		zassert_equal(want, drive + (int8_t)gain_kct8103l[drive],
			      "asking for %d dBm gave drive %d (+%u dB) = %d", want, drive,
			      gain_kct8103l[drive], drive + gain_kct8103l[drive]);
	}
}

/* Worked example from the reference table, both front-ends: 20 dBm radiated is
 * drive 7 on the KCT8103L (7+13) and drive 9 on the GC1109 (9+11). */
ZTEST(txpower, test_gain_convert_known_points)
{
	zassert_equal(7, meshtastic_fem_gain_convert(gain_kct8103l, ARRAY_SIZE(gain_kct8103l),
						     20));
	zassert_equal(9, meshtastic_fem_gain_convert(gain_gc1109, ARRAY_SIZE(gain_gc1109), 20));
}

/* A request the FEM cannot reach even at full drive falls through to the last
 * table entry rather than running off the end. 30 dBm is exactly this case on
 * both parts, and it is the US default, so it is the common path. */
ZTEST(txpower, test_gain_convert_unreachable_request)
{
	zassert_equal(23, meshtastic_fem_gain_convert(gain_kct8103l,
						      ARRAY_SIZE(gain_kct8103l), 30),
		      "30 dBm exceeds the FEM's reach; expect request minus the top gain");
}

/* No table (detection failed, or a board with no FEM) must be the identity --
 * under-driving is the safe direction to fail in. */
ZTEST(txpower, test_gain_convert_without_table_is_identity)
{
	zassert_equal(17, meshtastic_fem_gain_convert(NULL, 0, 17));
	zassert_equal(17, meshtastic_fem_gain_convert(gain_kct8103l, 0, 17));
}

/*
 * The identity above is right for BOTH "no front-end" and "detection failed",
 * which is exactly why those two must stay tellable apart somewhere else: the
 * power conversion cannot distinguish them and neither could the diagnostic,
 * which printed "none fitted, or detection did not complete" and left the
 * reader to guess. On a Heltec V4 the second case is silently 11-13 dB of lost
 * transmit power; on a XIAO the first case is simply correct.
 *
 * native_sim compiles no board file, so the weak default is what is under test
 * here -- and NONE is the right weak answer, because a board that detects at
 * runtime is obliged to override it (the V4 file does, and starts at FAILED so
 * an early return cannot masquerade as a bare transceiver).
 */
ZTEST(txpower, test_fem_state_weak_default_is_none_not_failed)
{
	zassert_equal(MESHTASTIC_FEM_STATE_NONE, meshtastic_radio_fem_state(),
		      "a board with no FEM hook must report NONE -- reporting FAILED would "
		      "make every bare-transceiver board look broken");
}

/* NONE must be the zero value: a memset-cleared report struct has to mean "no
 * front-end", not "detection failed", or a field nobody populated would raise
 * a fault that does not exist. */
ZTEST(txpower, test_fem_state_none_is_the_zero_value)
{
	zassert_equal(0, (int)MESHTASTIC_FEM_STATE_NONE);
	zassert_not_equal(0, (int)MESHTASTIC_FEM_STATE_FAILED);
	zassert_not_equal(0, (int)MESHTASTIC_FEM_STATE_MISMATCH);
	zassert_not_equal(0, (int)MESHTASTIC_FEM_STATE_DETECTED);
}

/*
 * The safety property behind the V4 board file's choice of starting gain table:
 * when the fitted part is UNKNOWN, converting with the highest-gain table can
 * never radiate above the request, whichever part is actually there.
 *
 * The board powers its FEM rail before it reads the detect line, so a failed
 * read leaves the front-end possibly ENABLED and unidentified. Converting with
 * the identity there (what the code did until 2026-09-02, under a comment
 * calling it the safe direction) drives the full request into ~13 dB of gain.
 * This asserts the direction rather than the mechanism, so it keeps holding if
 * the tables are ever re-sourced.
 */
ZTEST(txpower, test_unknown_fem_assumption_never_over_radiates)
{
	/* Every radiated request a region can ask for, per meshtastic_tx_power_resolve. */
	for (int8_t want = 1; want <= 33; want++) {
		int8_t drive = meshtastic_fem_gain_convert(gain_kct8103l,
							   ARRAY_SIZE(gain_kct8103l), want);

		/* Whichever part is really fitted, radiated = drive + that part's gain
		 * at that drive level. Assuming the biggest table must not let either
		 * real part exceed the request. */
		for (size_t i = 0; i < ARRAY_SIZE(gain_gc1109); i++) {
			if ((int)i != (int)drive) {
				continue;
			}
			zassert_true((int)drive + (int)gain_gc1109[i] <= (int)want,
				     "GC1109 fitted, KCT assumed: %d dBm drive + %u dB "
				     "would radiate above the %d dBm requested",
				     drive, gain_gc1109[i], want);
			zassert_true((int)drive + (int)gain_kct8103l[i] <= (int)want,
				     "KCT8103L fitted and assumed: %d dBm drive + %u dB "
				     "would radiate above the %d dBm requested",
				     drive, gain_kct8103l[i], want);
		}
	}
}

/* And the converse, which is what makes the choice above the RIGHT one rather
 * than merely a cautious one: assuming the SMALLER table while the bigger part
 * is fitted does over-radiate. Documents the trap so nobody "simplifies" the
 * board file back to a single shared table. */
ZTEST(txpower, test_assuming_the_smaller_gain_would_over_radiate)
{
	int8_t drive = meshtastic_fem_gain_convert(gain_gc1109, ARRAY_SIZE(gain_gc1109), 14);

	zassert_true((int)drive + (int)gain_kct8103l[drive] > 14,
		     "assuming GC1109 (11 dB) while a KCT8103L (13 dB) is fitted must be "
		     "the direction that radiates hot — if this ever stops being true the "
		     "tables have changed and the board file's assumption needs revisiting");
}

/*
 * Strong override of the weak board hook. native_sim compiles no board file, so
 * without this every conversion is the identity and the licence gate below
 * cannot be observed at all. Uses the real KCT8103L table so the numbers are the
 * ones a Heltec V4 rev 4.3 actually produces.
 */
int8_t meshtastic_radio_fem_tx_power_conversion(int8_t radiated_dbm)
{
	return meshtastic_fem_gain_convert(gain_kct8103l, ARRAY_SIZE(gain_kct8103l), radiated_dbm);
}

/* The default weak hook is the identity, and the clamp bounds the result to
 * what the transceiver can actually be set to.
 *
 * The clamp is NOT licence-gated — it is the transceiver's electrical range,
 * not a regulation — so both operators land on the same rails. */
ZTEST(txpower, test_chip_drive_clamped_to_radio_range)
{
	zassert_equal(CONFIG_MESHTASTIC_RADIO_MAX_TX_POWER,
		      meshtastic_tx_power_chip_drive(127, false));
	zassert_equal(CONFIG_MESHTASTIC_RADIO_MIN_TX_POWER,
		      meshtastic_tx_power_chip_drive(-128, false));
	zassert_equal(CONFIG_MESHTASTIC_RADIO_MAX_TX_POWER,
		      meshtastic_tx_power_chip_drive(127, true));
	zassert_equal(CONFIG_MESHTASTIC_RADIO_MIN_TX_POWER,
		      meshtastic_tx_power_chip_drive(-128, true));
}

/*
 * The INT8_MIN case above is the one that found a real defect, so it gets its
 * own name rather than hiding inside a clamp test.
 *
 * meshtastic_fem_gain_convert() subtracts the front-end's gain from the request.
 * At the bottom of the range that subtraction used to overflow int8_t —
 * -128 - 13 wraps to +115 — and the clamp then pinned it to the radio's
 * MAXIMUM. A request for minimum power returning maximum power is the worst
 * possible direction for that bug to fail in, and it stayed invisible until a
 * real gain table was put behind the weak hook.
 *
 * Unreachable from a real config (tx_power_resolve yields ~10..33 dBm), which is
 * exactly why it wants a test: nothing else would ever exercise it.
 */
ZTEST(txpower, test_fem_conversion_saturates_instead_of_wrapping)
{
	zassert_equal(INT8_MIN,
		      meshtastic_fem_gain_convert(gain_kct8103l, ARRAY_SIZE(gain_kct8103l),
						  INT8_MIN),
		      "the gain subtraction must saturate at INT8_MIN, not wrap positive");
}

/*
 * The FEM backoff is skipped for a licensed operator.
 *
 * Reference: RadioInterface::limitPower() applies the conversion only inside
 * `if (!devicestate.owner.is_licensed)`. The backoff exists to keep RADIATED
 * power inside a regulatory limit, and a licensed operator is not bound by that
 * limit — so skipping it is what gives them the extra power the licence allows.
 *
 * This port applied the conversion unconditionally until 2026-08-23, which left
 * a licensed operator on a front-end board radiating roughly 6 dB BELOW vanilla.
 * Pinned here because the failure is entirely silent: nothing logs, nothing
 * errors, the node is simply quieter than the reference for the one class of
 * operator entitled to be louder.
 *
 * native_sim builds no board file, so the weak identity hook is overridden here
 * with a real gain table. Without that the test would be vacuous: with the
 * identity conversion both paths return the same number and the gate could be
 * deleted entirely without failing anything.
 */
ZTEST(txpower, test_licensed_operator_keeps_the_full_drive_level)
{
	/* 20 dBm requested, KCT8103L table: the unlicensed path finds drive 7
	 * (7 + 13 = 20 at the antenna). Both are inside the radio's range, so the
	 * clamp cannot mask the difference. */
	zassert_equal(7, meshtastic_tx_power_chip_drive(20, false),
		      "an unlicensed operator must be backed off by the front-end's gain");
	zassert_equal(20, meshtastic_tx_power_chip_drive(20, true),
		      "a licensed operator's request must reach the transceiver un-backed-off");
}

ZTEST_SUITE(txpower, NULL, NULL, NULL, NULL, NULL);

/* --- NodeInfoLite SNR persistence (Q4) -----------------------------------
 *
 * SNR used to be dropped entirely when a node record was written, so a reboot
 * blanked the link-quality column until every peer was heard again. It is now
 * persisted as the Q4 integer the reference uses; these pin that conversion,
 * which is the part that can silently lose sign or precision.
 *
 * Comparisons stay in the integer domain on purpose: Q4's defining property is
 * that a quarter-dB step IS an integer, so a float compare would be testing the
 * test rather than the encoding.
 */

ZTEST(txpower, test_snr_q4_round_trips_at_quarter_db)
{
	for (int q = -80; q <= 80; q++) {
		float db = meshtastic_snr_from_q4(q);

		zassert_equal(q, meshtastic_snr_to_q4(db),
			      "q4 %d -> dB -> q4 did not come back to %d", q, q);
	}
}

/* Negative SNR is the normal case on a real link and must not truncate toward
 * zero: a node at -7.5 dB has to persist as -30, not -29. */
ZTEST(txpower, test_snr_q4_handles_negative_values)
{
	zassert_equal(-30, meshtastic_snr_to_q4(-7.5f));
	zassert_equal(-30, meshtastic_snr_to_q4(meshtastic_snr_from_q4(-30)));
}

/* Off-grid values round to nearest in both directions, rather than toward zero
 * (which would bias every negative reading upward). */
ZTEST(txpower, test_snr_q4_rounds_to_nearest)
{
	zassert_equal(51, meshtastic_snr_to_q4(12.7f));
	zassert_equal(-51, meshtastic_snr_to_q4(-12.7f));
}

/* The range a LoRa radio actually reports (~ -20..+13 dB) maps to |q4| <= 80,
 * which zigzag-encodes in one or two bytes -- the reason to persist this rather
 * than the 5-byte float. */
ZTEST(txpower, test_snr_q4_typical_readings_stay_small)
{
	zassert_equal(52, meshtastic_snr_to_q4(13.0f));
	zassert_equal(-80, meshtastic_snr_to_q4(-20.0f));
}

/* --- sanity bounds --------------------------------------------------------
 *
 * Power is the one setting where a bad value does not produce an obviously
 * broken node — it produces a node transmitting at the wrong level that looks
 * completely healthy. So the arithmetic is pinned at its edges, not just in
 * its normal range.
 */

/*
 * A stored tx_power outside any plausible dBm band must be treated as unset
 * rather than propagated. The realistic source is not malice but a config
 * record written by a different firmware version, or one that got corrupted;
 * either way it must not reach the transceiver.
 */
ZTEST(txpower, test_resolve_rejects_implausible_stored_power)
{
	/* Both of these are "treat as unset", so they resolve to the US limit
	 * exactly as a stored 0 would. */
	zassert_equal(30, meshtastic_tx_power_resolve(
				  INT8_MAX, meshtastic_Config_LoRaConfig_RegionCode_US, false),
		      "an absurdly high stored power must fall back, not be honoured");
	zassert_equal(30, meshtastic_tx_power_resolve(
				  INT8_MIN, meshtastic_Config_LoRaConfig_RegionCode_US, false),
		      "an absurdly low stored power must fall back, not be honoured");

	/* And the licensed path must not become a way to smuggle a nonsense value
	 * through: licensing lifts the REGIONAL clamp, not the sanity bound. */
	zassert_equal(30, meshtastic_tx_power_resolve(
				  INT8_MAX, meshtastic_Config_LoRaConfig_RegionCode_US, true),
		      "a licence must not make an implausible stored power legitimate");
}

/*
 * Whatever the inputs, the value programmed into the transceiver must land
 * inside the radio's electrical range. This sweeps the entire int8_t domain
 * through both licence states, because the point is that NO input escapes.
 */
ZTEST(txpower, test_chip_drive_never_escapes_the_radio_range)
{
	for (int v = INT8_MIN; v <= INT8_MAX; v++) {
		for (int lic = 0; lic <= 1; lic++) {
			int8_t drive = meshtastic_tx_power_chip_drive((int8_t)v, lic != 0);

			zassert_true(drive >= CONFIG_MESHTASTIC_RADIO_MIN_TX_POWER &&
					     drive <= CONFIG_MESHTASTIC_RADIO_MAX_TX_POWER,
				     "drive %d escaped [%d..%d] for input %d (licensed=%d)",
				     drive, CONFIG_MESHTASTIC_RADIO_MIN_TX_POWER,
				     CONFIG_MESHTASTIC_RADIO_MAX_TX_POWER, v, lic);
		}
	}
}

/*
 * Same sweep for the resolver: every input, every region in the enum's range,
 * must come back inside the sane band. A region code we do not know must not
 * produce a wild number — it must fall back.
 */
ZTEST(txpower, test_resolve_always_returns_a_plausible_power)
{
	for (int v = INT8_MIN; v <= INT8_MAX; v += 7) {
		for (int r = 0; r < 32; r++) {
			int8_t p = meshtastic_tx_power_resolve(
				(int8_t)v, (meshtastic_Config_LoRaConfig_RegionCode)r, false);

			zassert_true(p >= -30 && p <= 40,
				     "resolve returned %d dBm for stored %d region %d", p, v, r);
		}
	}
}
```
