## src/Kconfig.nodedb
```kconfig
# Copyright (c) 2026 The Zephyr Project Contributors
# SPDX-License-Identifier: GPL-3.0

menuconfig MESHTASTIC_NODEDB
	bool "Meshtastic in-RAM NodeDB"
	default y
	help
	  Track mesh nodes heard by the Meshtastic subsystem in RAM. Node
	  metadata (names, positions, metrics) is volatile; peer public keys
	  can be persisted to flash (see MESHTASTIC_NODEDB_PERSIST_KEYS).

if MESHTASTIC_NODEDB

config MESHTASTIC_NODEDB_MAX_NODES
	int "Maximum NodeDB entries"
	default 32
	range 1 256
	help
	  Maximum number of nodes kept in the in-RAM Meshtastic NodeDB,
	  including the local node entry.

config MESHTASTIC_NODEDB_PERSIST_KEYS
	bool "Persist peer public keys across reboots"
	depends on MESHTASTIC_SETTINGS
	default y if MESHTASTIC_PKI
	help
	  Persist learned peer X25519 public keys (keyed by node id) to the
	  settings/NVS store and restore them at boot. Without this, every
	  reboot drops all peer keys and PKC direct messages fall back to PSK
	  until each peer re-announces its NodeInfo. Only public keys are
	  stored; names and other metadata stay in the hot store.

config MESHTASTIC_NODEDB_WARM_KEYS
	int "Warm key-tier size"
	depends on MESHTASTIC_NODEDB_PERSIST_KEYS
	default 32
	range 8 512
	help
	  Size of the in-RAM warm key tier: an {id -> X25519 pubkey} cache
	  (~40 bytes/entry), sized larger than the hot NodeDB and mirrored to
	  NVS. A key here stays usable for PKC direct messages after the peer's
	  full record is evicted from the hot store, so PKC reach is decoupled
	  from MESHTASTIC_NODEDB_MAX_NODES. Persisted keys are restored into this
	  tier at boot (not the hot store), so a large key set never thrashes
	  the hot store. Evicts least-recently-seen when full.

config MESHTASTIC_NODEDB_PERSIST_RECORDS
	bool "Persist the node list across reboots"
	depends on MESHTASTIC_SETTINGS
	default y
	help
	  Persist the full identity (name, hardware model, role, flags, public
	  key) plus last-heard time of every node in the hot NodeDB, keyed by
	  node id, to the settings/NVS store, and restore them at boot. Without
	  this, a reboot drops the whole seen-node list until each node
	  re-announces. NVS is kept equal to the hot store (records are pruned on
	  eviction/removal), so it is bounded by MESHTASTIC_NODEDB_MAX_NODES.
	  last-heard is stored as a wall-clock epoch so node recency survives a
	  reboot (see MESHTASTIC_NODEDB_PERSIST_INTERVAL_SEC).

config MESHTASTIC_NODEDB_PERSIST_INTERVAL_SEC
	int "NodeDB last-heard snapshot interval (seconds, 0 = off)"
	depends on MESHTASTIC_NODEDB_PERSIST_RECORDS
	default 300
	range 0 86400
	help
	  How often the full NodeDB is snapshotted to NVS so each node's
	  last-heard time (and any newly seen node) survives a reboot. The
	  settings backend skips unchanged records, so a snapshot only writes
	  nodes actually heard since the previous one. Smaller = fresher
	  last-heard after a reboot, at the cost of more flash writes. 0 disables
	  periodic snapshots; records then persist only on identity change or
	  favorite/ignore toggle (last-heard recency will not survive a reboot).

endif # MESHTASTIC_NODEDB
```
