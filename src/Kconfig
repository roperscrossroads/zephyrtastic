## src/Kconfig.diag_loop
```kconfig
# SPDX-License-Identifier: GPL-3.0

config MESHTASTIC_DIAG_LOOP_STACK_SIZE
	int "Stack size for the combined thread-summary/supervisor diagnostic loop"
	default 2048
	depends on MESHTASTIC_THREAD_SUMMARY || MESHTASTIC_SUPERVISOR
	help
	  agents-wu94.12.1: mt_thread_summary (was CONFIG_MESHTASTIC_THREAD_SUMMARY_STACK_SIZE,
	  2048 B) and mt_supervisor_thread (was CONFIG_MESHTASTIC_SUPERVISOR_STACK_SIZE,
	  4096 B) merged onto one thread with one stack, replacing both symbols with
	  this one.

	  2026-09-21: deliberately provoking the supervisor's alert() path on real hardware
	  (rzr4, class 6) found a genuine crash-loop, not a tight margin -- confirmed via a
	  full decoded backtrace (Xtensa EXCCAUSE 63, Zephyr's own z_check_stack_sentinel
	  catching a real overflow): thread_analyzer_run()'s callback calling check_thread()
	  for mt_diag_loop's OWN entry, once it crosses CONFIG_MESHTASTIC_SUPERVISOR_STACK_WARN_PCT,
	  fires alert() -> alert_phone() -> meshtastic_phoneapi_on_packet() ->
	  meshtastic_phoneapi_enqueue_fromradio() (672 B alone, measured with -fstack-usage)
	  -> meshtastic_phoneapi_notify_data_ready() -> a BLE work-queue submit -> a kernel
	  reschedule -- roughly 1.6 KB of measured frames across ~13 nested calls, all
	  running on mt_diag_loop's own stack, self-referentially triggered by mt_diag_loop
	  warning about its own stack pressure. Doubling this Kconfig's default to 4096 B did
	  NOT fix it -- identical crash, identical ~41 s timing, both sizes -- because the
	  true worst case was never a sizing problem: nobody had ever measured this specific
	  chain (it was pure dead code until the alert path actually fired), and its depth
	  isn't a small fixed increment over the routine 39-53%/2048 B baseline.

	  FIX (2026-09-21, agents-wu94.12.1): alert()'s actual phoneapi send moved off this
	  thread entirely, onto a dedicated worker (CONFIG_MESHTASTIC_SUPERVISOR_ALERT_STACK_SIZE,
	  Kconfig.supervisor) -- the same "isolate the deep call chain onto its own measured
	  thread" pattern agents-ooma.35 already proved for XEdDSA signing two days earlier
	  in this codebase (main/src/meshtastic_pki.c). mt_diag_loop itself never runs that
	  chain anymore, so its own worst case is back to the routine sweep+dispatch cost --
	  2048 B restores real margin over the 39-53% baseline this Kconfig was originally
	  sized from, which was always accurate; it was the untested alert path riding on
	  the SAME stack that was the actual defect, not this number.
```

## src/Kconfig.duty
```kconfig
# SPDX-License-Identifier: GPL-3.0

menuconfig MESHTASTIC_DUTY_CYCLE
	bool "Enforce the regional regulatory duty cycle"
	depends on MESHTASTIC_AIRTIME
	default y
	help
	  Refuse egress once the rolling one-hour TX-utilization window exceeds the
	  ceiling the active region mandates -- EU_868 10 %, EU_866 2.5 % (10 % for
	  a router), EU_433 and TH 10 %, UA_868 1 %. Regions with no ceiling (US,
	  ANZ, ...) carry 100 % and are unaffected, so this costs them nothing but
	  a float compare per send.

	  The ceilings have always been in the region tables; until now nothing
	  read them, so a node in a restricted region transmitted past the legal
	  limit without limit (docs/parity/OPEN-DIVERGENCES.md, DUTY).

	  This is a REFUSAL, not a throttle, and it applies to RELAYS as well as to
	  this node's own traffic -- airtime is airtime regardless of whose packet
	  it was. It is a different mechanism from the airtime gate under `sched
	  airtime.max`, which throttles only our own background beacons out of
	  politeness to a busy channel. Both run.

	  A refused frame that this node originated produces a DUTY_CYCLE_LIMIT
	  routing NAK to the phone, so the app can say why a message did not go,
	  and `meshtastic duty` reports the ceiling, the current window and the
	  refusal counters.

	  config.lora.override_duty_cycle disables enforcement at runtime, as
	  upstream does. Turning it on logs a warning: it is a deliberate choice to
	  transmit past a legal ceiling and the log is the only record of it.
```

## src/Kconfig.environment_metrics
```kconfig
# Copyright (c) 2026 The Zephyr Project Contributors
# SPDX-License-Identifier: GPL-3.0

menuconfig MESHTASTIC_ENVIRONMENT_METRICS
	bool "Meshtastic environment metrics telemetry"
	depends on SENSOR
	select REQUIRES_FLOAT_PRINTF
	help
	  Read temperature/humidity/pressure/gas/light sensors via the
	  ambient_temp0, humidity0, pressure_sensor, gas_sensor and
	  light_sensor devicetree aliases and broadcast Meshtastic
	  EnvironmentMetrics Telemetry. Only quantities whose alias exists
	  and is "okay" are compiled in.

if MESHTASTIC_ENVIRONMENT_METRICS

config MESHTASTIC_ENVIRONMENT_METRICS_AUTO_SEND
	bool "Automatically send environment metrics"
	default y
	help
	  Send environment metrics periodically after meshtastic_init().

	  This is the first-boot seed for ModuleConfig.telemetry's
	  environment_measurement_enabled: the phone can turn the
	  broadcast on or off afterwards. The reference ships it OFF (stock
	  2.7 broadcasts no environment metrics until the user enables them);
	  this port defaults to ON so a bench node announces itself without
	  a phone. Set =n for parity with stock.

config MESHTASTIC_ENVIRONMENT_METRICS_INTERVAL_SEC
	int "Environment metrics send interval in seconds"
	default 3600
	range 30 86400
	help
	  Interval between automatic environment metrics Telemetry packets.
	  Defaults to 3600 s to match the reference client cadence
	  (default_telemetry_broadcast_interval_secs); 900 s was ~4x chattier.

endif # MESHTASTIC_ENVIRONMENT_METRICS
```

## src/Kconfig.extnotify
```kconfig
# Copyright (c) 2026 The Zephyr Project Contributors
# SPDX-License-Identifier: GPL-3.0

menuconfig MESHTASTIC_EXTNOTIFY
	bool "Meshtastic external notification (board LED)"
	default y
	depends on GPIO
	help
	  The reference ExternalNotificationModule's generic output role: on an
	  incoming text (TEXT_MESSAGE_APP, ALERT_APP, DETECTION_SENSOR_APP) from
	  another node, drive the board's led0 for output_ms, or toggle it every
	  output_ms for nag_timeout seconds; alert_message fires on any
	  non-muted message, alert_bell on one carrying an ASCII BEL (0x07).
	  Driven by ModuleConfig.external_notification, applied live.

	  What this port cannot drive is refused at write time rather than
	  stored and ignored: a raw pin number in `output` (0 = the board LED is
	  the only meaning here), vibra and buzzer outputs and their alert
	  flags, PWM/I2S ringtone playback (set_ringtone is refused too). A
	  board with no led0 alias refuses `enabled`.

if MESHTASTIC_EXTNOTIFY

config MESHTASTIC_EXTNOTIFY_SEED_ENABLED
	bool "First-boot default: enabled"
	default n
	help
	  The reference ships the module enabled on boards that define a
	  notification output. Off here by default: a bench node blinking on
	  every text is a surprise, not a feature. The rest of the seed matches
	  the reference (active-high, alert on message, 1000 ms, 60 s nag).

endif # MESHTASTIC_EXTNOTIFY
```

## src/Kconfig.health
```kconfig
# SPDX-License-Identifier: GPL-3.0

config MESHTASTIC_HEALTH_REPORT
	bool "Announce an abnormal boot to a named health channel"
	default n
	depends on MESHTASTIC_BOOTLOG
	help
	  Phase 4 of the diagnostics-baseline plan: rung 4 of
	  Kconfig.supervisor's escalation ladder, the only rung that costs
	  airtime. On a boot with a pending crash breadcrumb (watchdog channel
	  timeout, hw-watchdog stage-0, or fatal error -- see
	  zephyr/meshtastic/diagnostics.h), broadcasts a small fixed struct
	  (boot number, reset-cause bits, MESHTASTIC_BOOT_F_* flags, previous
	  uptime, which breadcrumb fired) on MESHTASTIC_PORT_HEALTH -- boot
	  number and cause bits ONLY, never thread names, free text, or config
	  values. OBSERVABILITY-AND-COURIER.md §6 is explicit that a free-form
	  event channel is a way past the secret boundary the cluster
	  enforces; this stays a closed allowlist on purpose.

	  Resolved BY NAME at send time, never cached, exactly like
	  meshtastic_cluster.c's channel binding: if no channel named
	  MESHTASTIC_HEALTH_CHANNEL_NAME is provisioned, this idles with no
	  primary fallback, ever. That makes the feature structurally unable
	  to leak onto the public mesh, which the standing rule calls
	  read-only territory. Default n; the fleet overlay turns it on, and
	  even then it stays inert until a "health" channel actually exists.

	  Crash-loop guard, from meshtastic_bootlog.c's already-retained
	  history (nothing new stored): the 1st abnormal boot in a run
	  announces after MESHTASTIC_HEALTH_ANNOUNCE_DELAY_1ST_S; a 2nd
	  consecutive short-lived boot waits
	  MESHTASTIC_HEALTH_ANNOUNCE_DELAY_2ND_S; a 3rd and beyond stays
	  SILENT and only counts in `stats list` (group mt_health) -- a node
	  stuck in a boot loop therefore produces LESS traffic over time, not
	  more, the same shape as the courier's re-arm health window
	  (DECLARATIVE-FLEET.md §18.3, "so a boot loop cannot become a push
	  loop").

if MESHTASTIC_HEALTH_REPORT

config MESHTASTIC_HEALTH_CHANNEL_NAME
	string "Health channel name"
	default "health"
	help
	  Case-sensitive exact match against a provisioned, non-disabled
	  channel's name, checked fresh on every announce -- see the parent
	  help text for why this is never cached.

config MESHTASTIC_HEALTH_SHORT_UPTIME_S
	int "Previous-run length (seconds) below which a boot counts as a loop"
	default 120
	help
	  Read against meshtastic_boot_record.prev_uptime_s in the retained
	  history. A prev_uptime_s of 0 (unknown) is treated as NOT part of a
	  loop -- ambiguous data does not extend the streak either way.

config MESHTASTIC_HEALTH_ANNOUNCE_DELAY_1ST_S
	int "Delay before the 1st abnormal-boot announcement (seconds)"
	default 30
	help
	  Startup delay so the announcement does not race radio bring-up --
	  the send goes out over meshtastic_send_packet() like any other
	  originated traffic, which needs the stack fully initialized.

config MESHTASTIC_HEALTH_ANNOUNCE_DELAY_2ND_S
	int "Delay before a 2nd consecutive short-lived boot's announcement (seconds)"
	default 300
	help
	  Longer than the 1st-boot delay on purpose: escalating backoff is
	  the crash-loop guard itself, not just a courtesy delay.

endif # MESHTASTIC_HEALTH_REPORT
```

## src/Kconfig.heap_trace
```kconfig
# SPDX-License-Identifier: GPL-3.0

config MESHTASTIC_HEAP_TRACE
	bool "Trace every _system_heap alloc/free to the log (diagnostic)"
	default n
	select SYS_HEAP_LISTENER
	help
	  Registers a Zephyr heap_listener on _system_heap (the general k_malloc
	  pool sized by CONFIG_HEAP_MEM_POOL_SIZE) and logs every allocation and
	  free with its size, pointer, and a running total maintained locally in
	  the listener (not by re-querying the heap, which would deadlock: the
	  listener callback runs with the heap's own spinlock held).

	  Built to answer a specific question: the periodic heap heartbeat
	  (meshtastic_watchdog.c) showed a flat steady-state allocated total but
	  a max_allocated (peak-since-boot) that drifted by a couple of KB
	  between boot sessions on the same board/build, with no per-event
	  visibility into what caused it. This turns that "peak observed
	  eventually" signal into an event-by-event timeline: what allocated,
	  how big, and when, correlated against boot time via the existing
	  network log timestamps.

	  Diagnostic only -- off by default. Adds one heap_listener struct pair
	  (~80 B) and a LOG_INF call on every heap event; leave off for normal
	  operation once the question above is answered, since a busy heap
	  (frequent MQTT reconnects, PhoneAPI churn) could log a lot.
```

## src/Kconfig.keyverify
```kconfig
# Copyright (c) 2026 The Zephyr Project Contributors
# SPDX-License-Identifier: GPL-3.0

config MESHTASTIC_KEYVERIFY
	bool "Meshtastic manual key verification (security-number handshake)"
	default y
	depends on MESHTASTIC_PKI && MESHTASTIC_NODEDB
	help
	  The reference KeyVerificationModule: a two-party handshake on
	  KEY_VERIFICATION_APP (port 12) that lets a user confirm, out of band,
	  that a peer holds the private key for the public key we have for it --
	  MitM-resistant -- and, in the bootstrap case, learn a peer's key from
	  the handshake itself. Driven from the app over AdminMessage
	  key_verification (INITIATE / PROVIDE_SECURITY_NUMBER / DO_VERIFY /
	  DO_NOT_VERIFY) or from the shell; prompts reach the app as
	  ClientNotification (number to show, number to enter, final code).
	  On accept the peer's key is committed to the NodeDB with the
	  "key manually verified" flag, which persists.
```

## src/Kconfig.led_status
```kconfig
menuconfig MESHTASTIC_LED_STATUS
	bool "Board LED says whether the node is in use (bench diagnostic)"
	default n
	depends on GPIO
	depends on !MESHTASTIC_EXTNOTIFY
	help
	  Drives the board LED(s) directly, independent of the Meshtastic
	  app/config, to answer the bench's question at a glance: which of
	  these identical boards is in a test, which is free, and which one is
	  the node called rzr5. The host sets the mode from the bench's claims
	  (`meshtastic led mode ...`, tools/leds.sh); the node remembers it.

	    idle     slow blink (red on a XIAO)       -- free, available
	    in-use   solid green on a XIAO, off on a one-LED board
	    locate   fast blink (blue on a XIAO) for a while, then back
	    off      dark

	  A board with green and blue LEDs (led1/led2, the XIAO's RGB) uses the
	  colours; a board with one LED (the Heltecs' white led0) uses the
	  patterns alone.

	  Mutually exclusive with CONFIG_MESHTASTIC_EXTNOTIFY: both want sole
	  ownership of led0, and this module does not arbitrate with it.

if MESHTASTIC_LED_STATUS

config MESHTASTIC_LED_STATUS_LOCATE_SEC
	int "Default locate duration (s)"
	default 30
	range 1 600
	help
	  How long `meshtastic led locate` blinks when no duration is given.

endif # MESHTASTIC_LED_STATUS
```
