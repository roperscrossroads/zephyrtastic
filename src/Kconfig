## src/Kconfig.lockdown
```kconfig
# SPDX-License-Identifier: GPL-3.0

config MESHTASTIC_LOCKDOWN_ANY_SOC
	bool "Allow lockdown on SoCs other than nRF52"
	default n
	depends on MESHTASTIC_SETTINGS && MESHTASTIC_PHONEAPI
	help
	  The reference excludes ESP32 (its flash encryption is the SoC-level tool
	  there). Enable to build the feature elsewhere anyway; the at-rest protection
	  is then only as good as the SoC's protection of its own flash.

menuconfig MESHTASTIC_LOCKDOWN
	bool "Lockdown mode: passphrase-gated, encrypted-at-rest preferences"
	default n
	depends on MESHTASTIC_SETTINGS
	depends on MESHTASTIC_PHONEAPI
	depends on SOC_SERIES_NRF52 || MESHTASTIC_LOCKDOWN_ANY_SOC || ARCH_POSIX
	select HWINFO
	select MBEDTLS
	select PSA_WANT_KEY_TYPE_AES
	select PSA_WANT_ALG_GCM
	select PSA_WANT_ALG_SHA_256
	select PSA_WANT_ALG_HMAC
	select PSA_WANT_KEY_TYPE_HMAC
	select PSA_WANT_ALG_PBKDF2_HMAC
	select PSA_WANT_GENERATE_RANDOM
	help
	  The reference's lockdown_auth (AdminMessage.lockdown_auth, FromRadio.lockdown_status):
	  once a passphrase is provisioned the preference records are stored encrypted
	  (AES-128-GCM under a random DEK that a passphrase-derived KEK wraps), a
	  device-bound unlock token lets the node boot unlocked for N boots / until an
	  epoch / per-session cap, a locked boot keeps the radio silent, and a phone
	  must present the passphrase on each connection before it sees the config
	  or may administer the node. A build with this on but never provisioned
	  behaves exactly like stock. Design: docs/LOCKDOWN-DESIGN.md (workspace).

	  The reference limits it to nRF52 (its crypto and APPROTECT are nRF-bound);
	  here the crypto is PSA and the device id comes from hwinfo, so the gate is
	  a policy choice: MESHTASTIC_LOCKDOWN_ANY_SOC lifts it.

if MESHTASTIC_LOCKDOWN

config MESHTASTIC_LOCKDOWN_PBKDF2_ITERATIONS
	int "PBKDF2-HMAC-SHA256 iterations for the passphrase KEK"
	default 10000
	range 1000 200000
	help
	  The reference derives its KEK with a single SHA-256 over device id and
	  passphrase; this port uses PBKDF2 so a dumped flash costs an attacker this
	  many hashes per guess. On-flash only, never on the air. ~1 s per 10 000 on
	  a Cortex-M4 at unlock time.

config MESHTASTIC_LOCKDOWN_REWRITE_MAX_NAMES
	int "Records collected per direct-written subtree when sealing or unsealing the store"
	default 96
	range 16 512
	help
	  Provisioning seals every record already on flash and a disable writes
	  them back in the clear. Subtrees whose owner exports through the
	  settings callbacks are rewritten by settings_save_subtree(); the ones
	  written record by record (the cluster document, the backup) are
	  collected by name first, this many at a time, because a record cannot
	  be rewritten from inside the backend's own walk. 32 B per name, static.

config MESHTASTIC_LOCKDOWN_DEFAULT_BOOTS
	int "Unlock token boot budget when the client sends 0"
	default 50
	range 1 255
	help
	  Reference TOKEN_DEFAULT_BOOTS.

config MESHTASTIC_LOCKDOWN_SESSION_DEFAULT_SECONDS
	int "Per-boot unlocked-session cap when the client sends 0 (0 = none)"
	default 0
	help
	  Reference MESHTASTIC_LOCKDOWN_SESSION_DEFAULT_SECONDS.

endif # MESHTASTIC_LOCKDOWN
```

## src/Kconfig.logring
```kconfig
# SPDX-License-Identifier: GPL-3.0

config MESHTASTIC_LOGRING
	bool "Keep the last few KB of log in RTC memory across a reset"
	default y
	select LOG_OUTPUT
	select LOG_BACKEND_SUPPORTS_FORMAT_TIMESTAMP
	help
	  Registers a log backend that mirrors the log stream into a byte ring in
	  RTC-persistent memory, and dumps whatever was there from before the last
	  reset on the next boot.

	  Added 2026-08-11. Every other diagnostic here depends on the network:
	  log_backend_net is the only backend on the shipping profile, so a node
	  that loses WiFi is silent by construction, and -- worse -- that backend
	  unconditionally no-ops once LOG_PANIC() runs, which is exactly when the
	  output matters. The crash breadcrumbs exist because of that gap, but a
	  breadcrumb says what state the node was in, not what it was doing. This
	  keeps the actual last log lines.

	  Survives every warm reset (watchdog stage 0/1, software reboot, fatal
	  error) -- which is every failure class the bench has seen. A true power
	  cycle clears RTC memory; the magic check then starts fresh rather than
	  printing garbage.

	  Deliberately NOT flash-backed: an ESP32 flash write disables the
	  instruction cache and blocks non-IRAM ISRs, which is the same
	  interrupt-masking mechanism currently suspected in the 2026-08-11
	  all-three-nodes stall. RTC memory is plain stores.

if MESHTASTIC_LOGRING

config MESHTASTIC_LOGRING_SIZE
	int "Ring size in bytes (RTC memory)"
	default 4096
	range 512 8192
	help
	  Lives in .rtc_noinit, i.e. the 8 KB rtc_slow_seg, which was 2.88% used
	  before this. 4 KB is roughly 30-50 formatted lines -- enough to cover
	  the seconds before a stall without crowding the existing RTC-persistent
	  crash breadcrumbs and reset-cause history that share the segment.

	  NOTE: an equal-sized buffer is also allocated in DRAM, to snapshot the
	  ring at boot before this boot's own logging overwrites it. Budget 2x
	  this value.

config MESHTASTIC_LOGRING_LINE_MAX
	int "Formatting buffer for one log line"
	default 128
	range 64 256
	help
	  Bounds the memcpy done under irq_lock. Longer lines are written in
	  several chunks; only their tail survives if a line exceeds the ring.

config MESHTASTIC_LOGRING_LOG_LEVEL
	int "Log level for the ring module itself"
	default 3
	range 0 4

endif # MESHTASTIC_LOGRING

config MESHTASTIC_LOGRING_FILTER
	bool "Keep per-packet chatter out of the retained ring"
	default y
	help
	  Restrict a curated list of high-volume modules to WRN-or-worse ON THE
	  RING BACKEND ONLY. The console keeps every line; what changes is how far
	  back the ring reaches after a reset.

	  This is the lever that matters, because ring SIZE barely moves. The ring
	  lives in RTC retained memory, which is 8 KB total on the ESP32-S3 and
	  already holds the boot log, the fatal breadcrumb, the watchdog crash info
	  and the persisted clock. Measured 2026-08-30: 4476 B used, so the ring
	  could reach about 7.8 KB and no further -- under 2x. Filtering is not
	  bounded that way.

	  The numbers that motivated the list, from a real 5-hour run (~25,000
	  lines, coredump excluded):

	    powermon: state=            9801   40%   one line per TX/RX transition
	    meshtastic: RX from         4885   20%
	    phone queue full (WRN)      4619   19%   see meshtastic_phoneapi.c
	    Watchdog: system heap       3121   13%
	    thread_summary              ~2600  10%

	  At that verbosity the whole 4 KB ring held about THREE MINUTES. The
	  thread summary runs every 300 s, so the one periodic health record most
	  worth having after a crash could miss the ring entirely.

	  What is deliberately NOT restricted, because it is the narrative you
	  actually read after a reset: `meshtastic` (RX/TX, heartbeat),
	  `meshtastic_sample` (boot cause + crash breadcrumbs), `thread_summary`,
	  and `os` (fault output).

	  Applied lazily on the ring backend's FIRST process() call rather than at
	  init. Before the logging thread's first tick every backend id still reads
	  0, so log_filter_set() would silently write into whatever backend holds
	  slot 0 -- the trap documented at length in meshtastic_netlog_filter.c,
	  which had to hook a network event to dodge it. Owning this backend means
	  the first process() call is a guarantee that ids are real, with no timing
	  guesswork at all.
```

## src/Kconfig.meshbeacon
```kconfig
# Copyright (c) 2026 The Zephyr Project Contributors
# SPDX-License-Identifier: GPL-3.0

menuconfig MESHTASTIC_MESHBEACON
	bool "Meshtastic mesh beacon (partial vs. the reference; unsupported by default)"
	default n
	help
	  The reference MeshBeacon modules: a zero-hop "here is my mesh, join
	  me" announcement on MESH_BEACON_APP (port 37) -- a short text and/or
	  an offered channel (name + PSK), region and modem preset -- and the
	  listener that caches an offer heard for a client app to act on (never
	  applied automatically). Both halves are off until their flag is set
	  in ModuleConfig.mesh_beacon.flags (LISTEN / BROADCAST). Compiles in
	  the MeshBeacon protobuf.

	  OFF BY DEFAULT, deliberately: this port broadcasts on the RUNNING
	  radio config only (the primary channel, or any channel-table slot a
	  target names), whereas the reference switches the radio around each
	  transmission whose target names another modem preset or region --
	  the feature that gives the beacon its targets at all. Rather than
	  ship a module that accepts a config and then does part of it, the
	  module stays out of a default image and the admin path answers a
	  mesh_beacon write with a NAK, exactly as the reference does for an
	  excluded module. Opt in for a bench that wants the supported subset.
	  The gate for flipping this default: the multi-preset arc delivering a
	  hold/restore radio switch (docs/MULTI-PRESET-OPERATION.md).

if MESHTASTIC_MESHBEACON

config MESHTASTIC_MESHBEACON_START_DELAY_SEC
	int "Delay before the first beacon after boot or a config change"
	default 60
	range 1 3600
	help
	  The reference staggers periodic modules a few tens of seconds after
	  boot. A change to the section re-arms from here, so an app user's
	  edits coalesce into one beacon.

config MESHTASTIC_MESHBEACON_MIN_INTERVAL_SEC
	int "Smallest broadcast interval, in seconds"
	default 3600
	range 60 604800
	help
	  broadcast_interval_secs below this is raised to it, and 0 means this
	  value (reference default_mesh_beacon_min_broadcast_interval_secs, 1 h:
	  a beacon is an invitation, not a heartbeat). The sim suite lowers it
	  to run the cadence in virtual time.

endif # MESHTASTIC_MESHBEACON
```

## src/Kconfig.neighborinfo
```kconfig
# Copyright (c) 2026 The Zephyr Project Contributors
# SPDX-License-Identifier: GPL-3.0

menuconfig MESHTASTIC_NEIGHBORINFO
	bool "Meshtastic neighbor info"
	default y
	help
	  The reference NeighborInfoModule: keeps a table of the nodes heard
	  DIRECTLY (a packet whose hop_limit still equals its hop_start), with
	  the SNR each was last heard at, and periodically broadcasts it as a
	  NeighborInfo on NEIGHBORINFO_APP (port 71) so the mesh -- and a phone
	  app or MQTT consumer -- can draw real topology instead of inferring
	  it from traceroutes. Off by default at runtime: the switch is
	  ModuleConfig.neighbor_info.enabled, set over the admin channel or
	  `meshtastic neighbors enable`; there is no AUTO_SEND Kconfig here
	  because the section's own `enabled` IS that switch. Also answers a
	  unicast want_response request with its table.

if MESHTASTIC_NEIGHBORINFO

config MESHTASTIC_NEIGHBORINFO_INTERVAL_SEC
	int "Default broadcast interval in seconds"
	default 21600
	range 60 604800
	help
	  Used when ModuleConfig.neighbor_info.update_interval is 0 (unset) or
	  below MIN_INTERVAL_SEC. The reference default is 6 hours.

config MESHTASTIC_NEIGHBORINFO_MIN_INTERVAL_SEC
	int "Smallest broadcast interval a stored config may ask for"
	default 14400
	range 60 604800
	help
	  A stored update_interval below this is replaced by INTERVAL_SEC, as
	  the reference does at set time (min_neighbor_info_broadcast_secs, 4 h)
	  -- here in the module's own resolver so every writer is clamped, not
	  only the admin path. The sim suite lowers it to run the cadence in
	  virtual time.

config MESHTASTIC_NEIGHBORINFO_TABLE_SIZE
	int "Neighbor table size"
	default 10
	range 2 32
	help
	  Direct neighbors tracked in RAM. A NeighborInfo carries at most 10
	  (the protobuf's bound); a larger table only changes which ones are
	  forgotten when a busy mesh has more than fit. When full, the least
	  recently heard neighbor is replaced.

config MESHTASTIC_NEIGHBORINFO_REPLY_SUPPRESS_SEC
	int "Minimum seconds between answered want_response requests"
	default 180
	range 1 86400
	help
	  The reference answers a NeighborInfo request at most once per three
	  minutes, whoever asks.

endif # MESHTASTIC_NEIGHBORINFO
```

## src/Kconfig.netlog_filter
```kconfig
# SPDX-License-Identifier: GPL-3.0

config MESHTASTIC_NETLOG_FILTER
	bool "Restrict noisy modules to WRN+ on the net syslog backend only"
	default y
	depends on LOG_BACKEND_NET
	depends on LOG_RUNTIME_FILTERING
	help
	  Zephyr's runtime log filtering (log_filter_set()) is genuinely
	  per-(backend, module): a message can be created at the compiled
	  ceiling (CONFIG_<MODULE>_LOG_LEVEL) but only actually SENT to a
	  given backend if that backend's own per-module filter allows it.
	  This restricts a curated list of driver/protocol-internals modules
	  to WRN-or-worse on log_backend_net specifically -- the shell/console
	  backend is untouched and keeps seeing whatever each module is
	  compiled at.

	  Exists because CONFIG_LOG_BACKEND_NET has repeatedly caused real
	  stability problems at volume: a resolved net_pkt/net_buf exhaustion
	  bug (DEBUG-level LoRa+meshtastic logging saturated the TX pool), a
	  resolved GNSS UART-overrun flood implicated in household WiFi
	  interference (the bench WiFi shares a radio with the house WiFi),
	  and a heap-alloc trace that lost ~85% of its own output to the same
	  flood class. All three were DIFFERENT modules getting loud at
	  DIFFERENT times -- this exists to hold a standing, curated ceiling
	  on the modules most likely to do that again, rather than reactively
	  chasing the next one.

	  Deliberately does NOT touch modules the bench's own passive netlog
	  tooling depends on (meshtastic, meshtastic_sample, meshtastic_sntp,
	  thread_analyzer) -- see meshtastic_netlog_filter.c for the exact
	  list and the reasoning per module, including meshtastic_powermon,
	  which is a real judgment call (fires every RX/TX state transition;
	  restricted here since it's real volume, but it was also this
	  session's main "is this node radio-active" signal -- easy to move
	  back to the keep list if that visibility is missed more than the
	  bandwidth is).
```
