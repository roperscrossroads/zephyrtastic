## src/Kconfig
```kconfig
# Meshtastic mesh radio stack
#
# Copyright (c) 2026 The Zephyr Project Contributors
# SPDX-License-Identifier: GPL-3.0

menuconfig MESHTASTIC
	bool "Meshtastic mesh radio stack [EXPERIMENTAL]"
	depends on ZEPHYR_NANOPB_MODULE
	select LORA
	select NANOPB
	select PSA_CRYPTO
	select PSA_WANT_ALG_CTR
	select PSA_WANT_KEY_TYPE_AES
	select EXPERIMENTAL
	help
	  Enable the Meshtastic mesh radio stack.

	  Provides a wire-compatible implementation of the Meshtastic protocol
	  (https://meshtastic.org) on top of the Zephyr raw LoRa driver API.
	  Supports text messaging (PortNum 1) and raw data delivery over the
	  LongFast channel parameters (SF 11, BW 250 kHz, CR 4/5).

	  Requires a LoRa transceiver supported by the Zephyr LoRa driver
	  (e.g. SX1276, SX1262) and the nanopb module in the west workspace.

if MESHTASTIC

config MESHTASTIC_PHONEAPI
	bool "Phone-app (client) API core"
	help
	  Client-facing FromRadio/ToRadio protocol core shared by the BLE, serial
	  and TCP transports. Normally selected automatically by whichever
	  transport is enabled; can also be turned on directly for a custom
	  transport or for host-side tests.

config MESHTASTIC_ADMIN
	bool "Handle AdminMessage config-write from the connected app"
	depends on MESHTASTIC_PHONEAPI
	select REBOOT
	default y
	help
	  Allow the directly-connected client app (BLE/serial/TCP) to WRITE
	  settings via AdminMessage (portnum ADMIN_APP), not just read them.
	  Handles get_/set_ config, module config, channels and owner,
	  begin/commit edit transactions, and reboot. Local (from == this node)
	  admin only for now; a managed node (SecurityConfig.is_managed) refuses
	  local admin. The rotating session-passkey engine is present (issued in
	  responses, validated on the remote path); PKC admin_key auth and
	  remote/mesh admin delivery are still pending.
	  Persistence of writes across reboot additionally requires
	  MESHTASTIC_SETTINGS; without it writes apply live but are RAM-only.

menuconfig MESHTASTIC_SETTINGS
	bool "Persist Meshtastic configuration with Zephyr settings"
	select SETTINGS
	help
	  Store Meshtastic owner, channel, config and module settings through
	  Zephyr's settings subsystem. The selected settings backend remains
	  controlled by the application or board configuration.

if MESHTASTIC_SETTINGS

config MESHTASTIC_SETTINGS_SAVE_DELAY_MS
	int "Meshtastic settings save delay (ms)"
	default 1000
	range 0 60000
	help
	  Delay used to coalesce runtime configuration changes before saving
	  the Meshtastic settings subtree.

endif # MESHTASTIC_SETTINGS

module = MESHTASTIC
module-str = meshtastic
source "subsys/logging/Kconfig.template.log_config"

config MESHTASTIC_LOG_WALLCLOCK
	bool "Stamp logs with wall-clock time once the clock is seeded"
	depends on MESHTASTIC && LOG
	default y
	select LOG_TIMESTAMP_64BIT
	help
	  Register a log timestamp source that returns the meshtastic wall clock
	  (the SNTP / GPS / phone-seeded Unix epoch, millisecond precision) once it
	  is valid, so syslog and console lines carry real time instead of
	  1970+uptime. Falls back to k_uptime before the clock is seeded. log_output
	  renders "1970 + timestamp/freq", so the source returns epoch milliseconds
	  with freq=1000 -- which needs 64-bit log timestamps to hold, hence the
	  select of LOG_TIMESTAMP_64BIT.

	  This does NOT by itself make log_output render an actual date: its
	  default renderer just prints "epoch millis" as elapsed hh:mm:ss since
	  boot -- correct precision, useless display (e.g. "[496194:12:08.048,000]",
	  not a date). CONFIG_LOG_OUTPUT_FORMAT_DATE_TIMESTAMP=y (set in prj.conf;
	  can't be `select`ed here -- it's a choice-group member and Kconfig
	  ignores select on those) is what actually renders the same value as a
	  calendar date. Found 2026-08-09 -- see docs/uart0-console-investigation.md.

rsource "Kconfig.core"
rsource "Kconfig.nodedb"
rsource "Kconfig.nodeinfo"
rsource "Kconfig.message"
rsource "Kconfig.traceroute"
rsource "Kconfig.reliable"
rsource "Kconfig.ble"
rsource "Kconfig.serial"
rsource "Kconfig.tcp"
rsource "Kconfig.scanner"
rsource "Kconfig.shell"
rsource "Kconfig.position"
rsource "Kconfig.gnss"
rsource "Kconfig.device_metrics"
rsource "Kconfig.airtime"
rsource "Kconfig.environment_metrics"
rsource "Kconfig.telemetry"
rsource "Kconfig.mqtt"
rsource "Kconfig.wifi_auto"
rsource "Kconfig.sntp"
rsource "Kconfig.pki"
rsource "Kconfig.ota"
rsource "Kconfig.display"
rsource "Kconfig.powermon"
rsource "Kconfig.watchdog"
rsource "Kconfig.dfu_trigger"
rsource "Kconfig.heap_trace"
rsource "Kconfig.netlog_filter"
rsource "Kconfig.shell_uart0"
rsource "Kconfig.thread_summary"
rsource "Kconfig.wifi_diag"
rsource "Kconfig.logring"
rsource "Kconfig.power"

menu "LoRa transmit retry"

config MESHTASTIC_TX_BUSY_RETRIES
	int "Retries when CAD reports busy channel"
	range 0 32
	default 6
	help
	  Number of retransmission attempts when lora_send() returns -EBUSY
	  because CAD/LBT detected channel activity.

config MESHTASTIC_TX_BUSY_BACKOFF_MIN_MS
	int "Minimum backoff on busy channel (ms)"
	range 0 60000
	default 8
	help
	  Minimum randomized wait in milliseconds between retry attempts when
	  the channel is busy.

config MESHTASTIC_TX_BUSY_BACKOFF_MAX_MS
	int "Maximum backoff on busy channel (ms)"
	range 0 60000
	default 40
	help
	  Maximum randomized wait in milliseconds between retry attempts when
	  the channel is busy.
	  If this is less than the minimum, the minimum value is used.

endmenu

menu "SX126x AGC reset"

config MESHTASTIC_AGC_RESET_INTERVAL_MS
	int "Periodic AGC reset interval (ms)"
	depends on LORA_SX126X
	range 1000 3600000
	default 60000
	help
	  Interval between periodic radio AGC resets (a warm-sleep power-cycle
	  of the analog frontend + RX sensitivity register patch). Matches
	  upstream Meshtastic's AGC_RESET_INTERVAL_MS: the SX126x's internal
	  AGC can get stuck and RX sensitivity silently degrades without this,
	  and does not recover on its own until reboot.

endmenu

endif # MESHTASTIC
```

## src/Kconfig.attachment
```kconfig
# Copyright (c) 2026 The Zephyr Project Contributors
# SPDX-License-Identifier: GPL-3.0

menu "Attachments: one brain, many radios (ATTACHMENT-DESIGN)"

config MESHTASTIC_ATTACHMENT_CODEC
	bool
	default y if MESHTASTIC_ATTACHMENT_BRAIN || MESHTASTIC_ATTACHMENT_HEAD || MESHTASTIC_RELAY_EAR
	help
	  The envelope a radio head and its brain exchange (pure byte packing).
	  Pulled in by anything that speaks it; not a user choice.

config MESHTASTIC_ATTACH_BEARER
	bool
	default y if MESHTASTIC_ATTACHMENT_CODEC
	help
	  The board-to-board link behind the attachments (ATTACHMENT-SCOPE §4):
	  a registry of bearers -- the BLE peer link, a wire, a test pipe -- each
	  a send and a link_info. Envelopes never see a bearer's types.

config MESHTASTIC_ATTACHMENT_BRAIN
	bool "This node is a brain: it hears through radio heads"
	default n
	help
	  Accept attachment envelopes over the BLE peer link. A head's RX_FRAME
	  enters the router as an RF frame tagged with the head's preset and
	  signal; the node's identity, keys, NodeDB and modules stay exactly as
	  they are. Costs a small table (MESHTASTIC_ATTACHMENT_MAX entries) and
	  8 B per RX queue slot; the code is flash.

config MESHTASTIC_ATTACHMENT_MAX
	int "Radio heads a brain tracks (its own radio is not counted)"
	depends on MESHTASTIC_ATTACHMENT_BRAIN
	default 4
	range 1 8
	help
	  A BLE peer link per head; the R8 has 3 connection slots in total.

config MESHTASTIC_ATTACHMENT_EVICT_SEC
	int "Seconds a head stays in the table after its link went down"
	depends on MESHTASTIC_ATTACHMENT_BRAIN
	default 180
	range 1 3600
	help
	  A head whose bearer link dropped keeps its slot (and counters) this long
	  so a reboot or a BLE hiccup re-admits it in place; after that the slot
	  is freed. A head that speaks again before then is simply up again.

config MESHTASTIC_ATTACHMENT_ALLOW_MAX
	int "Operator allow-list entries (heads admitted on an untrusted link)"
	depends on MESHTASTIC_ATTACHMENT_BRAIN
	default 4
	range 1 8

config MESHTASTIC_ATTACHMENT_HEAD
	bool "This node is a keyless radio head"
	depends on !MESHTASTIC_ATTACHMENT_BRAIN
	default n
	help
	  The radio forwards every frame it hears, undecoded, with its RSSI/SNR
	  and preset, to its brain over the peer link (overlay-ble-peer.conf; on
	  native_sim the send is a test seam), and retunes when the brain says
	  so. Transmit for the brain is phase 3. The image carries no channel
	  keys, no PKI, no NodeDB and no config beyond its preset and its brain:
	  build with samples/meshtastic/overlay-attachment-head.conf, whose
	  post-build step refuses an image in which any of those linked
	  (cmake/keyless-assert.cmake). The router is never reached from the
	  radio on a head; origination is refused at the outbound queue.

config MESHTASTIC_ATTACHMENT_HEAD_BRAIN_ID
	hex "The brain's node number (0 = set at runtime)"
	depends on MESHTASTIC_ATTACHMENT_HEAD
	default 0
	help
	  Baked-in brain. `meshtastic attach brain <id>` overrides it and the
	  value persists (mtattach/brain) with MESHTASTIC_SETTINGS.

config MESHTASTIC_ATTACHMENT_HEAD_STATUS_PERIOD_SEC
	int "STATUS report period (s)"
	depends on MESHTASTIC_ATTACHMENT_HEAD
	default 60
	range 5 3600

config MESHTASTIC_ATTACHMENT_HEAD_TX_QUEUE_SIZE
	int "Frames the brain has handed this head, waiting to key up"
	depends on MESHTASTIC_ATTACHMENT_HEAD
	default 4
	range 1 16
	help
	  TX_FRAMEs accepted from the brain and not yet transmitted. A full queue
	  refuses the envelope (counted; the brain sees no TX_RESULT). Each entry
	  is a full airframe.

config MESHTASTIC_ATTACHMENT_HEAD_QUEUE_SIZE
	int "Frames queued for the brain"
	depends on MESHTASTIC_ATTACHMENT_HEAD
	default 4
	range 1 16
	help
	  Between the RX thread and the forwarding work item. ~260 B each.

endmenu
```

## src/Kconfig.device_metrics
```kconfig
# Copyright (c) 2026 The Zephyr Project Contributors
# SPDX-License-Identifier: GPL-3.0

menuconfig MESHTASTIC_DEVICE_METRICS
	bool "Meshtastic device metrics telemetry"
	default y
	help
	  Enable Telemetry.device_metrics encoding and send helpers. Uptime is
	  always included.

if MESHTASTIC_DEVICE_METRICS

config MESHTASTIC_DEVICE_METRICS_AUTO_SEND
	bool "Automatically send device metrics"
	default y
	help
	  Send device metrics periodically after meshtastic_init().

	  This is the first-boot seed for ModuleConfig.telemetry's
	  device_telemetry_enabled: the phone can turn the
	  broadcast on or off afterwards. The reference ships it OFF (stock
	  2.7 broadcasts no device metrics until the user enables them);
	  this port defaults to ON so a bench node announces itself without
	  a phone. Set =n for parity with stock.

config MESHTASTIC_DEVICE_METRICS_INTERVAL_SEC
	int "Device metrics send interval in seconds"
	default 3600
	range 30 86400
	help
	  Interval between automatic device metrics Telemetry packets.
	  Defaults to 3600 s to match the reference client cadence
	  (default_telemetry_broadcast_interval_secs); 900 s was ~4x chattier.

config MESHTASTIC_FUEL_GAUGE
	bool "Include battery metrics from fuel_gauge0"
	depends on FUEL_GAUGE
	help
	  If devicetree alias fuel_gauge0 exists and is ready, include state
	  of charge and voltage in DeviceMetrics when the driver supports
	  those properties.

config MESHTASTIC_DEVICE_METRICS_TO_PHONE
	bool "Push DeviceMetrics to a connected phone on a faster cadence than the mesh broadcast"
	default y
	depends on MESHTASTIC_PHONEAPI
	help
	  agents-ooma.15: upstream's DeviceTelemetryModule::runOnce() pushes
	  DeviceMetrics to a connected phone on its own short timer
	  (sendToPhoneIntervalMs, ~60 s) independent of the much slower mesh
	  broadcast interval (MESHTASTIC_DEVICE_METRICS_INTERVAL_SEC, 3600 s
	  default) -- the phone app's battery/util/uptime readings are meant to be
	  live, not only as fresh as the last airtime-budgeted broadcast. This
	  port previously had one cadence for both.

	  Same mechanism and reasoning as MESHTASTIC_LOCAL_STATS_TO_PHONE just
	  above: meshtastic_phoneapi_on_packet() directly, never
	  meshtastic_send_data() -- zero airtime by construction, the frame never
	  reaches the radio. Independent of MESHTASTIC_DEVICE_METRICS_AUTO_SEND;
	  the phone push runs whether or not the mesh broadcast is even enabled,
	  matching upstream's runOnce() (the phone branch is not gated on
	  device_telemetry_enabled).

config MESHTASTIC_DEVICE_METRICS_TO_PHONE_SEC
	int "DeviceMetrics to-phone interval in seconds"
	default 60
	range 10 3600
	depends on MESHTASTIC_DEVICE_METRICS_TO_PHONE
	help
	  Matches upstream's sendToPhoneIntervalMs (DeviceTelemetry.h,
	  SECONDS_IN_MINUTE * 1000) -- one minute. Upstream's real trigger is
	  "every runOnce tick that isn't the mesh's turn to send", which this
	  port simplifies to a real independent timer, the same simplification
	  already made for MESHTASTIC_LOCAL_STATS_TO_PHONE_SEC (whose own upstream
	  trigger is a proper fixed interval, unlike this one, but the port keeps
	  both as plain per-job deadlines for one consistent dispatch shape).

endif # MESHTASTIC_DEVICE_METRICS

menuconfig MESHTASTIC_LOCAL_STATS
	bool "Meshtastic LocalStats telemetry"
	default y
	depends on MESHTASTIC_DEVICE_METRICS
	help
	  Enable Telemetry.local_stats -- the mesh-statistics variant: uptime,
	  channel/airtime utilization, packet and relay counters, node counts and
	  heap. Every counter it reports is one the stack already keeps; this only
	  puts them on the wire in the shape clients already render (the Android
	  app ships a dedicated LocalStats home-screen widget).

	  Note the deliberate asymmetry with device_metrics, which mirrors
	  upstream's DeviceTelemetryModule: LocalStats is pushed to a connected
	  PHONE only and is never broadcast over LoRa on a timer. It costs no
	  airtime. The mesh only ever sees it as a reply to an explicit
	  Telemetry(local_stats) request.

if MESHTASTIC_LOCAL_STATS

config MESHTASTIC_LOCAL_STATS_TO_PHONE
	bool "Push LocalStats to a connected phone periodically"
	default y
	depends on MESHTASTIC_PHONEAPI
	help
	  Enqueue a LocalStats frame onto every registered PhoneAPI transport on
	  a timer. Zero airtime -- the frame never reaches the radio.

config MESHTASTIC_LOCAL_STATS_TO_PHONE_SEC
	int "LocalStats to-phone interval in seconds"
	default 900
	range 30 86400
	depends on MESHTASTIC_LOCAL_STATS_TO_PHONE
	help
	  Matches upstream's sendStatsToPhoneIntervalMs (15 minutes).

endif # MESHTASTIC_LOCAL_STATS
```
