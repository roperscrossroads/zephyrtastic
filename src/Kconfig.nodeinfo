## src/Kconfig.relay
```kconfig
# Copyright (c) 2026 The Zephyr Project Contributors
# SPDX-License-Identifier: GPL-3.0

menuconfig MESHTASTIC_RELAY
	bool "Cross-preset text relay (receiving half)"
	default n
	help
	  The receiving half of a cross-preset relay (agents-jbrq.12). An "ear"
	  node on another preset forwards the frames it hears over the BLE peer
	  link. This node reads them through a channel it holds, and
	  RE-ORIGINATES broadcast text on its own preset as a new packet from
	  itself, prefixed "[xxxx] " with the origin's id.

	  Only text crosses. A position, NodeInfo or telemetry packet sent in the
	  relay's name would be the relay's, so those never cross; DMs are
	  PKC and cannot be read.

	  Channel mapping: every preset-named channel on exactly the default key
	  is one public channel (a LongFast frame goes out on this node's default
	  channel); a custom channel goes out on the same channel, which has the
	  same hash on every preset.

	  Loops are refused, not merely damped: any text already carrying a
	  relay-style prefix is dropped, a seen-cache keyed on (origin, text)
	  drops repeats, and a rate cap bounds the damage of anything that
	  gets past both.

	  Off at boot unless MESHTASTIC_RELAY_INBOUND_AT_BOOT, or unless a
	  direction was set before a reboot: with MESHTASTIC_SETTINGS the
	  direction and the ignore list are saved (mtrelay/relay).

if MESHTASTIC_RELAY

config MESHTASTIC_RELAY_INBOUND_AT_BOOT
	bool "Relay inbound (ear -> this preset) from boot"
	default n
	help
	  Start with the direction set to inbound. The default is off:
	  enabling a relay is a deliberate act. A direction set at runtime is
	  saved when MESHTASTIC_SETTINGS is on and wins over this; this is for
	  an image that must relay from its very first boot.

config MESHTASTIC_RELAY_SEEN_SIZE
	int "Seen-cache entries"
	default 16
	range 4 128
	help
	  Recently relayed (origin, text hash) pairs. A repeat inside the TTL is
	  dropped. The ear already drops a repeated (origin, packet id); this
	  catches the same text arriving under a NEW id, which is what a second
	  relay or a re-send produces.

config MESHTASTIC_RELAY_SEEN_TTL_SEC
	int "Seen-cache lifetime in seconds"
	default 300
	range 10 3600
	help
	  Matches the router's duplicate-cache lifetime. The cost of a long TTL
	  is that an origin sending the same short text twice (e.g. "ok") inside
	  it is relayed once.

config MESHTASTIC_RELAY_RATE_MAX
	int "Texts relayed per window"
	default 10
	range 1 255
	help
	  Token bucket per direction: at most this many texts per
	  MESHTASTIC_RELAY_RATE_WINDOW_SEC. Set it from the measured source
	  volume (the testbed's B1). The limit protects the destination tier's
	  airtime from a chatty or looping source.

config MESHTASTIC_RELAY_RATE_WINDOW_SEC
	int "Rate window in seconds"
	default 600
	range 10 86400

config MESHTASTIC_RELAY_PER_ORIGIN_MAX
	int "Texts relayed per origin per window"
	default 3
	range 1 255
	help
	  One node -- misbehaving, buggy, or hostile -- may not spend the whole
	  direction's cap (MESHTASTIC_RELAY_RATE_MAX) and starve everyone else.
	  Checked after the seen-cache and before the direction's cap.

config MESHTASTIC_RELAY_PER_ORIGIN_WINDOW_SEC
	int "Per-origin window in seconds"
	default 60
	range 10 86400

config MESHTASTIC_RELAY_ORIGIN_SLOTS
	int "Origins tracked by the per-origin limiter"
	default 8
	range 2 64
	help
	  A new origin takes the slot whose window started longest ago, so a
	  flood of invented origins cycles the table rather than growing it.

config MESHTASTIC_RELAY_LOG_INTERVAL_SEC
	int "At most one refusal log line per this many seconds"
	default 10
	range 1 3600
	help
	  Refusals worth a look (bad text, a relay prefix, the caps) are logged
	  with their first 16 bytes in hex; this bounds that log so a flooding
	  node cannot turn it into the attack. Held-back lines are counted.

config MESHTASTIC_RELAY_IGNORE_MAX
	int "Relay ids never translated"
	default 4
	range 1 16
	help
	  Nodes whose text is never relayed: other relays' destination halves.
	  The prefix refusal catches relays nobody listed; this catches a
	  relay that sends unprefixed text.

config MESHTASTIC_RELAY_QUEUE_SIZE
	int "Pending relayed texts"
	default 2
	range 1 16
	help
	  Texts accepted by the receive path and waiting for the work queue to
	  send them. Each slot holds a full text (~240 B).

endif # MESHTASTIC_RELAY

menuconfig MESHTASTIC_RELAY_EAR
	bool "Cross-preset relay: the ear"
	default n
	help
	  The other node of a cross-preset relay pair: it sits on the source
	  preset and forwards every broadcast TEXT frame it hears, byte for
	  byte, over the BLE peer link to the relay's receiving half
	  (MESHTASTIC_RELAY) on the destination preset.

	  The ear does not decide what crosses: the receiving half does, and
	  re-checks everything. The ear only avoids spending BLE on what could
	  never cross (DMs, non-text).

if MESHTASTIC_RELAY_EAR

config MESHTASTIC_RELAY_EAR_PEER
	hex "Receiving half's node id"
	default 0x0
	help
	  The node the ear forwards to, over whichever BLE peer link reaches
	  it. 0 means none until set at runtime (`meshtastic ear peer <id>`),
	  which is saved (mtear/peer) when MESHTASTIC_SETTINGS is on.

config MESHTASTIC_RELAY_EAR_QUEUE_SIZE
	int "Frames waiting to be forwarded"
	default 4
	range 1 32
	help
	  Each slot holds one wire frame (up to 256 B). Forwarding runs on the
	  BLE work queue, never on the LoRa receive thread.

config MESHTASTIC_RELAY_EAR_RATE_MAX
	int "Frames forwarded per window"
	default 30
	range 1 1000
	help
	  The ear does not judge content (the receiving half does), but a
	  flood of text frames on its preset must not saturate the peer link
	  or the receiving half. Excess frames are counted and dropped.

config MESHTASTIC_RELAY_EAR_RATE_WINDOW_SEC
	int "Ear forwarding window in seconds"
	default 60
	range 1 3600

config MESHTASTIC_RELAY_EAR_RX_ONLY
	bool "Compile the transmit path out"
	default y
	help
	  An ear usually sits on a PUBLIC channel it does not own. With this on
	  the image cannot key the radio at all (the same gate as
	  MESHTASTIC_SCANNER_RX_ONLY), so a stored tx_enabled, a phone or an
	  admin write cannot put it on someone else's air.

endif # MESHTASTIC_RELAY_EAR
```

## src/Kconfig.shell
```kconfig
# Copyright (c) 2026 The Zephyr Project Contributors
# SPDX-License-Identifier: GPL-3.0

menuconfig MESHTASTIC_SHELL
	bool "Meshtastic shell commands"
	depends on SHELL
	help
	  Add a "meshtastic" shell command group for status, text send,
	  app-port send, and optional gnss/metrics/environment send
	  subcommands when the corresponding Meshtastic features are enabled.

if MESHTASTIC_SHELL

config MESHTASTIC_SHELL_WORK_STACK_SIZE
	int "Meshtastic shell work thread stack size"
	default 6144
	help
	  Stack size for deferred shell commands that may block on LoRa TX or
	  protobuf encoding. The "~600 B measured peak" this default used to cite
	  covered simple commands only; "meshtastic metrics send" measured
	  3012/3072 (98%) on hardware (2026-08-05) — it drives the same
	  C3-migrated meshtastic_send_data() path that overflowed the dedicated
	  telemetry auto-send thread's 2 KB stack (see meshtastic_metrics.c).
	  Bumped to 6144 for the same ~50% margin now targeted across that send
	  path, with STACK_SENTINEL as the backstop against a further spike.

config MESHTASTIC_SHELL_WORK_PRIORITY
	int "Meshtastic shell work thread priority"
	default 8
	help
	  Priority for deferred Meshtastic shell command handling.

config MESHTASTIC_SHELL_QUEUE_SIZE
	int "Meshtastic shell command queue depth"
	default 4
	range 1 16
	help
	  Number of deferred shell commands that can be queued.

config MESHTASTIC_SHELL_CONFIG_WRITE
	bool "Allow the shell to modify device configuration"
	default y
	help
	  Include the shell subcommands that persist configuration changes:
	  "channel set", "channel disable", and the argument forms of
	  "device role" and "device rebroadcast".

	  The shell is not an authenticated transport. Anyone with console
	  access (UART, USB or RTT) reaches it with no pairing, passkey or
	  public-key check of any kind, so it is a configuration write surface
	  in its own right, independent of the admin model.

	  Say n to compile these writes out of a production build. The
	  read-only forms stay available either way, so "device role" with no
	  argument still reports the current role.

	  Independently of this option, the writes honour
	  SecurityConfig.is_managed: a managed node refuses them exactly as it
	  refuses local admin over the PhoneAPI.

config MESHTASTIC_SHELL_PSK_HEX
	bool "Print raw channel PSK bytes in the shell"
	default n
	help
	  Let "meshtastic channel show" print a channel's pre-shared key as raw
	  hex. This discloses live key material to anyone with console access,
	  and is only useful when debugging a key mismatch against another node.

	  Disabled by default. The PSK summary (kind and length) is always
	  printed and is normally enough to tell which key a slot is using;
	  "channel list" only ever prints the summary.

endif # MESHTASTIC_SHELL

config MESHTASTIC_SHELL_CRASHTEST
	bool "Shell command that deliberately crashes the node"
	default n
	help
	  Adds "meshtastic crashtest <kind>", which faults on purpose.

	  This exists because a crash-capture pipeline is otherwise only ever
	  exercised by the bug it was built to catch, and therefore is first
	  discovered to be broken at the exact moment it was needed. That is not
	  hypothetical here: the coredump path shipped for months writing to a
	  backend too slow to finish before the watchdog reset the node, so every
	  dump it produced was truncated to the first quarter of RAM. Thousands of
	  #CD: lines scrolled past and none of them were usable, and nobody knew,
	  because nobody had ever crashed a node on purpose and read one back.

	  With this, the whole chain -- fault, dump written, reset survived, dump
	  read back, parsed, symbolised -- is provable in a couple of minutes on a
	  bench node, against the image that is actually about to be deployed.

	  Kinds:
	    panic  k_panic() from thread context. The simplest fatal path.
	    stack  unbounded recursion until the stack guard fires. Reproduces the
	           SHAPE of agents-quo6 (a stack overflow) rather than a generic
	           fault, so the dump can be checked for the thing that actually
	           needs reading.

	  DEFAULT n, and it should stay that way for anything on a mast. Turn it on
	  for diagnostic builds, alongside the flash coredump backend.
```

## src/Kconfig.shell_uart0
```kconfig
# SPDX-License-Identifier: GPL-3.0

config MESHTASTIC_SHELL_UART0
	bool "Second interactive shell instance on the uart0 chosen node"
	default y
	depends on SHELL
	help
	  Register a second shell instance (transport: shell_uart.c, the same
	  code the primary native-USB console shell already uses) bound to
	  whichever device a board overlay names via the
	  `zephyr,meshtastic-shell-uart0` chosen node -- currently just
	  heltec_wifi_lora32_v4's uart0 (the header-pin UART, GPIO43/44). Boards
	  without that chosen node compile this to nothing (see
	  meshtastic_shell_uart0.c).

	  Gives the header-pin UART both a full interactive shell (same command
	  tree as the native-USB console and telnet) and log output (via the
	  shell's own log_backend=true registration) through one owner, on
	  hardware that's proven immune to the native USB-CDC console's
	  WSL2-passthrough flakiness (drops under load, lost connections
	  mid-boot -- see docs/KNOWN-ISSUES.md and the friction log) and to the
	  telnet shell's single-client + PM-doze limitations.

	  Superseded the same day: a first cut used a log-only backend
	  (CONFIG_LOG_BACKEND_UART) instead. That can't safely coexist with an
	  interactive shell on the same physical UART -- log_backend_uart.c
	  writes via synchronous uart_poll_out(), while the shell transport
	  drives the UART via interrupt-driven uart_irq_tx_enable() /
	  uart_fifo_fill(); mixing the two access patterns on one UART isn't
	  something Zephyr's driver model arbitrates. This shell instance's own
	  log backend replaces that mechanism outright, matching how the
	  existing native-USB and telnet shells already double as their own log
	  backends. See docs/uart0-console-investigation.md.
```

## src/Kconfig.statusmessage
```kconfig
# Copyright (c) 2026 The Zephyr Project Contributors
# SPDX-License-Identifier: GPL-3.0

menuconfig MESHTASTIC_STATUSMESSAGE
	bool "Meshtastic node status message"
	default y
	help
	  The reference StatusMessageModule: an away-message for a node. The
	  string in ModuleConfig.statusmessage.node_status (set from a Meshtastic
	  client over the admin channel, or `meshtastic status set` on the
	  shell) is broadcast on NODE_STATUS_APP (port 36) so peers and their
	  apps can show it next to the node; statuses heard from peers are kept
	  in a small RAM cache. Changing the status takes effect live -- the
	  reference does not reboot for this section and neither does this
	  port -- the next announce is re-armed from the change.

if MESHTASTIC_STATUSMESSAGE

config MESHTASTIC_STATUSMESSAGE_AUTO_SEND
	bool "Automatically broadcast the status"
	default y
	help
	  Announce the status unprompted: once START_DELAY_SEC after boot (or
	  after the status changes), then every INTERVAL_SEC while one is set.
	  With this off the status is only sent on request (`meshtastic status
	  send`) -- the shape fleet class 5 (the listener) wants.

config MESHTASTIC_STATUSMESSAGE_START_DELAY_SEC
	int "Delay before the first status broadcast in seconds"
	default 120
	range 1 3600
	depends on MESHTASTIC_STATUSMESSAGE_AUTO_SEND
	help
	  Time from boot -- and from a status change -- to the announce. The
	  reference uses 2 minutes after boot. Re-arming from a change (which
	  the reference does not do: a status set at runtime there waits for
	  the running 12 h timer, its own TODO) means a user editing the text
	  in an app produces one announce when they stop, not one per keystroke.

config MESHTASTIC_STATUSMESSAGE_INTERVAL_SEC
	int "Status broadcast interval in seconds"
	default 43200
	range 60 604800
	depends on MESHTASTIC_STATUSMESSAGE_AUTO_SEND
	help
	  Interval between repeats while a status is set. The reference repeats
	  every 12 hours (43200 s). A status is low-value, slow-changing
	  context, not telemetry; keep this long. The floor exists for the sim
	  suite, which runs the cadence in virtual time.

config MESHTASTIC_STATUSMESSAGE_CACHE_SIZE
	int "Peer status cache size"
	default 8
	range 1 64
	help
	  Number of peers whose most recent status is kept in RAM (80 bytes of
	  text each, plus bookkeeping). The least recently heard peer is evicted
	  when full. Read by the shell (`meshtastic status peers`) and by
	  applications through meshtastic_statusmessage_peer_get(); the phone
	  app decodes port 36 itself from the forwarded packet and needs
	  nothing from this cache.

endif # MESHTASTIC_STATUSMESSAGE
```
