## src/Kconfig.traffic
```kconfig
# Copyright (c) 2026 The Zephyr Project Contributors
# SPDX-License-Identifier: GPL-3.0

menuconfig MESHTASTIC_TRAFFIC
	bool "Meshtastic traffic management (packet inspection / airtime shaping)"
	default y
	help
	  The reference TrafficManagementModule's airtime-saving inspection of
	  every received frame, driven by ModuleConfig.traffic_management:
	    - position dedup: a peer's position broadcast on a well-known
	      channel that has not moved (same grid cell at the channel's
	      precision) within position_min_interval_secs is dropped -- not
	      relayed, not delivered;
	    - per-node rate limiting: more than rate_limit_max_packets from one
	      node inside rate_limit_window_secs are dropped (ROUTING and ADMIN
	      exempt);
	    - unknown-packet filtering: a node whose undecodable frames exceed
	      unknown_packet_threshold in a 5-minute window stops being relayed.
	  Each is "non-zero implies enabled". Applies live, no reboot.

	  NOT supported, and refused at write time rather than ignored: the
	  reference's NodeInfo direct response (nodeinfo_direct_response_max_hops
	  != 0), which answers a NodeInfo request on another node's behalf from
	  a cache and gates that on key provenance (XEdDSA-signed or manually
	  verified keys) this port does not have yet. Also not mirrored: the
	  precision clamp the reference applies to a RELAYED position -- this
	  port relays the wire bytes unchanged.

if MESHTASTIC_TRAFFIC

config MESHTASTIC_TRAFFIC_TABLE_SIZE
	int "Per-node traffic state table size"
	default 32
	range 4 256
	help
	  Nodes tracked at once (position fingerprint + rate and unknown-packet
	  windows, ~32 bytes each). The least recently heard node is replaced
	  when full. The reference sizes this 250-2048 by platform; a small
	  LoRa-only fleet needs far fewer.

config MESHTASTIC_TRAFFIC_POSITION_MIN_INTERVAL_SEC
	int "First-boot default for position_min_interval_secs"
	default 18000
	range 0 604800
	help
	  Seeded into ModuleConfig.traffic_management on a fresh node (the
	  reference ships dedup enabled at 5 h). 0 seeds dedup disabled. A stored
	  value of 0 disables dedup at runtime.

config MESHTASTIC_TRAFFIC_POSITION_PRECISION_BITS
	int "Grid precision for dedup when the channel sets none"
	default 19
	range 1 32
	help
	  The reference default_traffic_mgmt_position_precision_bits (~90 m
	  cells). A channel's own position_precision wins when it is set.

endif # MESHTASTIC_TRAFFIC
```

## src/Kconfig.wifi_diag
```kconfig
# SPDX-License-Identifier: GPL-3.0

config MESHTASTIC_WIFI_DIAG
	bool "WiFi/network event logging + periodic link snapshot"
	depends on WIFI && NET_L2_WIFI_MGMT && NET_MGMT_EVENT
	default y if WIFI
	help
	  Logs WiFi connect/disconnect/signal-change events with their reason
	  codes, and periodically snapshots the link (state, RSSI, channel,
	  BSSID) over the existing netlog pipe.

	  Added 2026-08-11 after all three bench nodes hardware-watchdog reset
	  inside a 20-second window with no preceding anomaly in any log, and
	  none of them leaving a stage-0 breadcrumb -- meaning the IRAM watchdog
	  ISR never ran, i.e. interrupts were masked for the whole window. All
	  three were associated to the SAME BSSID, making the AP the one shared
	  dependency capable of hitting every node simultaneously.

	  The bench was effectively blind to this: CONFIG_WIFI_LOG_LEVEL was ERR,
	  so the ESP32 driver's own LOG_DBG("Disconnect reason: %d") never
	  emitted, and no net statistics were compiled in at all.

	  This CANNOT capture the stall itself -- nothing logs while interrupts
	  are masked. It captures the lead-up: a disconnect storm, an RSSI
	  collapse, a BSSID roam, a reconnect loop. A clean lead-up on all nodes
	  would itself be informative, pointing away from WiFi.

if MESHTASTIC_WIFI_DIAG

config MESHTASTIC_WIFI_DIAG_SNAPSHOT_SEC
	int "Seconds between periodic link snapshots (0 = events only)"
	default 300
	help
	  Matches the thread-summary cadence (5 min) so the two interleave
	  predictably in the netlog and can be read side by side. Set 0 to log
	  only on events and drop the snapshot thread entirely.

config MESHTASTIC_WIFI_DIAG_STACK_SIZE
	int "Stack size for the snapshot thread"
	default 1536
	help
	  Only ever calls net_mgmt() for an iface-status query and one LOG_INF.
	  net_mgmt dispatches into the WiFi L2 handler on the caller's stack,
	  so this is not as small as the work suggests.

config MESHTASTIC_WIFI_DIAG_LOG_LEVEL
	int "Log level for the WiFi diagnostics module"
	default 3
	range 0 4
	help
	  Disconnects log at WRN so they survive per-backend throttling; the
	  periodic snapshot logs at INF.

endif # MESHTASTIC_WIFI_DIAG
```

## src/Kconfig.xeddsa
```kconfig
# Copyright (c) 2026 The Zephyr Project Contributors
# SPDX-License-Identifier: GPL-3.0

config MESHTASTIC_XEDDSA
	bool "Verify XEdDSA-signed packets"
	default n
	depends on MESHTASTIC_PKI
	select MBEDTLS
	select PSA_WANT_ALG_SHA_512
	help
	  Verify the XEdDSA signatures the reference firmware puts on some
	  broadcasts (position, telemetry, NodeInfo), which are otherwise accepted
	  on the sender id alone. The signature is made with the sender's X25519
	  identity key, so verification needs no extra key material: the key is
	  converted to its Ed25519 form and checked with a standard Ed25519 verify.

	  This is VERIFY ONLY -- this port never signs. That is safe on a mixed
	  mesh because the reference's default policy accepts unsigned traffic;
	  what changes here is that a packet arriving WITH a signature must have a
	  good one.

	  Costs ~19 KB of flash, measured on the XIAO (2026-09-17): the vendored
	  orlp/ed25519 arithmetic is 12.9 KB (src/crypto/ed25519, zlib -- see its
	  PROVENANCE.md), SHA-512 from PSA another 3.3 KB (PKC uses SHA-256, so
	  SHA-512 is not otherwise in the image), and the gate itself ~0.9 KB.
	  Check the headroom before adding this to an image that is already close
	  to the ceiling.

config MESHTASTIC_XEDDSA_SIGN
	bool "Sign our own broadcasts with XEdDSA"
	default n
	depends on MESHTASTIC_XEDDSA
	help
	  Sign the packets this node originates, so peers can authenticate them
	  instead of trusting the sender id. Without this the node verifies
	  others but cannot be verified itself, and a peer running the
	  reference's STRICT policy drops everything we send.

	  ⚠️ COSTS ~38 KB MORE FLASH than verification alone, measured from the
	  objects: the base-point table 30,720 B, sc_muladd 6,548 B (verify uses
	  only sc_reduce), ge_scalarmult_base 264 B, plus this code. Verification
	  links none of it -- the linker garbage-collects the table today.

	  That does NOT fit a XIAO: a class-1 image has ~34 KB of slot left with
	  verification on, and the lockdown variant ~13 KB. This is for the Heltec
	  boards (2 MB slot) until a table-free constant-time base multiplication
	  exists.

	  Do not reach for the vartime path to avoid the table. It is the
	  verifier's, and its running time depends on the scalar -- which during
	  signing is the secret nonce.

	  ⚠️ NEEDS ~2 KB MORE STACK on every thread that originates a packet.
	  Signing happens inside the encoder, on the caller's thread, and those
	  stacks were sized for an encoder that did no curve arithmetic. Enabling
	  this without raising them boot-loops the node: measured on the bench
	  2026-09-17, rzr1 and rzr2 overflowed in meshtastic_nodeinfo and
	  gnss_send. Frames: sign 480 B, derive 240 B, ge_scalarmult_base 512 B,
	  select 176 B, plus hashing. See agents-ooma.35.
```

## tests/airtime/testcase.yaml
```yaml
common:
  tags:
    - meshtastic
    - airtime
    - native_sim
  integration_platforms:
    - native_sim/native/64
  platform_allow:
    - native_sim/native/64
tests:
  meshtastic.airtime.native_sim: {}
```
