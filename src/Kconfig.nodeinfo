## src/Kconfig.storage
```kconfig
# SPDX-License-Identifier: GPL-3.0

config MESHTASTIC_STORAGE_STATS
	bool "Storage report (meshtastic storage)"
	default y
	depends on MESHTASTIC_SETTINGS
	help
	  A read-only report of the settings store: sector layout, free space
	  (NVS backends), and per-subtree record counts, value bytes, estimated
	  on-flash bytes and lockdown-sealed counts, plus how long the config,
	  node-key and node-record restores took at boot. Shell command
	  `meshtastic storage`; API meshtastic_storage_stats().

	  Exists because nothing measured settings use while the XIAO's 32 KB
	  partition is shared by everything that persists (agents-oaz1).

config MESHTASTIC_BULK_STORE
	bool "Bulk store: a second NVS for node tables and messages"
	default y
	depends on $(dt_nodelabel_enabled,mt_bulk_partition)
	depends on NVS && FLASH_MAP
	help
	  Mount a second NVS instance on the `mt_bulk_partition` devicetree
	  partition for large, rebuildable tables (node records, per-node
	  satellites, the message store), apart from the settings NVS that holds
	  identity, keys and config. On the XIAO the partition is on the external
	  QSPI flash; on the Heltecs it is the idle part of the storage partition.
	  Built only where the partition exists; elsewhere the node tables stay
	  in settings. See meshtastic_bulk.h (agents-2dk3).
```

## src/Kconfig.supervisor
```kconfig
# SPDX-License-Identifier: GPL-3.0

config MESHTASTIC_SUPERVISOR
	bool "Health supervisor: watch headroom shrink, don't wait for a fault"
	default y
	depends on THREAD_ANALYZER
	select STATS
	help
	  Phase 3 of the diagnostics-baseline plan. thread_analyzer_run() and
	  the system heap already carry the numbers that flag trouble coming --
	  stack%, per-thread CPU%, free heap -- but nothing thresholds them or
	  acts on them; meshtastic_thread_summary.c only prints them on a timer.
	  This is the real mitigation for a fault class this project has
	  actually hit on hardware: ESP32-S3 has no MPU stack guard, so a fast
	  deep recursion can smash the sentinel and wedge the system before any
	  detection fires (`meshtastic crashtest stack` reproduces it -- bare
	  WATCHDOG reset, no fatal, no coredump, nothing in the log ring). A
	  supervisor that watches headroom SHRINK catches that class before the
	  overflow, instead of waiting for a detection that may never come.

	  Shares the low-priority combined diagnostic thread with
	  MESHTASTIC_THREAD_SUMMARY (meshtastic_diag_loop.c) -- own interval, own
	  callback, same thread_analyzer_run() sweep when both are due at once.
	  Escalates on a state TRANSITION only (OK -> WARN, WARN -> OK), never
	  every sample -- the same discipline as the cluster's push-on-change,
	  and the reason a periodic sampler does not become a periodic
	  transmitter. Each rung of the ladder below is independent of the
	  ones above it, so losing one does not silently lose the rest:

	    1. STATS counter (`stats list`, group "mt_supervisor") -- costs
	       nothing, survives with no console and no phone attached.
	    2. LOG_WRN on its own module -- carried by the console AND the RTC
	       log ring, so a transition is in `logring prev` after a reset
	       even if nobody was watching live.
	    3. The phone, if attached, over PhoneAPI (MESHTASTIC_PORT_SUPERVISOR_ALERT)
	       -- zero airtime, and independent of MESHTASTIC_PHONELOG's runtime
	       verbosity knob, which an operator could otherwise turn down and
	       silently lose this too.
	    4. The mesh, bounded and opt-in -- Phase 4, not built yet.

	  The supervisor thread never feeds the watchdog. Its own liveness is
	  not evidence of anything else's -- that is meshtastic_watchdog.c's
	  sysworkq heartbeat's job, unaffected by this.

if MESHTASTIC_SUPERVISOR

config MESHTASTIC_SUPERVISOR_INTERVAL
	int "Sample interval (seconds)"
	default 30
	help
	  Deliberately shorter than MESHTASTIC_THREAD_SUMMARY_INTERVAL's 300 s
	  default: that thread reports steady state on a timer, this one exists
	  to catch a trend building INSIDE one of its intervals.

config MESHTASTIC_SUPERVISOR_STACK_WARN_PCT
	int "Per-thread stack-used percent that trips a WARN"
	default 85
	range 50 99
	help
	  Any thread's stack_used/stack_size crossing this is the early-warning
	  signal for the overflow class described above -- the sentinel itself
	  is checked only at context switch and can be smashed past before it
	  ever fires, so this is the only chance to catch it ahead of time.

config MESHTASTIC_SUPERVISOR_CPU_WARN_PCT
	int "Per-thread CPU utilization percent that trips a WARN"
	default 80
	range 10 100
	depends on THREAD_RUNTIME_STATS
	help
	  A single non-idle thread pinned above this for
	  MESHTASTIC_SUPERVISOR_CPU_WARN_CYCLES consecutive samples signals a
	  runaway or starved thread. Silently a no-op (never fires) when
	  THREAD_RUNTIME_STATS is off, same as meshtastic_thread_summary.c's
	  cpu% column reading "--" instead of a real number.

config MESHTASTIC_SUPERVISOR_CPU_WARN_CYCLES
	int "Consecutive over-threshold samples before a CPU WARN fires"
	default 3
	depends on THREAD_RUNTIME_STATS
	help
	  Debounces a legitimate short burst (a TX, a crypto op) from a genuine
	  stuck thread. At the default interval this is 90 s of sustained load
	  before it escalates.

config MESHTASTIC_SUPERVISOR_TO_PHONE
	bool "Escalate a WARN/recovery transition to the phone, zero airtime"
	default y
	depends on MESHTASTIC_PHONEAPI
	help
	  Rung 3 of the ladder -- see the parent help text. Sends
	  MESHTASTIC_PORT_SUPERVISOR_ALERT via meshtastic_phoneapi_on_packet(),
	  the same local-only fan-out meshtastic_send_local_stats_to_phone()
	  uses. Turning this off still leaves rungs 1 (STATS) and 2 (log ring)
	  intact.

	  Runs on the dedicated worker CONFIG_MESHTASTIC_SUPERVISOR_ALERT_STACK_SIZE
	  sizes, not on mt_diag_loop's own stack -- see that config's help for why.

config MESHTASTIC_SUPERVISOR_ALERT_STACK_SIZE
	int "Stack size for the dedicated supervisor-alert worker thread"
	default 3584
	depends on MESHTASTIC_SUPERVISOR_TO_PHONE
	help
	  agents-wu94.12.1, 2026-09-21: alert()'s phoneapi send used to run inline on
	  mt_diag_loop's own stack (meshtastic_diag_loop.c) -- the call chain
	  alert_phone() -> meshtastic_phoneapi_on_packet() ->
	  meshtastic_phoneapi_enqueue_fromradio() -> meshtastic_phoneapi_notify_data_ready()
	  -> a BLE work-queue submit -> a kernel reschedule is a real, deep send path
	  (~13 nested calls), and firing it from INSIDE the same sweep that detects
	  mt_diag_loop's own stack pressure overflowed it on real hardware -- a
	  confirmed crash (Zephyr's own z_check_stack_sentinel catching it), not a
	  tight margin; doubling mt_diag_loop's stack did not fix it, because the
	  chain's true depth had never been measured, isolated, or budgeted for by
	  anyone, including before this merge.

	  Measured with -fstack-usage (Xtensa, class-6 build) along the exact path a
	  decoded crash backtrace confirmed: alert() 304 B (includes alert_phone(),
	  inlined) + meshtastic_phoneapi_on_packet() 48 B + enqueue_fromradio() 672 B
	  (the single largest frame -- its own ~515 B stack-local FromRadio encode
	  buffer) + notify_data_ready() 32 B + the BLE work-submit + reschedule/sentinel
	  path (roughly 100-150 B more) -- about 1.2 KB just for this segment, atop
	  whatever thread_analyzer_run()'s own walk already used to reach it. As with
	  meshtastic_watchdog.c's own documented caveat, -fstack-usage does not capture
	  Xtensa's real per-call register-window-spill cost, which is nontrivial across
	  this many nested calls.

	  3584 B reuses CONFIG_MESHTASTIC_XEDDSA_SIGN_STACK_SIZE's default -- the
	  already-hardware-proven size for the exact same class of problem
	  (agents-ooma.35, meshtastic_pki.c's dedicated signing thread: a real send/
	  crypto call chain isolated onto its own right-sized worker instead of
	  running inline on whichever thread happened to trigger it), not a fresh
	  guess. Soak with the alert path DELIBERATELY forced (both the heap-low and
	  the thread's-own-stack-warn branches -- the latter is what actually crashed)
	  before trusting a smaller number here.

config MESHTASTIC_SUPERVISOR_HEAP_MIN_BYTES
	int "Free system-heap bytes below which a WARN fires"
	default 4096
	help
	  Same _system_heap meshtastic_watchdog.c's heartbeat already logs
	  free/allocated/max_allocated for every interval -- this just puts a
	  floor under the free number instead of only ever reporting it.

endif # MESHTASTIC_SUPERVISOR
```

## src/Kconfig.tcp
```kconfig
# Copyright (c) 2026 The Zephyr Project Contributors
# SPDX-License-Identifier: GPL-3.0

menuconfig MESHTASTIC_TCP
	bool "Meshtastic TCP PhoneAPI transport"
	depends on NETWORKING && NET_TCP && NET_SOCKETS
	select MESHTASTIC_PHONEAPI
	select NET_TCP_KEEPALIVE
	select ZVFS_EVENTFD	# wakes the transport's blocking poll() cross-thread
	help
	  Expose the Meshtastic PhoneAPI over TCP using stock StreamAPI framing
	  (0x94 0xc3 <len16> <protobuf>), so the Android app or the reference
	  client `meshtastic --host <ip>` can connect over IP. One client at a
	  time. Unlike the serial transport this needs no dedicated UART, so it
	  coexists with the console/shell and MQTT on the WiFi build.

if MESHTASTIC_TCP

config MESHTASTIC_TCP_PORT
	int "TCP PhoneAPI listen port"
	default 4403
	range 1 65535
	help
	  Stock Meshtastic clients default to 4403.

config MESHTASTIC_TCP_FROMRADIO_QUEUE_SIZE
	int "TCP FromRadio queue depth"
	default 8
	range 8 64
	help
	  Number of encoded FromRadio frames retained for the TCP phone client.

config MESHTASTIC_TCP_THREAD_STACK_SIZE
	int "TCP PhoneAPI thread stack size"
	default 4096

config MESHTASTIC_TCP_DYNAMIC_STACK
	bool "Heap-allocate the TCP PhoneAPI thread stack at bring-up"
	depends on MESHTASTIC_TCP
	select DYNAMIC_THREAD
	select DYNAMIC_THREAD_ALLOC
	help
	  Allocate the (large, overflow-hardened) TCP serve-thread stack from the
	  heap in meshtastic_tcp_init() instead of reserving it statically. Intended
	  for a unified BLE+WiFi image: it removes the stack from the static image
	  and, because the TCP transport only inits when WiFi is the active
	  transport, leaves that internal DRAM free in BLE mode. The stack stays in
	  internal RAM (a PSRAM stack is unsafe across flash-write cache windows).
	  Needs the WiFi-mode heap to have room; on alloc failure the TCP PhoneAPI is
	  skipped (non-fatal). Leave OFF for single-transport net images, which
	  always run TCP and would only trade a proven static stack for a runtime
	  heap dependency. Pair with DYNAMIC_THREAD_PREFER_ALLOC=y and
	  DYNAMIC_THREAD_POOL_SIZE=0 so the stack is heap-backed, not from a static pool.

config MESHTASTIC_TCP_THREAD_PRIORITY
	int "TCP PhoneAPI thread priority"
	default 8
	help
	  Priority for the TCP accept/serve worker. Keep below LoRa packet
	  processing so broker I/O cannot delay local mesh sends.

config MESHTASTIC_TCP_IDLE_TIMEOUT_SEC
	int "Drop a client after this many seconds of silence (0 = never)"
	default 300
	help
	  Backstop for a client that vanished with no clean close and no
	  keepalive drop. A connected app resets this on any traffic/heartbeat;
	  "newest wins" preemption and SO_KEEPALIVE (if NET_TCP_KEEPALIVE) are
	  the primary mechanisms, so this can be generous.

endif # MESHTASTIC_TCP
```

## src/Kconfig.thread_summary
```kconfig
# SPDX-License-Identifier: GPL-3.0

config MESHTASTIC_THREAD_SUMMARY
	bool "Periodic condensed per-thread stack/CPU summary"
	default y
	depends on THREAD_ANALYZER
	help
	  Own periodic thread that calls the same public thread_analyzer_run()
	  API upstream's CONFIG_THREAD_ANALYZER_AUTO uses, but with a condensed
	  callback: batches 3 threads per LOG_INF line ("name stack%/cpu%"
	  triplets) instead of upstream's own two-lines-per-thread format
	  (a "STACK: ..." line and a separate "Total CPU cycles used: ..."
	  line for every thread).

	  Exists because CONFIG_THREAD_ANALYZER_AUTO's built-in dump -- left
	  as CONFIG_THREAD_ANALYZER_AUTO=y in prj.conf until 2026-08-09 -- is
	  genuinely large: ~29 threads on this build (see `kernel thread
	  stacks`) x 2 lines = ~58 near-simultaneous LOG_INF calls every
	  interval, which regularly overran the deferred-log ring buffer
	  ("--- N messages dropped ---" in the console/netlog output). This
	  reports the same two numbers that actually flag a problem at a
	  glance -- a climbing stack% signals encroaching overflow risk (the
	  same class of near-miss STABILITY-2, 2026-08-05, caught); a stuck-
	  high cpu% signals a runaway or starved thread -- and drops the
	  absolute cycles-used counter, which isn't actionable without a
	  second reading to diff against anyway.

	  Mutually exclusive with CONFIG_THREAD_ANALYZER_AUTO in spirit (both
	  can technically be on at once, but that just doubles the reporting
	  this exists to reduce) -- prj.conf leaves AUTO off by default now.

if MESHTASTIC_THREAD_SUMMARY

config MESHTASTIC_THREAD_SUMMARY_INTERVAL
	int "Interval between summaries (seconds)"
	default 300
	help
	  Matches the interval CONFIG_THREAD_ANALYZER_AUTO_INTERVAL used to be
	  set to here (5 min) -- enough to catch a trend without spamming.

config MESHTASTIC_THREAD_SUMMARY_STACK_SIZE
	int "Stack size for the summary thread"
	default 2048
	help
	  Matches the stack size CONFIG_THREAD_ANALYZER_AUTO_STACK_SIZE used
	  to be set to here -- this thread walks and formats every other
	  thread's info, doubled from the Zephyr default during an earlier
	  soak that measured this exact job as the tightest margin on the
	  bench (STABILITY-2 investigation, 2026-08-05).

endif # MESHTASTIC_THREAD_SUMMARY
```
