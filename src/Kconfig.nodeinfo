## src/Kconfig.nodeinfo
```kconfig
# Copyright (c) 2026 The Zephyr Project Contributors
# SPDX-License-Identifier: GPL-3.0

menuconfig MESHTASTIC_NODEINFO
	bool "Meshtastic NodeInfo announcement"
	default y
	help
	  Announce this node's User identity (name, MAC address derived from
	  the node ID, hardware model and role) to the mesh on the
	  NODEINFO_APP port. Without it peers only see a bare node number
	  with no name, MAC address or hardware model.

if MESHTASTIC_NODEINFO

config MESHTASTIC_NODEINFO_AUTO_SEND
	bool "Automatically broadcast NodeInfo"
	default y
	help
	  Periodically broadcast NodeInfo after meshtastic_init() so peers
	  (including nodes that join later) learn about this node.

config MESHTASTIC_NODEINFO_START_DELAY_SEC
	int "Delay before the first NodeInfo broadcast in seconds"
	default 30
	range 0 3600
	depends on MESHTASTIC_NODEINFO_AUTO_SEND
	help
	  Time to wait after meshtastic_init() before the first NodeInfo
	  broadcast, giving the radio and network time to settle.

config MESHTASTIC_NODEINFO_INTERVAL_SEC
	int "NodeInfo broadcast interval in seconds"
	default 10800
	range 3600 86400
	help
	  Interval between automatic NodeInfo broadcasts. The upstream
	  Meshtastic default is 3 hours (10800 s); broadcasting more than
	  once an hour is discouraged to limit channel utilisation.

	  NOT gated on MESHTASTIC_NODEINFO_AUTO_SEND (unlike START_DELAY_SEC,
	  which only means anything to the auto-send thread): this is also the
	  fallback meshtastic_nodeinfo_interval_secs() returns when no
	  device.node_info_broadcast_secs is stored (agents-t2hb.1), and that
	  function is reachable from the shell's `nodeinfo interval` read even
	  on a build with auto-send off.

config MESHTASTIC_NODEINFO_PEER_CACHE_SIZE
	int "NodeInfo peer cache size"
	default 16
	range 4 64
	help
	  Number of peers tracked in RAM for ad-hoc NodeInfo behavior: the
	  request and reply suppression stamps live here. Whether a peer is
	  "unknown" (and so gets asked for its NodeInfo) is decided from the
	  NodeDB record, which persists across reboots, not from this cache;
	  the cache only remembers when it was last asked or answered. Peers
	  with a User record in the NodeDB never trigger automatic requests.

config MESHTASTIC_NODEINFO_UNKNOWN_SUPPRESS_SEC
	int "Unknown-peer NodeInfo request suppression interval"
	default 600
	range 60 86400
	help
	  Minimum time before asking the same unknown peer for NodeInfo again.

config MESHTASTIC_NODEINFO_REPLY_SUPPRESS_SEC
	int "NodeInfo response suppression interval"
	default 43200
	range 60 86400
	help
	  Minimum time before replying again to the same peer's NodeInfo
	  want_response request.

endif # MESHTASTIC_NODEINFO
```

## src/Kconfig.phonelog
```kconfig
# SPDX-License-Identifier: GPL-3.0

menuconfig MESHTASTIC_PHONELOG
	bool "Forward the log stream to a connected phone (FromRadio.log_record)"
	depends on MESHTASTIC_PHONEAPI
	depends on LOG
	depends on LOG_MODE_DEFERRED
	select LOG_OUTPUT
	default y
	help
	  Registers a log backend that wraps each log message as a
	  FromRadio.log_record and hands it to every attached PhoneAPI transport.
	  Costs ZERO airtime -- the record never reaches the radio -- and the
	  official Android client already consumes it (its Debug panel, persisted
	  to the app's MeshLog table).

	  Added 2026-08-25, when the fleet went all-LoRa+BLE and lost the netlog:
	  log_backend_net needs WiFi, which no node now has, leaving a USB console
	  as the only way to see inside a node. This is the direct replacement for
	  bench work -- anything you can stand next to with a phone.

	  Not a replacement for MESHTASTIC_LOGRING, which is what survives a reset
	  and keeps working in panic mode. This backend deliberately stands down
	  once LOG_PANIC() runs: it takes mutexes and hands work to a BLE stack,
	  neither of which is safe from that context.

	  Requires deferred logging (the default). In immediate mode a backend runs
	  on whatever thread -- or ISR -- emitted the message, where taking the
	  PhoneAPI's mutexes would be wrong.

if MESHTASTIC_PHONELOG

config MESHTASTIC_PHONELOG_LEVEL
	int "Maximum severity forwarded (0=off 1=ERR 2=WRN 3=INF 4=DBG)"
	default 3
	range 0 4
	help
	  Compile-time default for the runtime filter; change it live with
	  `meshtastic phonelog <level>`. This filters what this backend FORWARDS,
	  independently of what each module is compiled at and of what the console
	  shows -- the same per-backend split MESHTASTIC_NETLOG_FILTER relies on.

	  ⚠ DBG (4) is self-sustaining, by design of the code around it rather
	  than of this backend: delivering a frame to the phone makes the BLE
	  transport log "FromRadio staged" at DBG, which is another record, which
	  is another delivery. At INF and below that line is filtered out and the
	  cycle cannot start. At DBG it runs until MESHTASTIC_PHONELOG_RATE stops
	  it -- bounded and visible (`meshtastic phonelog` shows the rate drops),
	  but the node will be spending its log budget describing its own logging.
	  Turn DBG on deliberately and for a specific question, not as a default.

config MESHTASTIC_PHONELOG_LINE_MAX
	int "Maximum characters per forwarded record"
	default 160
	range 64 384
	help
	  Bounds the formatting buffer and therefore the wire size of one record.
	  384 is the schema's LogRecord.message ceiling (mesh.options). Longer
	  lines are truncated, not split: a record is one log line.

config MESHTASTIC_PHONELOG_RATE
	int "Maximum records forwarded per second"
	default 20
	range 1 200
	help
	  A token bucket, refilled once a second, with the excess dropped and
	  counted. Two reasons, both learned elsewhere in this project: a log flood
	  must not be able to push real traffic through a bounded phone queue, and
	  a bounded rate is the backstop against any feedback loop where forwarding
	  a record causes another record.

endif # MESHTASTIC_PHONELOG
```

## src/Kconfig.pki
```kconfig
# Copyright (c) 2026 The Zephyr Project Contributors
# SPDX-License-Identifier: GPL-3.0

config MESHTASTIC_PKI
	bool "PKC for direct messages (Curve25519/X25519 + AES-CCM)"
	depends on MESHTASTIC_NODEDB && MESHTASTIC_SETTINGS
	help
	  Implements Meshtastic public-key cryptography for direct messages,
	  interoperable with the reference firmware: an X25519 keypair (generated
	  once, persisted in the SecurityConfig NVS partition — survives reboot and
	  reflash), advertised via User.public_key, with AES-256-CCM DM
	  encrypt/decrypt (key = SHA256(ECDH shared secret)). Fixes both the
	  "PKI send failed, no public key" a peer sees and the NO_CHANNEL a peer
	  returns for our PSK-only DMs.

	  Requires PSA crypto: ECDH + ECC Montgomery-255 (key pair
	  generate/import/export + public key), AES, CCM and SHA-256. On the net
	  build the ECC/AES/SHA pieces come from the TLS overlay; the overlay adds
	  PSA_WANT_ALG_CCM.

config MESHTASTIC_NODE_ID_FROM_KEY
	bool "Derive the node ID from the identity public key (reference >= 2.8)"
	depends on MESHTASTIC_PKI
	select CRC
	help
	  Use crc32(X25519 public key) as the node ID, as the reference firmware
	  has since 2.8 (NodeDB::createNewIdentity, shipped with packet signing).
	  The id then commits to the key: nobody can claim an id without also
	  holding the key it was derived from, which is what makes trusting a
	  stranger's first signed NodeInfo safe.

	  MESHTASTIC_NODE_ID_SOURCE still supplies the PROVISIONAL id, used only
	  when no key is readable and none was stored. The adopted id is kept in
	  the unsealed "mtid" settings record so a lockdown-locked boot, which
	  cannot read the keypair, keeps the same id.

	  Turning this on CHANGES the id of an existing node once, on its first
	  boot, and every peer then holds the node under both ids until the old
	  entry is forgotten or ages out (the reference does the same). Keys do
	  not change, so the new id is predictable before flashing, and turning
	  it off again returns the node to its hardware id.
```

## src/Kconfig.position
```kconfig
# Copyright (c) 2026 The Zephyr Project Contributors
# SPDX-License-Identifier: GPL-3.0

menuconfig MESHTASTIC_POSITION
	bool "Meshtastic position service"
	default y
	help
	  Position portnum module: caches the node's position (from a GNSS
	  source and/or an admin-set fixed position), answers incoming Position
	  requests, and broadcasts. Required by MESHTASTIC_GNSS, which is just
	  one optional source feeding it; can also run stand-alone on a GNSS-less
	  node to advertise a fixed position (admin set_fixed_position).

if MESHTASTIC_POSITION

config MESHTASTIC_POSITION_BROADCAST_INTERVAL_SEC
	int "Default position broadcast interval in seconds"
	default 300 if MESHTASTIC_GNSS
	default 900
	range 5 86400
	help
	  The compiled default for PositionConfig.position_broadcast_secs: a
	  stored nonzero value overrides it, read afresh at every broadcast, so
	  an admin/shell write applies to the next one with no reboot
	  (agents-t2hb.2). Governs both senders -- the GNSS fix-driven gate and
	  the timer that re-announces a fixed or phone-supplied position. The
	  two defaults preserve what each build shape did before the two
	  intervals were merged (GNSS 300 s, fixed-position beacon 900 s).

config MESHTASTIC_POSITION_REPLY_SUPPRESS_SEC
	int "Minimum seconds between Position want_response replies"
	default 180
	range 0 86400
	help
	  Rate-limit responses to incoming Position requests with want_response
	  set, matching stock PositionModule behavior.

endif # MESHTASTIC_POSITION
```

## src/Kconfig.power
```kconfig
# Meshtastic power policy — PowerConfig.is_power_saving wiring
# SPDX-License-Identifier: GPL-3.0

config MESHTASTIC_POWER_SAVE_DEFAULT
	bool "Default is_power_saving when no PowerConfig is stored"
	depends on PM
	default n
	help
	  Fallback for PowerConfig.is_power_saving before the phone / NVS provides
	  one. is_power_saving gates whether the SoC may enter light sleep
	  (PM_STATE_STANDBY): OFF holds a pm_policy lock blocking standby (stay
	  responsive — upstream's default for a mains/WiFi node); ON releases it.

	  Set y in a PM build (e.g. via a PM-enabled profile overlay) so light sleep is exercised
	  out of the box; the phone's stored is_power_saving still overrides on the
	  next boot. Only meaningful with CONFIG_PM (the power-policy hook,
	  meshtastic_power.c, compiles only then).
```

## src/Kconfig.powermon
```kconfig
# Meshtastic PowerMon — power-state activity instrumentation
# SPDX-License-Identifier: GPL-3.0

config MESHTASTIC_POWERMON
	bool "Power-state activity monitor (PowerMon)"
	default n
	help
	  Track power-relevant subsystem activity (LoRa RX/TX, wifi, light sleep,
	  Vext, GNSS, ...) as an atomic bitmask, logged on change at INF level and
	  readable over the shell ("powermon"). Intended for bench power
	  characterisation: correlate a measured current draw with what the node is
	  actually doing.

	  Zero cost when disabled — the instrumentation calls compile to no-ops, so
	  the radio/wifi/PM call sites carry no #ifdef. With CONFIG_PM, a PM notifier
	  additionally tracks the ESP32-S3 light-sleep state (atomically, no logging
	  from that constrained context).

	  Raise just this module's verbosity at the bench with
	  "log level dbg meshtastic_powermon" (state changes log at INF by default).
```

## src/Kconfig.preset
```kconfig
# SPDX-License-Identifier: GPL-3.0

menu "Preset switching"

config MESHTASTIC_PRESET_SETTLE_MS
	int "Radio settle window after a preset switch, in milliseconds"
	default 20
	range 0 1000
	help
	  How long the transmit path waits after a preset switch before keying the
	  PA. The TX path already asks the radio to listen before it talks
	  (LORA_CAD_MODE_LBT), so this is not about politeness — it is about the
	  first CAD after a retune being taken on an AGC that has not settled on
	  the new bandwidth yet, which can read a busy channel as quiet.

	  Costs nothing in steady state: the window is armed by a switch and is
	  already expired by the time the next frame is composed. 0 disables it.

	  docs/MULTI-PRESET-OPERATION.md §4.4, third interlock.

config MESHTASTIC_PRESET_DRAIN_MS
	int "How long a scheduled hop waits for the TX queue to drain"
	default 500
	range 0 30000
	help
	  A frame is composed for the preset the node was on when it was queued —
	  for a default (empty-name) channel the wire channel hash is derived from
	  the preset's display name, so transmitting it after a hop puts the wrong
	  hash on the new preset's frequency. meshtastic_preset_hop() therefore
	  refuses to leave until the outbound queue is empty.

	  This is the bound on that wait. Exceeding it is not an error: the hop is
	  refused, the node stays where it is, and a slot-driven caller simply
	  tries again at the next boundary.

	  docs/MULTI-PRESET-OPERATION.md §4.4, fourth interlock.

endmenu
```

## src/Kconfig.reboot_trace
```kconfig
# SPDX-License-Identifier: GPL-3.0

config MESHTASTIC_REBOOT_TRACE
	bool "Record where each reboot came from"
	default y
	help
	  Writes a small record into retained RAM whenever this node reboots: who
	  asked, from which thread, at what uptime, and the return address of the
	  caller. `meshtastic resets` reports it on the next boot.

	  The boot log already says whether a reset was warm and what hwinfo
	  reported. It cannot say who asked for it — and on 2026-09-04 that gap cost
	  a day of investigation when two nodes restarted seconds apart reporting
	  only "SOFTWARE", a deliberate reboot from firmware, with nothing in the
	  tree able to name which of the several possible paths had done it. Two of
	  those paths record something before rebooting; both had recorded nothing;
	  the answer remained unaccounted for.

	  This works by wrapping sys_reboot() at link time, so every caller is
	  captured — including the Zephyr shell's `kernel reboot`, MCUmgr, and any
	  library. That breadth is the point: instrumenting only our own call sites
	  would leave out exactly the suspects that matter when a reboot is
	  unexplained. Our own sites additionally leave a note naming their intent,
	  because a caller address identifies a site but not a reason.

	  Costs a few dozen bytes of retained RAM and a handful of stores on a path
	  that is about to reboot anyway.
```
